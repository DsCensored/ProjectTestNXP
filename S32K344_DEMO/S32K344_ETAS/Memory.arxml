AUTOSAR XML (schema 00050)
package /ETAS_Project/EcucModuleConfigurationValuess
  module config NvM_0: definition=NvM
    NvMBlockDescriptor_0 (NvMBlockDescriptor):
      NvMBlockCrcType = NVM_CRC16
      NvMBlockUseAutoValidation = 0
      NvMBlockUseCRCCompMechanism = 0
      NvMBlockUseCompression = 0
      NvMBlockUsePort = 0
      NvMBlockUseSyncMechanism = 0
      NvMCalcRamBlockCrc = 0
      NvMRamBlockDataAddress = NULL_PTR
      NvMRbBackupBlock = 0
      NvMRbFirstReadDataMigration = 0
      NvMRbInitBlockAtLayoutChange = 0
      NvMRbNoFallback = 0
      NvMRbRamBlockDataAddressString = NULL_PTR
      NvMRbRamInitUnconditional = 0
      NvMRbResistantToLayoutRemoval = 0
      NvMRbSelectBlockForFirstInitAll = 0
      NvMRbSingleBlockStartCallback = NULL_PTR
      NvMRbWriteCounter = 0
      NvMReadRamBlockFromNvCallback = NULL_PTR
      NvMRomBlockDataAddress = NULL_PTR
      NvMSelectBlockForReadAll = true
      NvMSelectBlockForWriteAll = true
      NvMWriteRamBlockToNvCallback = NULL_PTR
      NvMBlockJobPriority = 1
      NvMBlockManagementType = NVM_BLOCK_NATIVE
      NvMBlockUseCrc = true
      NvMBlockWriteProt = false
      NvMMaxNumOfReadRetries = 0
      NvMMaxNumOfWriteRetries = 0
      NvMNvBlockLength = 512
      NvMNvBlockNum = 1
      NvMNvramDeviceId = 0
      NvMResistantToChangedSw = false
      NvMRomBlockNum = 0
      NvMStaticBlockIDCheck = false
      NvMWriteBlockOnce = false
      NvMWriteVerification = false
      NvMWriteVerificationDataSize = 0
    NvMBlockDescriptor_1 (NvMBlockDescriptor):
      NvMBlockCrcType = NVM_CRC16
      NvMBlockUseAutoValidation = 0
      NvMBlockUseCRCCompMechanism = 0
      NvMBlockUseCompression = 0
      NvMBlockUsePort = 0
      NvMBlockUseSyncMechanism = 0
      NvMCalcRamBlockCrc = 0
      NvMRamBlockDataAddress = NULL_PTR
      NvMRbBackupBlock = 0
      NvMRbFirstReadDataMigration = 0
      NvMRbInitBlockAtLayoutChange = 0
      NvMRbNoFallback = 0
      NvMRbRamBlockDataAddressString = NULL_PTR
      NvMRbRamInitUnconditional = 0
      NvMRbResistantToLayoutRemoval = 0
      NvMRbSelectBlockForFirstInitAll = 0
      NvMRbSingleBlockStartCallback = NULL_PTR
      NvMRbWriteCounter = 0
      NvMReadRamBlockFromNvCallback = NULL_PTR
      NvMRomBlockDataAddress = NULL_PTR
      NvMSelectBlockForReadAll = 0
      NvMSelectBlockForWriteAll = 0
      NvMWriteRamBlockToNvCallback = NULL_PTR
    NvMCommon_0 (NvMCommon):
      NvMBswMMultiBlockJobStatusInformation = 0
      NvMCsmRetryCounter = 0
      NvMRbAuxInterface = 0
      NvMRbBlockHeader = 0
      NvMRbCallbackSignatureAR45 = 0
      NvMRbCommonCalcRamBlockCrc = 0
      NvMRbCommonWriteCounter = 0
      NvMRbDynConfigLoadDefaultsForNonResistant = 0
      NvMRbErrorInfoDetail = 0
      NvMRbExplcitSyncReadWithConst = 0
      NvMRbGenArxmlVersion = NVM_GEN_ARXML_VERSION_402
      NvMRbInitAtLayoutChange = 0
      NvMRbInitBufferBeforeSyncWrite = 0
      NvMRbMainFunctionScheduling = NVM_RB_MAINFUNC_SCHEDULING_RTE_TIMED
      NvMRbNoInitCallbackRomBlockConfigured = 0
      NvMRbNoSingleBlockBeforeReadAll = 0
      NvMRbNvCrcEnable = 0
      NvMRbRamInitCheck = NVM_RB_RAM_INIT_CHECK_NONE
      NvMRbRandomNrLength = 16
      NvMRbRemoveNonResistantBlocks = 0
      NvMRbReqMonitor = NVM_RB_REQ_MON_DISABLED
      NvMRbRuntimeRamBlockConfiguration = true
      NvMRbRuntimeRamBufferAddressEnd = NULL_PTR
      NvMRbRuntimeRamBufferAddressStart = NULL_PTR
      NvMRbSetWriteAllTriggerApi = 0
      NvMRbSwcdToEcucValuesEnable = 0
      NvMRepeatMirrorOperations = 0
      NvMSizeImmediateJobQueue = 1
      NvMApiConfigClass = NVM_API_CONFIG_CLASS_3
      NvMCompiledConfigId = 0
      NvMDynamicConfiguration = false
      NvMCrcNumOfBytes = 1
      NvMDevErrorDetect = false
      NvMDrvModeSwitch = false
      NvMJobPrioritization = true
      NvMMainFunctionPeriod = 0.01
      NvMPollingMode = true
      NvMSizeStandardJobQueue = 5
      NvMVersionInfoApi = false
      NvMSetRamBlockStatusApi = true
package /ETAS_Project/EcucModuleConfigurationValuess1
  module config Fee_0: definition=Fee
    FeeBlockConfiguration_0 (FeeBlockConfiguration): FeeRbDeviceIndex=0, FeeRbFirstReadDataMigration=0, FeeRbNoFallback=0, FeeRbRobustness=0, FeeRbSurvival=0, FeeRbVarBlockLength=0
    FeeGeneral_0 (FeeGeneral):
      FeeMainFunctionPeriod = 0.0
      FeeRbActSurvivalEval = 0
      FeeRbActUnknownBlockReorg = 0
      FeeRbActUnknownBlockReorgCacheSize = 1800
      FeeRbBlockTableLocation = ROM
      FeeRbChunkJobApis = 0
      FeeRbChunkJobFeatureRequested = FEE_RB_CHUNK_FEATURE_LEVEL1
      FeeRbConfirmSingleStorageBlockloss = 0
      FeeRbConfirmUseGetSystemJobResult = 0
      FeeRbDetailedBlkInfoApi = 0
      FeeRbEnableRuntimeErrorReporting = false
      FeeRbEnterStopModeApi = 0
      FeeRbFsSelect = FS1
      FeeRbGetFreeSpaceApi = 0
      FeeRbGetNrFreeBytesAndFatEntriesApi = 0
      FeeRbGetNrSectorErases = true
      FeeRbGetSectStateApi = 0
      FeeRbInclPrjHeader = 0
      FeeRbMainFunctionScheduling = FEE_RB_MAINFUNC_SCHEDULING_RTE_BACKGROUND
      FeeRbMaintainRedundantBlocks = true
      FeeRbNrOfUnknownBlockCacheEntries = 300
      FeeRbPageBufferSize = 1024
      FeeRbRestrictDirectMemoryAccess = 0
      FeeRbSchedTriggerFeeRbEndInit = empty
      FeeRbSecondPageBufferSize = 1024
      FeeRbSetAndGetJobModeApi = 0
      FeeRbSyncFlsMainLoopHook = NULL_PTR
      FeeRbTriggerReorgApi = 0
      FeeRbUseRelativeAddressing = 0
      FeeDevErrorDetect = false
      FeePollingMode = true
      FeeVersionInfoApi = false
      FeeSetModeSupported = true
      FeeRbMachineType = FEE_RB_FULL_MANUAL_CFG
      FeeVirtualPageSize = 1024
    FeeRbDevice: FeeRbDeviceFs1xDirectMemAccess=true
package /ETAS_Project/EcucModuleConfigurationValuess2
  module config MemIf_0: definition=MemIf
    MemIfGeneral_0 (MemIfGeneral):
      MemIfRbMainFunctionScheduling = MEMIF_RB_MAINFUNC_SCHEDULING_RTE_TIMED
      MemIfMainFunctionCycleTime = 0.01
      MemIfNumberOfDevices = 1
      MemIfRbFeeUsed = true
      MemIfRbDisableForwardingScheduleInfo = false
      MemIfVersionInfoApi = false
      MemIfDevErrorDetect = false
