AUTOSAR XML (schema 00048)
package /AUTOSAR_WdgIf/EcucModuleDefs
  module definition WdgIf [0..1]: category=VENDOR_SPECIFIC_MODULE_DEFINITION, post-build-variant-support=true, refined-module-def=WdgIf, variants pre-compile  # Watchdog Interface | Configuration of the WdgIf (Watchdog Interface) module (with vendor specific enhancements of RB).
    container WdgIfDevice [1..*]: multiplicity set at pre-compile  # Watchdog Device Selection for WdgIf | It contains the information for the selection of a particular Watchdog device in case multiple Watchdog drivers are connected.
      integer WdgIfDeviceIndex: 0..255, scope=ECU, set at pre-compile, symbolic-name-value=true, with-auto=true  # Watchdog interface identifier | Represents the watchdog interface ID so that it can be referenced by the watchdog manager. This parameter should not be configured by Integrator. Value for this parameters will be filled(forwarded) by the Id Generate Script.
      symbolic name reference WdgIfDriverRef: set at pre-compile, destination=WdgGeneral  # Watchdog driver reference | Reference to the watchdog drivers that are controlled by the watchdog interface.
    container WdgIfGeneral  # Watchdog interface general | This container collects all generic watchdog interface parameters.
      boolean WdgIfDevErrorDetect: set at pre-compile  # Development error enable | Switches the development error detection and notification on or off. true: detection and notification is enabled. false: detection and notification is disabled.
      string WdgIfRbExtWdgModuleName [0..255]: multiplicity set at pre-compile, origin=RB:1.0.0:2012-09-28, set at pre-compile  # External Watchdog Module name | This is module name of the External Watchdog Module. This parameter is to help generating the Api names to be used inside WdgIf from Io External Device controller. If this parameter is not configured, Vendor specific(related to RTA-BSW specific IoExtDev module) External Watchdog interfaces will not be generated. This shall be configured with exact Module name, as it should appear in the Prefix for the generated Api's.
      boolean WdgIfVersionInfoApi: set at pre-compile  # Version information | Pre-processor switch to enable / disable the service returning the version information. true: Version information service enabled false: Version information service disabled
      container WdgIfRbExtWdgApiSupport [0..255]: multiplicity set at pre-compile  # External Watchdog Api Support | This Container consists of parameters which indicate whether corresponding Api (functionality) is supported by the External watchdog module (configured at parameter "WdgIfRbExtWdgModuleName") or not. This container should not be configured by Integrator. Value for the parameters of this container will be filled(forwarded) by the External watchdog module (driver). External watchdog module should forward "External watchdog module name" as shortname for this container.
        boolean WdgIfRbExtWdgApiGetRegVdd5OvWda [0..1]: scope=ECU, multiplicity set at pre-compile, origin=RB:9.0.0:2020-11-09, set at pre-compile, with-auto=true  # Api GetRegVdd5OvWda Supported | Indicates whether Api to read status of VDD5OV_WDA bit is supported by External Watchdog module (driver) or not. True: GetRegVdd5OvWda Api is supported by the External Watchdog module. False: GetRegVdd5OvWda Api is not supported by the External Watchdog module. If this parameter is not configured, then it will be considered as Api not supported by the External Watchdog module (that is value 'False').
        boolean WdgIfRbExtWdgApiGetSwtPosn [0..1]: scope=ECU, multiplicity set at pre-compile, origin=RB:3.1.0:2018-04-06, set at pre-compile, with-auto=true  # Api GetSwtPosn Supported | Indicates whether Api to Get Switch position is supported by External Watchdog module (driver) or not. True: GetSwtPosn Api is supported by the External Watchdog module. False: GetSwtPosn Api is not supported by the External Watchdog module. If this parameter is not configured, then it will be considered as Api not supported by the External Watchdog module (that is value 'False').
        boolean WdgIfRbExtWdgApiGetUMonStatus [0..1]: scope=ECU, multiplicity set at pre-compile, origin=RB:9.0.0:2020-11-09, set at pre-compile, with-auto=true  # Api GetUMonStatus Supported | Indicates whether Api to read voltage monitoring status is supported by External Watchdog module (driver) or not. True: Api GetUMonStatus is supported by the External Watchdog module. False: Api GetUMonStatus is not supported by the External Watchdog module. If this parameter is not configured, then it will be considered as Api not supported by the External Watchdog module (that is value 'False').
        boolean WdgIfRbExtWdgApiGetWdgDiag [0..1]: scope=ECU, multiplicity set at pre-compile, origin=RB:1.0.0:2021-06-18, set at pre-compile, with-auto=true  # Api GetWdgDiag Supported | Indicates whether Api to read Watchdog Diagnostics is supported by External Watchdog module (driver) or not. True: Api GetWdgDiag is supported by the External Watchdog module. False: Api GetWdgDiag is not supported by the External Watchdog module. If this parameter is not configured, then it will be considered as Api not supported by the External Watchdog module (that is value 'False').
        boolean WdgIfRbExtWdgApiGetWdgThd [0..1]: scope=ECU, multiplicity set at pre-compile, origin=RB:6.1.0:2019-09-25, set at pre-compile, with-auto=true  # Api GetWdgThd Supported | Indicates whether Api to Get Wda threshold is supported by External Watchdog module (driver) or not. True: Api GetWdgThd is supported by the External Watchdog module. False: Api GetWdgThd is not supported by the External Watchdog module. If this parameter is not configured, then it will be considered as Api not supported by the External Watchdog module (that is value 'False').
        boolean WdgIfRbExtWdgApiGetWdgTiWin [0..1]: scope=ECU, multiplicity set at pre-compile, origin=RB:8.0.0:2020-05-21, set at pre-compile, with-auto=true  # Api GetWdgTiWin Supported | Indicates whether Api to Get Time Window value is supported by External Watchdog module (driver) or not. True: Api GetWdgTiWin is supported by the External Watchdog module. False: Api GetWdgTiWin is not supported by the External Watchdog module. If this parameter is not configured, then it will be considered as Api not supported by the External Watchdog module (that is value 'False').
        boolean WdgIfRbExtWdgApiReqUMonStatus [0..1]: scope=ECU, multiplicity set at pre-compile, origin=RB:9.0.0:2020-11-09, set at pre-compile, with-auto=true  # Api ReqUMonStatus Supported | Indicates whether Api to request voltage monitoring status is supported by External Watchdog module (driver) or not. True: ReqUMonStatus Api is supported by the External Watchdog module. False: ReqUMonStatus Api is not supported by the External Watchdog module. If this parameter is not configured, then it will be considered as Api not supported by the External Watchdog module (that is value 'False').
        boolean WdgIfRbExtWdgApiRlsWDA [0..1]: scope=ECU, multiplicity set at pre-compile, origin=RB:1.1.0:2021-10-05, set at pre-compile, with-auto=true  # Api RlsWDA Supported | Indicates whether Api to release FS0b is supported by External Watchdog module (driver) or not. True: RlsWDA Api is supported by the External Watchdog module. False: RlsWDA Api is not supported by the External Watchdog module. If this parameter is not configured, then it will be considered as Api not supported by the External Watchdog module (that is value 'False').
        boolean WdgIfRbExtWdgApiSetOperMode [0..1]: scope=ECU, multiplicity set at pre-compile, origin=RB:9.0.0:2020-11-09, set at pre-compile, with-auto=true  # Api SetOperMode Supported | Indicates whether Api to Set the operating mode is supported by External Watchdog module (driver) or not. True: SetOperMode Api is supported by the External Watchdog module. False: SetOperMode Api is not supported by the External Watchdog module. If this parameter is not configured, then it will be considered as Api not supported by the External Watchdog module (that is value 'False').
        boolean WdgIfRbExtWdgApiSetRegVdd5OvWda [0..1]: scope=ECU, multiplicity set at pre-compile, origin=RB:9.0.0:2020-11-09, set at pre-compile, with-auto=true  # Api SetRegVdd5OvWda Supported | Indicates whether Api to set status of VDD5OV_WDA bit is supported by External Watchdog module (driver) or not. True: SetRegVdd5OvWda Api is supported by the External Watchdog module. False: SetRegVdd5OvWda Api is not supported by the External Watchdog module. If this parameter is not configured, then it will be considered as Api not supported by the External Watchdog module (that is value 'False').
        boolean WdgIfRbExtWdgApiSetSwtPosn [0..1]: scope=ECU, multiplicity set at pre-compile, origin=RB:3.1.0:2018-04-06, set at pre-compile, with-auto=true  # Api SetSwtPosn Supported | Indicates whether Api to Set Switch position is supported by External Watchdog module (driver) or not. True: SetSwtPosn Api is supported by the External Watchdog module. False: SetSwtPosn Api is not supported by the External Watchdog module. If this parameter is not configured, then it will be considered as Api not supported by the External Watchdog module (that is value 'False').
        boolean WdgIfRbExtWdgApiSetWdgThd [0..1]: scope=ECU, multiplicity set at pre-compile, origin=RB:5.1.0:2019-02-06, set at pre-compile, with-auto=true  # Api SetWdgThd Supported | Indicates whether Api to Set Wda threshold is supported by External Watchdog module (driver) or not. True: Api SetWdgThd is supported by the External Watchdog module. False: Api SetWdgThd is not supported by the External Watchdog module. If this parameter is not configured, then it will be considered as Api not supported by the External Watchdog module (that is value 'False').
        boolean WdgIfRbExtWdgApiSetWdgTiWin [0..1]: scope=ECU, multiplicity set at pre-compile, origin=RB:8.0.0:2020-05-21, set at pre-compile, with-auto=true  # Api SetWdgTiWin Supported | Indicates whether Api to Set Time Window value is supported by External Watchdog module (driver) or not. True: Api SetWdgTiWin is supported by the External Watchdog module. False: Api SetWdgTiWin is not supported by the External Watchdog module. If this parameter is not configured, then it will be considered as Api not supported by the External Watchdog module (that is value 'False').
        boolean WdgIfRbExtWdgApiSetWdgWin [0..1]: scope=ECU, multiplicity set at pre-compile, origin=RB:1.0.0:2021-06-18, set at pre-compile, with-auto=true  # Api SetWdgWin Supported | Indicates whether Api to Set Window period and Window duty cycle is supported by External Watchdog module (driver) or not. True: Api SetWdgWin is supported by the External Watchdog module. False: Api SetWdgWin is not supported by the External Watchdog module. If this parameter is not configured, then it will be considered as Api not supported by the External Watchdog module (that is value 'False').
    container WdgIfRbConfigSet [0..1]  # Configuration set for WdgIf | This Container consists of parameters that support Post-Build variation.
      string WdgIfRbExtWdgModuleSel [0..1]: scope=ECU, origin=RB:5.1.0:2019-03-26, post-build-variant-value=true, set at pre-compile, with-auto=true  # Watchdog Module Name | This parameter is used for the selection of the External Watchdog module Name (WdgIfRbExtWdgModuleName) for particular Post-Build variant. This parameter should not be configured manually. Value for this parameter will be forwarded by the External Watchdog Module.
