[part 2 of 2: package /AUTOSAR_Dcm/EcucModuleDefs]
AUTOSAR XML (schema 4-2-2)
package /AUTOSAR_Dcm/EcucModuleDefs  (continued)
  module definition Dcm [0..1]: category=VENDOR_SPECIFIC_MODULE_DEFINITION, refined-module-def=Dcm, variants link-time/post-build/pre-compile  (continued)
    container DcmConfigSet  (continued)
      container DcmDsp [0..1]  (continued)
        container DcmDspRoutine [0..*]  # This container contains the configuration (parameters) for Routines
          integer DcmDspRoutineIdentifier: 0..65535, scope=ECU, set at link in variant link-time / pre-compile in variant post-build+pre-compile  # 2 bytes Identifier of the RID | Within each DcmConfigSet all DcmDspRoutineIdentifier values shall be unique.
          integer DcmDspRoutineInfoByte [0..1]: 0..255, scope=ECU, set at link in variant link-time / pre-compile in variant post-build+pre-compile  # Manufacturer specific value reported to the tester for the all record identifiers. For OBD RIDS routine info byte value is always 0 as per J1979-2. For other RIDS routine info byte value shall be same as configured value
          boolean DcmDspRoutineUsePort: scope=ECU, multiplicity set at pre-compile, set at pre-compile  # If this parameter is set to true, the DCM uses a port requiring a PortInterface RoutineServices_{RoutineName}. | The R-Port is named RoutineServices_{RoutineName} where {RoutineName} is the name of the container DcmDspRoutine In that case, the configuration must not provide function names in DcmDspStartRoutineFnc, DcmDspStopRoutineFnc or DcmDspRequestResultsRoutineFnc. If this is false, the DCM expects to find the names of the functions to be used in DcmDspStartRoutineFnc, DcmDspStopRoutineFnc or DcmDspRequestResultsRoutineFnc.
          boolean DcmDspRoutineUsed [0..0]: scope=ECU, set at link in variant link-time / post-build in variant post-build / pre-compile in variant pre-compile  # Allow to activate or deactivate the usage of a Routine, for multi purpose ECUs | True = Routine is available False = Routine is not available
          function name DcmRbDspIsRIDAvailableFnc [0..1]: multiplicity set at pre-compile, origin=RB:AR42.1.0.0:2017-01-31, set at pre-compile  # Function name to request the application to check if the routine identifier (RID) requested is supported in the variant.The user can leave the field empty if the check is not required for this RID
          boolean DcmRbDspReqSequenceErrorEnabled [0..1]: multiplicity set at pre-compile, origin=RB:AR42.1.0.0:2017-01-31, set at pre-compile, default-value=true  # Indicates Request Sequence Error (NRC 0x24) shall be triggered for a RequestResults/Stop subfunction with/without a prior Start subfunction request for Routines which supports both RequestResults and Start subfunctions/ Stop and Start Subfunctions. True :For a Routine which supports both RequestResults/Stop and Start Subfunction,NRC 0x24 shall be triggered if Routine Control tester request with RequestResults subfunction(0x03)/Stop subfunction(0x02) comes for a Routine which is not started (without a prior Routine Control request with Start subfunction(0x01)) False:For a Routine which supports both RequestResults/Stop and Start Subfunction,positive response shall be triggered if valid Routine Control tester request with RequestResults subfunction(0x03)/Stop subfunction(0x02) comes without a prior Routine Control request with Start subfunction(0x01) Dependency: Applicable only if Start subfunction (DcmDspStartRoutineSupported configured as TRUE or left unconfigured) and RequestResults subfunction(DcmDspRequestResultsRoutineSupported configured as TRUE)/Stop subfunction(DcmDspStopRoutineSupported configured as TRUE) is supported for RID, otherwise not valid.If the parameter is left unconfigured , default value will be considered as TRUE and the request sequence error will be enabled. | True:For a Routine which supports both RequestResults/Stop and Start Subfunction,NRC 0x24 shall be triggered if Routine Control tester request with RequestResults subfunction(0x03/Stop subfunction(0x02) comes for a Routine which is not started (without a prior Routine Control request with Start subfunction(0x01)) False:For a Routine which supports both RequestResults/Stop and Start Subfunction,positive response shall be triggered if Routine Control tester request with RequestResults subfunction(0x03)/Stop subfunction(0x02) comes without a prior Routine Control request with Start subfunction(0x01)
          boolean DcmRbDspRoutineUseAsynchronousServerCallPoint [0..1]: multiplicity set at link in variant link-time+post-build / pre-compile in variant pre-compile, origin=RB:AR42.13.0.0:2017-01-31, set at link in variant link-time+post-build / pre-compile in variant pre-compile, default-value=false  # Only relevant in case DcmDspRoutineUsePort is set to TRUE.This parameter is used to select the type of Server Handling required.Set the value to TRUE for Asynchronous server call point handling else Synchronous server call point handling is carried out
          function name DcmRbDspRoutineUserRoutineModeRuleFnc [0..1]: multiplicity set at pre-compile, origin=RB:AR42.1.0.0:2017-01-31, set at pre-compile  # Function name used by the application to perform user specific checks before accessing a Routine.In case the checks fails, NRC value set by the application can be returned to the tester. In case the function is not configured for the Routine, the DcmAppl API DcmAppl_UserRIDModeRuleService shall be called.
          boolean DcmRbDspStopRoutineOnSessionChange [0..1]: multiplicity set at pre-compile, origin=RB:AR42.1.0.0:2017-01-31, set at pre-compile, default-value=false  # Indicates if the StopRoutine operation needs to be performed on any session change. True = Stop this Routine if it is active on transition to default session / Stop this routine if it is not supported in the new nondefault session. False = No action on session transitions Dependency: Applicable only if StopRoutine operation is supported for RID (DcmDspStopRoutineSupported = true), otherwise not valid.If the parameter is left unconfigured FALSE will be considered as the default value. | true = stopRoutine is supported on session change false = stopRoutine is not supported on session change
          container DcmDspRequestRoutineResults [0..1]  # Provides the configuration of RequestResult subservice for RoutineControl service. | Existence indicates that the RequestRoutineResults in the RoutineControl is supported.
            boolean DcmDspRequestRoutineResultsConfirmationEnabled [0..0]: scope=ECU, multiplicity set at pre-compile, set at pre-compile, default-value=false  # Allows to enable/disable the confirmation function to indicate the transmission of a response to a RequestRoutineResults request
            function name DcmDspRequestRoutineResultsConfirmationFnc [0..0]: scope=ECU, multiplicity set at pre-compile, set at pre-compile  # C-function to call if a transmission confirmation is needed by the issuer (BSW module)
            function name DcmDspRequestRoutineResultsFnc [0..1]: scope=ECU, multiplicity set at pre-compile, set at pre-compile  # Function name for request to application the results of a routine. (Routine_RequestResults-function) | This parameter is related to the interface Xxx_RequestResults.
            integer DcmDspRequestRoutineResultsRole [0..1]: 0..4294967295, scope=ECU, multiplicity set at link in variant link-time / post-build in variant post-build / pre-compile in variant pre-compile, set at link in variant link-time / post-build in variant post-build / pre-compile in variant pre-compile  # Bitfield were each bit represents one dedicated role. A RoutineControl with sub-function requestResults is granted access if the bit value is 1. If a bit value is 0, the routine is not allowed for that role. If this parameter is not configured and the Service 0x29 (Authentication) is configured, the DcmDspAuthenticationDeauthenticatedRole will be considered for the role verification check so that when role is not configured, the routine will be allowed to be executed in all the deauthenticated states.
            boolean DcmDspRoutineInterfaceArgumentIntegrity [0..1]: scope=ECU, multiplicity set at pre-compile, set at pre-compile, default-value=true  # Defines the value of ClientServerOperation.diagArgIntegrity for the created C/S interface of this routine
            reference DcmDspRequestRoutineResultsCommonAuthorizationRef [0..1]: scope=ECU, multiplicity set at link in variant link-time / pre-compile in variant post-build+pre-compile, set at link in variant link-time / pre-compile in variant post-build+pre-compile, destination=DcmDspCommonAuthorization  # Reference to DcmDspCommonAuthorization | Common authorization configuration taken from the referenced DcmDspRequestRoutineResultsCommonAuthorizationRef. If there is no reference, no check on the commonly defined authorization conditions shall be done to get the routine result.
            container DcmDspRequestRoutineResultsIn [0..0]  # Provide description of input parameter of RequestResult subservice for RoutineControl service.
              container DcmDspRequestRoutineResultsInSignal [1..*]: requires-index=true  # Provides description of a routine signal used in RoutineControl service. | The ordering defined via the index attribute of the subcontainers in this list represents the order of the dataIn_n elements in the XXX_RequestResult function call.
                integer DcmDspRoutineParameterSize [0..0]: 0..65535, scope=ECU, multiplicity set at link in variant link-time / pre-compile in variant post-build+pre-compile, set at link in variant link-time / pre-compile in variant post-build+pre-compile  # Provide the size of a RoutineControl parameter in bytes
                enumeration DcmDspRoutineSignalEndianness [0..0]: {BIG_ENDIAN, LITTLE_ENDIAN, OPAQUE}, scope=ECU, multiplicity set at link in variant link-time / pre-compile in variant post-build+pre-compile, set at link in variant link-time / pre-compile in variant post-build+pre-compile  # Defines the endianness of the data belonging to a Routine In Signal for RequestResult subfunction.
                integer DcmDspRoutineSignalPos [0..0]: 0..65535, scope=ECU, set at link in variant link-time / pre-compile in variant post-build+pre-compile  # Provide the position of the signal in the RoutineControl request/response. | The position is defined in bits.
                enumeration DcmDspRoutineSignalType [0..0]: {BOOLEAN, SINT16, SINT16_N, SINT32, SINT32_N, SINT8, SINT8_N, UINT16, UINT16_N, UINT32, UINT32_N, UINT8, UINT8_N, VARIABLE_LENGTH}, scope=ECU, set at link in variant link-time / pre-compile in variant post-build+pre-compile  # Provide the type of the signal in the RoutineControl request/response.
                choice container DcmDspArgumentScaling [0..1]  # This container contains the configuration (arguments) of an alternative Diagnosis Representation. Out if this the scaling between Diagnosis and ECU internal representation and vice versa can be calculated.
                  container DcmDspAlternativeArgumentData [0..0]  # This container contains the configuration (parameters) of an alternative Diagnosis Representation by the means of a ArgumentDataPrototype.
                    foreign reference DcmDataElement [0..0]: set at pre-compile, destination-type=ARGUMENT-DATA-PROTOTYPE  # Alternative Diagnosis Representation for the data defined by the means of a ArgumentDataPrototype. | The CompuMethod of the data type of the referenced ArgumentDataPrototype will be applied to the data type of the ArgumentDataPrototype in the interface used by the Dcm.
                  container DcmDspAlternativeDataType [0..1]  # This container contains the configuration (parameters) of an alternative Diagnosis Representation by the means of an ApplicationDataType. | Additionally the definition of a text table mapping can be a defined for ApplicationDataTypes with a CompuMethod of category TEXTTABLE and SCALE_LINEAR_AND_TEXTTABLE.
                    foreign reference DcmApplicationDataType: set at pre-compile, destination-type=APPLICATION-DATA-TYPE  # Alternative Diagnosis Representation for the data defined by the means of a ApplicationDataType of category VALUE, BOOLEAN or ARRAY. | The CompuMethod that applies to the referenced ApplicationDataType in case of category VALUE or BOOLEAN will be applied to the data type of the VariableDataPrototype in the interface used by the Dcm.
                    container DcmDspTextTableMapping [0..*]  # The purpose of the DcmDspTextTableMapping is to associate a texttable value defined in the context of the Dcm to a texttable value defined in the context of a CompuMethod referenced by a DataType that shall be taken to create a dataElement in a SenderReceiverInterface. By this means it is possible to create a primitive version of a TexttableMapping (which can only be applied if a dataElement already exists). | In other words, the DcmDspTextTableMapping provides a similar mechanism to the TexttableMapping in a situation where the TexttableMapping cannot be applied since the SenderReceiverInterface for the PortPrototype on the Dcm ServiceComponent does not yet exist.
                      integer DcmDspDiagnosisRepresentationDataValue: 0..18446744073709551615, scope=ECU, set at pre-compile  # The data value in the diagnosis representation.
                      integer DcmDspInternalDataValue: 0..18446744073709551615, scope=ECU, set at pre-compile  # The ECU internal data value.
                  container DcmDspAlternativeDiagnosticDataElement [0..0]  # This container contains the configuration (parameters) of an alternative Diagnosis Representation by the means of Diagnostic Extract.
                    foreign reference DcmDspDiagnosticDataElementRef [0..0]: set at pre-compile, destination-type=DIAGNOSTIC-DATA-ELEMENT  # Alternative Diagnosis Representation for the data defined by the means of a DiagnosticDataElement in the Diagnostic Extract. | This EcucForeignReference enables the access to all SwDataDefProps, in particular BaseType, CompuMethod and DataConstr The CompuMethod and DataConstr that applies to the referenced DiagnosticDataElement will be applied to the data type of the VariableDataPrototype in the interface used by the Dcm. The mapped ImplementationDataType needs to match the given BaseType.
            container DcmDspRequestRoutineResultsOut [0..1]  # Provide description of output parameter of RequestResult subservice for RoutineControl service.
              container DcmDspRequestRoutineResultsOutSignal [1..*]: requires-index=true  # Provides description of a routine signal used in RoutineControl service. | The ordering defined via the index attribute of the subcontainers in this list represents the order of the dataOutN elements in the XXX_RequestResult function call.
                integer DcmDspRoutineParameterSize [0..0]: 0..65535, scope=ECU, multiplicity set at link in variant link-time / pre-compile in variant post-build+pre-compile, set at link in variant link-time / pre-compile in variant post-build+pre-compile  # Provide the size of a RoutineControl parameter in bytes
                enumeration DcmDspRoutineSignalEndianness [0..1]: {BIG_ENDIAN, LITTLE_ENDIAN, OPAQUE}, scope=ECU, multiplicity set at link in variant link-time / pre-compile in variant post-build+pre-compile, set at link in variant link-time / pre-compile in variant post-build+pre-compile  # Defines the endianness of the data belonging to a Routine Out Signal for RequestResult subfunction.
                integer DcmDspRoutineSignalLength [0..1]: 0..65535, scope=ECU, multiplicity set at link in variant link-time / pre-compile in variant post-build+pre-compile, set at link in variant link-time / pre-compile in variant post-build+pre-compile  # Provide the length in bits of the signal in the RoutineControl request/response
                integer DcmDspRoutineSignalPos: 0..65535, scope=ECU, set at link in variant link-time / pre-compile in variant post-build+pre-compile  # Provide the position of the signal in the RoutineControl request/response. | The position is defined in bits.
                enumeration DcmDspRoutineSignalType: {BOOLEAN, SINT16, SINT16_N, SINT32, SINT32_N, SINT8, SINT8_N, UINT16, UINT16_N, UINT32, UINT32_N, UINT8, UINT8_N, VARIABLE_LENGTH}, scope=ECU, set at link in variant link-time / pre-compile in variant post-build+pre-compile  # Provide the type of the signal in the RoutineControl request/response.
                choice container DcmDspArgumentScaling [0..1]  # This container contains the configuration (arguments) of an alternative Diagnosis Representation. Out if this the scaling between Diagnosis and ECU internal representation and vice versa can be calculated.
                  container DcmDspAlternativeArgumentData [0..0]  # This container contains the configuration (parameters) of an alternative Diagnosis Representation by the means of a ArgumentDataPrototype.
                    foreign reference DcmDataElement [0..0]: set at pre-compile, destination-type=ARGUMENT-DATA-PROTOTYPE  # Alternative Diagnosis Representation for the data defined by the means of a ArgumentDataPrototype. | The CompuMethod of the data type of the referenced ArgumentDataPrototype will be applied to the data type of the ArgumentDataPrototype in the interface used by the Dcm.
                  container DcmDspAlternativeDataType [0..1]  # This container contains the configuration (parameters) of an alternative Diagnosis Representation by the means of an ApplicationDataType. | Additionally the definition of a text table mapping can be a defined for ApplicationDataTypes with a CompuMethod of category TEXTTABLE and SCALE_LINEAR_AND_TEXTTABLE.
                    foreign reference DcmApplicationDataType: set at pre-compile, destination-type=APPLICATION-DATA-TYPE  # Alternative Diagnosis Representation for the data defined by the means of a ApplicationDataType of category VALUE, BOOLEAN or ARRAY. | The CompuMethod that applies to the referenced ApplicationDataType in case of category VALUE or BOOLEAN will be applied to the data type of the VariableDataPrototype in the interface used by the Dcm.
                    container DcmDspTextTableMapping [0..*]  # The purpose of the DcmDspTextTableMapping is to associate a texttable value defined in the context of the Dcm to a texttable value defined in the context of a CompuMethod referenced by a DataType that shall be taken to create a dataElement in a SenderReceiverInterface. By this means it is possible to create a primitive version of a TexttableMapping (which can only be applied if a dataElement already exists). | In other words, the DcmDspTextTableMapping provides a similar mechanism to the TexttableMapping in a situation where the TexttableMapping cannot be applied since the SenderReceiverInterface for the PortPrototype on the Dcm ServiceComponent does not yet exist.
                      integer DcmDspDiagnosisRepresentationDataValue: 0..18446744073709551615, scope=ECU, set at pre-compile  # The data value in the diagnosis representation.
                      integer DcmDspInternalDataValue: 0..18446744073709551615, scope=ECU, set at pre-compile  # The ECU internal data value.
                  container DcmDspAlternativeDiagnosticDataElement [0..0]  # This container contains the configuration (parameters) of an alternative Diagnosis Representation by the means of Diagnostic Extract.
                    foreign reference DcmDspDiagnosticDataElementRef [0..0]: set at pre-compile, destination-type=DIAGNOSTIC-DATA-ELEMENT  # Alternative Diagnosis Representation for the data defined by the means of a DiagnosticDataElement in the Diagnostic Extract. | This EcucForeignReference enables the access to all SwDataDefProps, in particular BaseType, CompuMethod and DataConstr The CompuMethod and DataConstr that applies to the referenced DiagnosticDataElement will be applied to the data type of the VariableDataPrototype in the interface used by the Dcm. The mapped ImplementationDataType needs to match the given BaseType.
                  container DcmDspAlternativeDataProps [0..1]  # This container contains the configuration (parameters) of an alternative Diagnosis Representation by the means of ECU configuration parameters.The physical unit of the alternative data representation is defined by the DataPrototype referenced by DcmDspExternalSRDataElementClass. Additionally the definition of a text table mapping can be a defined for DcmDspDataTypeCategory TEXTTABLE and SCALE_LINEAR_AND_TEXTTABLE | The physical unit of the alternative data representation is defined by the DataPrototype referenced by DcmDspExternalSRDataElementClass. Additionally the definition of a text table mapping can be a defined for DcmDspDataTypeCategory TEXTTABLE and SCALE_LINEAR_AND_TEXTTABLE
                    container DcmDspLinearScale  # This container contains the configuration (parameters) of an linear scale of the alternative Diagnosis Representation.
                      float DcmDspDiagnosisRepresentationDataLowerRange: -Inf..Inf, scope=ECU, set at pre-compile  # Lower Range for this scale of the data in the alternative Diagnosis Representation.
                      float DcmDspDiagnosisRepresentationDataOffset: 0..Inf, scope=ECU, set at pre-compile, default-value=0  # Data offset of the alternative Diagnosis Representation for this scale.
                      float DcmDspDiagnosisRepresentationDataResolution: 0..Inf, scope=ECU, set at pre-compile  # Data resolution of the alternative Diagnosis Representation for this scale.
                      float DcmDspDiagnosisRepresentationDataUpperRange: -Inf..Inf, set at pre-compile  # Upper Range for this scale of the data in the alternative Diagnosis Representation.
            container DcmRbDspRequestRoutineResultsIn [0..1]  # Provide description of input parameter of RequestResults subservice for RoutineControl service.
              container DcmRbDspRequestRoutineResultsInSignal [1..*]: requires-index=true  # Provide description of a routine signal used in RoutineControl service.
                enumeration DcmRbDspRoutineSignalEndianness [0..1]: {BIG_ENDIAN, LITTLE_ENDIAN, OPAQUE}, multiplicity set at link in variant link-time / pre-compile in variant post-build+pre-compile, set at link in variant link-time / pre-compile in variant post-build+pre-compile  # Defines the endianness of the data belonging to a Request Routine Response In Signal.If projects configures OPAQUE no endianness conversion will be supported/applicable | If no DcmDspRoutineSignalEndianness is defined the value of DcmDspDataDefaultEndianness is applicable.
                integer DcmRbDspRoutineSignalLength [0..1]: 0..65535, multiplicity set at link in variant link-time / pre-compile in variant post-build+pre-compile, origin=RB:AR42.1.0.0:2017-01-31, set at link in variant link-time / pre-compile in variant post-build+pre-compile  # Provide the length of the Routine signal in bits.If DcmDspRoutineRequestResINSignal is configured as VARIABLE_LENGTH, then Dcm shall update the currentDataLength parameter of the configured DcmAppl API (DcmDspRequestResultsRoutineFnc) in BYTES before calling the API .CurrentDataLength parameter signifies the actual length of the variable length signal positioned at the end in request.
                integer DcmRbDspRoutineSignalPos: 0..65535, origin=RB:AR42.1.0.0:2017-01-31, set at link in variant link-time / pre-compile in variant post-build+pre-compile  # Provide the position of the signal in the RoutineControl request/response.The position is defined in bits. | The position is defined in bits.
                enumeration DcmRbDspRoutineSignalType: {BOOLEAN, SINT16, SINT16_N, SINT32, SINT32_N, SINT8, SINT8_N, UINT16, UINT16_N, UINT32, UINT32_N, UINT8, UINT8_N, VARIABLE_LENGTH}, origin=RB:AR42.1.0.0:2017-01-31, set at link in variant link-time / pre-compile in variant post-build+pre-compile  # Provide the type of the signal in the RoutineControl request/response.
          container DcmDspStartRoutine [0..1]  # Provides the configuration of Start subservice for RoutineControl service.
            boolean DcmDspRoutineInterfaceArgumentIntegrity [0..1]: scope=ECU, multiplicity set at pre-compile, set at pre-compile, default-value=true  # Defines the value of ClientServerOperation.diagArgIntegrity for the created C/S interface of this routine
            boolean DcmDspStartRoutineConfirmationEnabled [0..0]: scope=ECU, multiplicity set at pre-compile, set at pre-compile, default-value=false  # Allows to enable/disable the confirmation function to indicate the transmission of a response to a StartRoutine request
            function name DcmDspStartRoutineConfirmationFnc [0..0]: scope=ECU, multiplicity set at pre-compile, set at pre-compile  # C-function to call if a transmission confirmation is needed by the issuer (BSW module)
            function name DcmDspStartRoutineFnc [0..1]: scope=ECU, multiplicity set at pre-compile, set at pre-compile  # Function name for request to application to start a routine. (Routine_Start-function) | This parameter is related to the interface Xxx_Start.
            integer DcmDspStartRoutineRole [0..1]: 0..4294967295, scope=ECU, multiplicity set at link in variant link-time / post-build in variant post-build / pre-compile in variant pre-compile, set at link in variant link-time / post-build in variant post-build / pre-compile in variant pre-compile  # Bitfield were each bit represents one dedicated role. A RoutineControl with sub-function startRoutine is granted access if the bit value is 1. If a bit value is 0, the routine is not allowed for that role. If this parameter is not configured and the Service 0x29 (Authentication) is configured, the DcmDspAuthenticationDeauthenticatedRole will be considered for the role verification check so that when role is not configured, the routine will be allowed to be executed in all the deauthenticated states.
            reference DcmDspStartRoutineCommonAuthorizationRef [0..1]: scope=ECU, multiplicity set at link in variant link-time / pre-compile in variant post-build+pre-compile, set at link in variant link-time / pre-compile in variant post-build+pre-compile, destination=DcmDspCommonAuthorization  # Reference to DcmDspCommonAuthorization | Common authorization configuration taken from the referenced DcmDspStartRoutineCommonAuthorizationRef. If there is no reference, no check on the commonly defined authorization conditions shall be done to start the routine.
            container DcmDspStartRoutineIn [0..1]  # Provide description of input parameter of Start subservice for RoutineControl service
              container DcmDspStartRoutineInSignal [1..*]: requires-index=true  # Provide description of a routine signal used in RoutineControl service. | The ordering defined via the index attribute of the subcontainers in this list represents the order of the dataInN elements in the XXX_Start function call.
                integer DcmDspRoutineParameterSize [0..0]: 0..65535, scope=ECU, multiplicity set at link in variant link-time / pre-compile in variant post-build+pre-compile, set at link in variant link-time / pre-compile in variant post-build+pre-compile  # Provide the size of a RoutineControl parameter in bytes
                enumeration DcmDspRoutineSignalEndianness [0..1]: {BIG_ENDIAN, LITTLE_ENDIAN, OPAQUE}, scope=ECU, multiplicity set at link in variant link-time / pre-compile in variant post-build+pre-compile, set at link in variant link-time / pre-compile in variant post-build+pre-compile  # Defines the endianness of the data belonging to a Routine In Signal for Start subfunction.
                integer DcmDspRoutineSignalLength [0..1]: 0..65535, scope=ECU, multiplicity set at link in variant link-time / pre-compile in variant post-build+pre-compile, set at link in variant link-time / pre-compile in variant post-build+pre-compile  # Provide the length in bits of the signal in the RoutineControl request/response
                integer DcmDspRoutineSignalPos: 0..65535, scope=ECU, set at link in variant link-time / pre-compile in variant post-build+pre-compile  # Provide the position of the signal in the RoutineControl request/response. | The position is defined in bits.
                enumeration DcmDspRoutineSignalType: {BOOLEAN, SINT16, SINT16_N, SINT32, SINT32_N, SINT8, SINT8_N, UINT16, UINT16_N, UINT32, UINT32_N, UINT8, UINT8_N, VARIABLE_LENGTH}, scope=ECU, set at link in variant link-time / pre-compile in variant post-build+pre-compile  # Provide the type of the signal in the RoutineControl request/response.
                choice container DcmDspArgumentScaling [0..1]  # This container contains the configuration (arguments) of an alternative Diagnosis Representation. Out if this the scaling between Diagnosis and ECU internal representation and vice versa can be calculated.
                  container DcmDspAlternativeArgumentData [0..0]  # This container contains the configuration (parameters) of an alternative Diagnosis Representation by the means of a ArgumentDataPrototype.
                    foreign reference DcmDataElement [0..0]: set at pre-compile, destination-type=ARGUMENT-DATA-PROTOTYPE  # Alternative Diagnosis Representation for the data defined by the means of a ArgumentDataPrototype. | The CompuMethod of the data type of the referenced ArgumentDataPrototype will be applied to the data type of the ArgumentDataPrototype in the interface used by the Dcm.
                  container DcmDspAlternativeDataType [0..1]  # This container contains the configuration (parameters) of an alternative Diagnosis Representation by the means of an ApplicationDataType. | Additionally the definition of a text table mapping can be a defined for ApplicationDataTypes with a CompuMethod of category TEXTTABLE and SCALE_LINEAR_AND_TEXTTABLE.
                    foreign reference DcmApplicationDataType: set at pre-compile, destination-type=APPLICATION-DATA-TYPE  # Alternative Diagnosis Representation for the data defined by the means of a ApplicationDataType of category VALUE, BOOLEAN or ARRAY. | The CompuMethod that applies to the referenced ApplicationDataType in case of category VALUE or BOOLEAN will be applied to the data type of the VariableDataPrototype in the interface used by the Dcm.
                    container DcmDspTextTableMapping [0..1]  # The purpose of the DcmDspTextTableMapping is to associate a texttable value defined in the context of the Dcm to a texttable value defined in the context of a CompuMethod referenced by a DataType that shall be taken to create a dataElement in a SenderReceiverInterface. By this means it is possible to create a primitive version of a TexttableMapping (which can only be applied if a dataElement already exists). | In other words, the DcmDspTextTableMapping provides a similar mechanism to the TexttableMapping in a situation where the TexttableMapping cannot be applied since the SenderReceiverInterface for the PortPrototype on the Dcm ServiceComponent does not yet exist.
                      integer DcmDspDiagnosisRepresentationDataValue: 0..18446744073709551615, scope=ECU, set at pre-compile  # The data value in the diagnosis representation.
                      integer DcmDspInternalDataValue: 0..18446744073709551615, scope=ECU, set at pre-compile  # The ECU internal data value.
                  container DcmDspAlternativeDiagnosticDataElement [0..0]  # This container contains the configuration (parameters) of an alternative Diagnosis Representation by the means of Diagnostic Extract.
                    foreign reference DcmDspDiagnosticDataElementRef [0..0]: set at pre-compile, destination-type=DIAGNOSTIC-DATA-ELEMENT  # Alternative Diagnosis Representation for the data defined by the means of a DiagnosticDataElement in the Diagnostic Extract. | This EcucForeignReference enables the access to all SwDataDefProps, in particular BaseType, CompuMethod and DataConstr The CompuMethod and DataConstr that applies to the referenced DiagnosticDataElement will be applied to the data type of the VariableDataPrototype in the interface used by the Dcm. The mapped ImplementationDataType needs to match the given BaseType.
                  container DcmDspAlternativeDataProps [0..1]  # This container contains the configuration (parameters) of an alternative Diagnosis Representation by the means of ECU configuration parameters.The physical unit of the alternative data representation is defined by the DataPrototype referenced by DcmDspExternalSRDataElementClass. Additionally the definition of a text table mapping can be a defined for DcmDspDataTypeCategory TEXTTABLE and SCALE_LINEAR_AND_TEXTTABLE | The physical unit of the alternative data representation is defined by the DataPrototype referenced by DcmDspExternalSRDataElementClass. Additionally the definition of a text table mapping can be a defined for DcmDspDataTypeCategory TEXTTABLE and SCALE_LINEAR_AND_TEXTTABLE
                    container DcmDspLinearScale  # This container contains the configuration (parameters) of an linear scale of the alternative Diagnosis Representation.
                      float DcmDspDiagnosisRepresentationDataLowerRange: -Inf..Inf, scope=ECU, set at pre-compile  # Lower Range for this scale of the data in the alternative Diagnosis Representation.
                      float DcmDspDiagnosisRepresentationDataOffset: 0..Inf, scope=ECU, set at pre-compile, default-value=0  # Data offset of the alternative Diagnosis Representation for this scale.
                      float DcmDspDiagnosisRepresentationDataResolution: 0..Inf, scope=ECU, set at pre-compile  # Data resolution of the alternative Diagnosis Representation for this scale.
                      float DcmDspDiagnosisRepresentationDataUpperRange: -Inf..Inf, scope=ECU, set at pre-compile  # Upper Range for this scale of the data in the alternative Diagnosis Representation.
            container DcmDspStartRoutineOut [0..1]  # Provide description of output parameter of Start subservice for RoutineControl service.
              container DcmDspStartRoutineOutSignal [1..*]: requires-index=true  # Provide description of a routine signal used in RoutineControl service. | The ordering defined via the index attribute of the subcontainers in this list represents the order of the dataOutN elements in the XXX_Start function call.
                integer DcmDspRoutineParameterSize [0..0]: 0..65535, scope=ECU, multiplicity set at link in variant link-time / pre-compile in variant post-build+pre-compile, set at link in variant link-time / pre-compile in variant post-build+pre-compile  # Provide the size of a RoutineControl parameter in bytes
                enumeration DcmDspRoutineSignalEndianness [0..1]: {BIG_ENDIAN, LITTLE_ENDIAN, OPAQUE}, scope=ECU, multiplicity set at link in variant link-time / pre-compile in variant post-build+pre-compile, set at link in variant link-time / pre-compile in variant post-build+pre-compile  # Defines the endianness of the data belonging to a Routine Out Signal for Start subfunction.
                integer DcmDspRoutineSignalLength [0..1]: 0..65535, scope=ECU, multiplicity set at link in variant link-time / pre-compile in variant post-build+pre-compile, set at link in variant link-time / pre-compile in variant post-build+pre-compile  # Provide the length in bits of the signal in the RoutineControl request/response.
                integer DcmDspRoutineSignalPos [0..1]: 0..65535, scope=ECU, multiplicity set at link in variant link-time / pre-compile in variant post-build+pre-compile, set at link in variant link-time / pre-compile in variant post-build+pre-compile  # Provide the position of the signal in the RoutineControl request/response. | The position is defined in bits.
                enumeration DcmDspRoutineSignalType: {BOOLEAN, SINT16, SINT16_N, SINT32, SINT32_N, SINT8, SINT8_N, UINT16, UINT16_N, UINT32, UINT32_N, UINT8, UINT8_N, VARIABLE_LENGTH}, scope=ECU, set at link in variant link-time / pre-compile in variant post-build+pre-compile  # Provide the type of the signal in the RoutineControl request/response.
                choice container DcmDspArgumentScaling [0..1]  # This container contains the configuration (arguments) of an alternative Diagnosis Representation. Out if this the scaling between Diagnosis and ECU internal representation and vice versa can be calculated.
                  container DcmDspAlternativeArgumentData [0..0]  # This container contains the configuration (parameters) of an alternative Diagnosis Representation by the means of a ArgumentDataPrototype.
                    foreign reference DcmDataElement [0..0]: set at pre-compile, destination-type=ARGUMENT-DATA-PROTOTYPE  # Alternative Diagnosis Representation for the data defined by the means of a ArgumentDataPrototype. | The CompuMethod of the data type of the referenced ArgumentDataPrototype will be applied to the data type of the ArgumentDataPrototype in the interface used by the Dcm.
                  container DcmDspAlternativeDataProps [0..1]  # This container contains the configuration (parameters) of an alternative Diagnosis Representation by the means of ECU configuration parameters.The physical unit of the alternative data representation is defined by the DataPrototype referenced by DcmDspExternalSRDataElementClass. Additionally the definition of a text table mapping can be a defined for DcmDspDataTypeCategory TEXTTABLE and SCALE_LINEAR_AND_TEXTTABLE | The physical unit of the alternative data representation is defined by the DataPrototype referenced by DcmDspExternalSRDataElementClass. Additionally the definition of a text table mapping can be a defined for DcmDspDataTypeCategory TEXTTABLE and SCALE_LINEAR_AND_TEXTTABLE
                    container DcmDspLinearScale  # This container contains the configuration (parameters) of an linear scale of the alternative Diagnosis Representation.
                      float DcmDspDiagnosisRepresentationDataLowerRange: -Inf..Inf, scope=ECU, set at pre-compile  # Lower Range for this scale of the data in the alternative Diagnosis Representation.
                      float DcmDspDiagnosisRepresentationDataOffset: 0..Inf, scope=ECU, set at pre-compile, default-value=0  # Data offset of the alternative Diagnosis Representation for this scale.
                      float DcmDspDiagnosisRepresentationDataResolution: 0..Inf, scope=ECU, set at pre-compile  # Data resolution of the alternative Diagnosis Representation for this scale.
                      float DcmDspDiagnosisRepresentationDataUpperRange: -Inf..Inf, scope=ECU, set at pre-compile  # Upper Range for this scale of the data in the alternative Diagnosis Representation.
                  container DcmDspAlternativeDataType [0..1]  # This container contains the configuration (parameters) of an alternative Diagnosis Representation by the means of an ApplicationDataType. | Additionally the definition of a text table mapping can be a defined for ApplicationDataTypes with a CompuMethod of category TEXTTABLE and SCALE_LINEAR_AND_TEXTTABLE.
                    foreign reference DcmApplicationDataType: set at pre-compile, destination-type=APPLICATION-DATA-TYPE  # Alternative Diagnosis Representation for the data defined by the means of a ApplicationDataType of category VALUE, BOOLEAN or ARRAY. | The CompuMethod that applies to the referenced ApplicationDataType in case of category VALUE or BOOLEAN will be applied to the data type of the VariableDataPrototype in the interface used by the Dcm.
                    container DcmDspTextTableMapping [0..*]  # The purpose of the DcmDspTextTableMapping is to associate a texttable value defined in the context of the Dcm to a texttable value defined in the context of a CompuMethod referenced by a DataType that shall be taken to create a dataElement in a SenderReceiverInterface. By this means it is possible to create a primitive version of a TexttableMapping (which can only be applied if a dataElement already exists). | In other words, the DcmDspTextTableMapping provides a similar mechanism to the TexttableMapping in a situation where the TexttableMapping cannot be applied since the SenderReceiverInterface for the PortPrototype on the Dcm ServiceComponent does not yet exist.
                      integer DcmDspDiagnosisRepresentationDataValue: 0..18446744073709551615, scope=ECU, set at pre-compile  # The data value in the diagnosis representation.
                      integer DcmDspInternalDataValue: 0..18446744073709551615, scope=ECU, set at pre-compile  # The ECU internal data value.
                  container DcmDspAlternativeDiagnosticDataElement [0..0]  # This container contains the configuration (parameters) of an alternative Diagnosis Representation by the means of Diagnostic Extract.
                    foreign reference DcmDspDiagnosticDataElementRef [0..0]: set at pre-compile, destination-type=DIAGNOSTIC-DATA-ELEMENT  # Alternative Diagnosis Representation for the data defined by the means of a DiagnosticDataElement in the Diagnostic Extract. | This EcucForeignReference enables the access to all SwDataDefProps, in particular BaseType, CompuMethod and DataConstr The CompuMethod and DataConstr that applies to the referenced DiagnosticDataElement will be applied to the data type of the VariableDataPrototype in the interface used by the Dcm. The mapped ImplementationDataType needs to match the given BaseType.
          container DcmDspStopRoutine [0..1]  # Provides the configuration of Stop subservice for RoutineControl service. | Existence indicates that the StopRoutine in the RoutineControl is supported.
            boolean DcmDspRoutineInterfaceArgumentIntegrity [0..1]: scope=ECU, multiplicity set at pre-compile, set at pre-compile, default-value=true  # Defines the value of ClientServerOperation.diagArgIntegrity for the created C/S interface of this routine
            boolean DcmDspStopRoutineConfirmationEnabled [0..0]: scope=ECU, multiplicity set at pre-compile, set at pre-compile, default-value=false  # Allows to enable/disable the confirmation function to indicate the transmission of a response to a StopRoutine request
            function name DcmDspStopRoutineConfirmationFnc [0..0]: scope=ECU, multiplicity set at pre-compile, set at pre-compile  # C-function to call if a transmission confirmation is needed by the issuer (BSW module)
            function name DcmDspStopRoutineFnc [0..1]: scope=ECU, multiplicity set at pre-compile, set at pre-compile  # Function name for request to application to stop a routine. (Routine_Stop-function) | This parameter is related to the interface Xxx_Stop.
            integer DcmDspStopRoutineRole [0..1]: 0..4294967295, scope=ECU, multiplicity set at link in variant link-time / post-build in variant post-build / pre-compile in variant pre-compile, set at link in variant link-time / post-build in variant post-build / pre-compile in variant pre-compile  # Bitfield were each bit represents one dedicated role. A RoutineControl with sub-function stopRoutine is granted access if the bit value is 1. If a bit value is 0, the routine is not allowed for that role. If this parameter is not configured and the Service 0x29 (Authentication) is configured, the DcmDspAuthenticationDeauthenticatedRole will be considered for the role verification check so that when role is not configured, the routine will be allowed to be executed in all the deauthenticated states.
            reference DcmDspStopRoutineCommonAuthorizationRef [0..1]: scope=ECU, multiplicity set at link in variant link-time / pre-compile in variant post-build+pre-compile, set at link in variant link-time / pre-compile in variant post-build+pre-compile, destination=DcmDspCommonAuthorization  # Reference to DcmDspCommonAuthorization | Common authorization configuration taken from the referenced DcmDspStopRoutineCommonAuthorizationRef. If there is no reference, no check on the commonly defined authorization conditions shall be done to stop the routine.
            container DcmDspStopRoutineIn [0..1]  # Provide description of input parameter of Stop subservice for RoutineControl service.
              container DcmDspStopRoutineInSignal [1..*]: requires-index=true  # Provide description of a routine signal used in RoutineControl service. | The ordering defined via the index attribute of the subcontainers in this list represents the order of the dataInN elements in the XXX_Stop function call.
                integer DcmDspRoutineParameterSize [0..0]: 0..65535, scope=ECU, multiplicity set at link in variant link-time / pre-compile in variant post-build+pre-compile, set at link in variant link-time / pre-compile in variant post-build+pre-compile  # Provide the size of a RoutineControl parameter in bytes
                enumeration DcmDspRoutineSignalEndianness [0..1]: {BIG_ENDIAN, LITTLE_ENDIAN, OPAQUE}, scope=ECU, multiplicity set at link in variant link-time / pre-compile in variant post-build+pre-compile, set at link in variant link-time / pre-compile in variant post-build+pre-compile  # Defines the endianness of the data belonging to a Routine In Signal for Stop subfunction.
                integer DcmDspRoutineSignalLength [0..1]: 0..65535, scope=ECU, multiplicity set at link in variant link-time / pre-compile in variant post-build+pre-compile, set at link in variant link-time / pre-compile in variant post-build+pre-compile  # Provide the length in bits of the signal in the RoutineControl request/response
                integer DcmDspRoutineSignalPos: 0..65535, scope=ECU, set at link in variant link-time / pre-compile in variant post-build+pre-compile  # Provide the position of the signal in the RoutineControl request/response. | The position is defined in bits.
                enumeration DcmDspRoutineSignalType: {BOOLEAN, SINT16, SINT16_N, SINT32, SINT32_N, SINT8, SINT8_N, UINT16, UINT16_N, UINT32, UINT32_N, UINT8, UINT8_N, VARIABLE_LENGTH}, scope=ECU, set at link in variant link-time / pre-compile in variant post-build+pre-compile  # Provide the type of the signal in the RoutineControl request/response.
                choice container DcmDspArgumentScaling [0..1]  # This container contains the configuration (arguments) of an alternative Diagnosis Representation. Out if this the scaling between Diagnosis and ECU internal representation and vice versa can be calculated.
                  container DcmDspAlternativeArgumentData [0..0]  # This container contains the configuration (parameters) of an alternative Diagnosis Representation by the means of a ArgumentDataPrototype.
                    foreign reference DcmDataElement [0..0]: set at pre-compile, destination-type=ARGUMENT-DATA-PROTOTYPE  # Alternative Diagnosis Representation for the data defined by the means of a ArgumentDataPrototype. | The CompuMethod of the data type of the referenced ArgumentDataPrototype will be applied to the data type of the ArgumentDataPrototype in the interface used by the Dcm.
                  container DcmDspAlternativeDataType [0..1]  # This container contains the configuration (parameters) of an alternative Diagnosis Representation by the means of an ApplicationDataType. | Additionally the definition of a text table mapping can be a defined for ApplicationDataTypes with a CompuMethod of category TEXTTABLE and SCALE_LINEAR_AND_TEXTTABLE.
                    foreign reference DcmApplicationDataType: set at pre-compile, destination-type=APPLICATION-DATA-TYPE  # Alternative Diagnosis Representation for the data defined by the means of a ApplicationDataType of category VALUE, BOOLEAN or ARRAY. | The CompuMethod that applies to the referenced ApplicationDataType in case of category VALUE or BOOLEAN will be applied to the data type of the VariableDataPrototype in the interface used by the Dcm.
                    container DcmDspTextTableMapping [0..*]  # The purpose of the DcmDspTextTableMapping is to associate a texttable value defined in the context of the Dcm to a texttable value defined in the context of a CompuMethod referenced by a DataType that shall be taken to create a dataElement in a SenderReceiverInterface. By this means it is possible to create a primitive version of a TexttableMapping (which can only be applied if a dataElement already exists). | In other words, the DcmDspTextTableMapping provides a similar mechanism to the TexttableMapping in a situation where the TexttableMapping cannot be applied since the SenderReceiverInterface for the PortPrototype on the Dcm ServiceComponent does not yet exist.
                      integer DcmDspDiagnosisRepresentationDataValue: 0..18446744073709551615, scope=ECU, set at pre-compile  # The data value in the diagnosis representation.
                      integer DcmDspInternalDataValue: 0..18446744073709551615, scope=ECU, set at pre-compile  # The ECU internal data value.
                  container DcmDspAlternativeDataProps [0..1]  # This container contains the configuration (parameters) of an alternative Diagnosis Representation by the means of ECU configuration parameters.The physical unit of the alternative data representation is defined by the DataPrototype referenced by DcmDspExternalSRDataElementClass. Additionally the definition of a text table mapping can be a defined for DcmDspDataTypeCategory TEXTTABLE and SCALE_LINEAR_AND_TEXTTABLE | The physical unit of the alternative data representation is defined by the DataPrototype referenced by DcmDspExternalSRDataElementClass. Additionally the definition of a text table mapping can be a defined for DcmDspDataTypeCategory TEXTTABLE and SCALE_LINEAR_AND_TEXTTABLE
                    container DcmDspLinearScale  # This container contains the configuration (parameters) of an linear scale of the alternative Diagnosis Representation.
                      float DcmDspDiagnosisRepresentationDataLowerRange: -Inf..Inf, scope=ECU, set at pre-compile  # Lower Range for this scale of the data in the alternative Diagnosis Representation.
                      float DcmDspDiagnosisRepresentationDataOffset: 0..Inf, scope=ECU, set at pre-compile, default-value=0  # Data offset of the alternative Diagnosis Representation for this scale.
                      float DcmDspDiagnosisRepresentationDataResolution: 0..Inf, scope=ECU, set at pre-compile  # Data resolution of the alternative Diagnosis Representation for this scale.
                      float DcmDspDiagnosisRepresentationDataUpperRange: -Inf..Inf, set at pre-compile  # Upper Range for this scale of the data in the alternative Diagnosis Representation.
                  container DcmDspAlternativeDiagnosticDataElement [0..0]  # This container contains the configuration (parameters) of an alternative Diagnosis Representation by the means of Diagnostic Extract.
                    foreign reference DcmDspDiagnosticDataElementRef [0..0]: set at pre-compile, destination-type=DIAGNOSTIC-DATA-ELEMENT  # Alternative Diagnosis Representation for the data defined by the means of a DiagnosticDataElement in the Diagnostic Extract. | This EcucForeignReference enables the access to all SwDataDefProps, in particular BaseType, CompuMethod and DataConstr The CompuMethod and DataConstr that applies to the referenced DiagnosticDataElement will be applied to the data type of the VariableDataPrototype in the interface used by the Dcm. The mapped ImplementationDataType needs to match the given BaseType.
            container DcmDspStopRoutineOut [0..1]  # Provide description of output parameter of Stop subservice for RoutineControl service.
              container DcmDspStopRoutineOutSignal [1..*]: requires-index=true  # Provide description of a routine signal used in RoutineControl service. | The ordering defined via the index attribute of the subcontainers in this list represents the order of the dataOutN elements in the XXX_Stop function call.
                integer DcmDspRoutineParameterSize [0..0]: 0..65535, scope=ECU, multiplicity set at link in variant link-time / pre-compile in variant post-build+pre-compile, set at link in variant link-time / pre-compile in variant post-build+pre-compile  # Provide the size of a RoutineControl parameter in bytes
                enumeration DcmDspRoutineSignalEndianness [0..1]: {BIG_ENDIAN, LITTLE_ENDIAN, OPAQUE}, scope=ECU, multiplicity set at link in variant link-time / pre-compile in variant post-build+pre-compile, set at link in variant link-time / pre-compile in variant post-build+pre-compile  # Defines the endianness of the data belonging to a Routine Out Signal for Stop subfunction.
                integer DcmDspRoutineSignalLength [0..1]: 0..65535, scope=ECU, multiplicity set at link in variant link-time / pre-compile in variant post-build+pre-compile, set at link in variant link-time / pre-compile in variant post-build+pre-compile  # Provide the length in bits of the signal in the RoutineControl request/response
                integer DcmDspRoutineSignalPos: 0..65535, scope=ECU, set at link in variant link-time / pre-compile in variant post-build+pre-compile  # Provide the position of the signal in the RoutineControl request/response. | The position is defined in bits.
                enumeration DcmDspRoutineSignalType: {BOOLEAN, SINT16, SINT16_N, SINT32, SINT32_N, SINT8, SINT8_N, UINT16, UINT16_N, UINT32, UINT32_N, UINT8, UINT8_N, VARIABLE_LENGTH}, scope=ECU, set at link in variant link-time / pre-compile in variant post-build+pre-compile  # Provide the type of the signal in the RoutineControl request/response.
                choice container DcmDspArgumentScaling [0..1]  # This container contains the configuration (arguments) of an alternative Diagnosis Representation. Out if this the scaling between Diagnosis and ECU internal representation and vice versa can be calculated.
                  container DcmDspAlternativeArgumentData [0..0]  # This container contains the configuration (parameters) of an alternative Diagnosis Representation by the means of a ArgumentDataPrototype.
                    foreign reference DcmDataElement [0..0]: set at pre-compile, destination-type=ARGUMENT-DATA-PROTOTYPE  # Alternative Diagnosis Representation for the data defined by the means of a ArgumentDataPrototype. | The CompuMethod of the data type of the referenced ArgumentDataPrototype will be applied to the data type of the ArgumentDataPrototype in the interface used by the Dcm.
                  container DcmDspAlternativeDataType [0..1]  # This container contains the configuration (parameters) of an alternative Diagnosis Representation by the means of an ApplicationDataType. | Additionally the definition of a text table mapping can be a defined for ApplicationDataTypes with a CompuMethod of category TEXTTABLE and SCALE_LINEAR_AND_TEXTTABLE.
                    foreign reference DcmApplicationDataType: set at pre-compile, destination-type=APPLICATION-DATA-TYPE  # Alternative Diagnosis Representation for the data defined by the means of a ApplicationDataType of category VALUE, BOOLEAN or ARRAY. | The CompuMethod that applies to the referenced ApplicationDataType in case of category VALUE or BOOLEAN will be applied to the data type of the VariableDataPrototype in the interface used by the Dcm.
                    container DcmDspTextTableMapping [0..*]  # The purpose of the DcmDspTextTableMapping is to associate a texttable value defined in the context of the Dcm to a texttable value defined in the context of a CompuMethod referenced by a DataType that shall be taken to create a dataElement in a SenderReceiverInterface. By this means it is possible to create a primitive version of a TexttableMapping (which can only be applied if a dataElement already exists). | In other words, the DcmDspTextTableMapping provides a similar mechanism to the TexttableMapping in a situation where the TexttableMapping cannot be applied since the SenderReceiverInterface for the PortPrototype on the Dcm ServiceComponent does not yet exist.
                      integer DcmDspDiagnosisRepresentationDataValue: 0..18446744073709551615, scope=ECU, set at pre-compile  # The data value in the diagnosis representation.
                      integer DcmDspInternalDataValue: 0..18446744073709551615, scope=ECU, set at pre-compile  # The ECU internal data value.
                  container DcmDspAlternativeDiagnosticDataElement [0..0]  # This container contains the configuration (parameters) of an alternative Diagnosis Representation by the means of Diagnostic Extract.
                    foreign reference DcmDspDiagnosticDataElementRef [0..0]: set at pre-compile, destination-type=DIAGNOSTIC-DATA-ELEMENT  # Alternative Diagnosis Representation for the data defined by the means of a DiagnosticDataElement in the Diagnostic Extract. | This EcucForeignReference enables the access to all SwDataDefProps, in particular BaseType, CompuMethod and DataConstr The CompuMethod and DataConstr that applies to the referenced DiagnosticDataElement will be applied to the data type of the VariableDataPrototype in the interface used by the Dcm. The mapped ImplementationDataType needs to match the given BaseType.
                  container DcmDspAlternativeDataProps [0..1]  # This container contains the configuration (parameters) of an alternative Diagnosis Representation by the means of ECU configuration parameters.The physical unit of the alternative data representation is defined by the DataPrototype referenced by DcmDspExternalSRDataElementClass. Additionally the definition of a text table mapping can be a defined for DcmDspDataTypeCategory TEXTTABLE and SCALE_LINEAR_AND_TEXTTABLE | The physical unit of the alternative data representation is defined by the DataPrototype referenced by DcmDspExternalSRDataElementClass. Additionally the definition of a text table mapping can be a defined for DcmDspDataTypeCategory TEXTTABLE and SCALE_LINEAR_AND_TEXTTABLE
                    container DcmDspLinearScale  # This container contains the configuration (parameters) of an linear scale of the alternative Diagnosis Representation.
                      float DcmDspDiagnosisRepresentationDataLowerRange: -Inf..Inf, scope=ECU, set at pre-compile  # Lower Range for this scale of the data in the alternative Diagnosis Representation.
                      float DcmDspDiagnosisRepresentationDataOffset: 0..Inf, scope=ECU, set at pre-compile, default-value=0  # Data offset of the alternative Diagnosis Representation for this scale.
                      float DcmDspDiagnosisRepresentationDataResolution: 0..Inf, scope=ECU, set at pre-compile  # Data resolution of the alternative Diagnosis Representation for this scale.
                      float DcmDspDiagnosisRepresentationDataUpperRange: -Inf..Inf, scope=ECU, set at pre-compile  # Upper Range for this scale of the data in the alternative Diagnosis Representation.
        container DcmDspSecurity  # This container contains the configuration ( DSP parameter) for security level configuration (per security level) | Description This container contains Rows of DcmDspSecurityRow
          float DcmDspSecurityMaxAttemptCounterReadoutTime [0..1]: 0..65535, set at link in variant link-time / pre-compile in variant post-build+pre-compile  # Delay, in seconds, from startup (measured from the first call of the Dcm_MainFunction()), allowed for all AttemptCounter values to be obtained from the Application. | Must be a multiple of the DcmTaskTime. min: A value equal to the DcmTaskTime
          enumeration DcmRbDspSecurityDelayTimerMonitor [0..1]: {REQUEST_SEED, SEND_KEY}, multiplicity set at link in variant link-time+post-build / pre-compile in variant pre-compile, origin=RB:AR42.1.0.0:2017-01-31, set at link in variant link-time+post-build / pre-compile in variant pre-compile, default-value=REQUEST_SEED  # According to ISO-14229-1 (2006-12-01) Security Access service shall return a NRC requiredTimeDelayNotExpired when requested action will not be taken because theclient?s latest attempt to gain security access was initiated before the server?s required timeout period had been elapsed. This provides an option to OEMs to either decide to send this NRC for either a REQUEST SEED sub-function or SEND KEY sub-function. It is possible to choose here for which of the two it is required to monitor the delay time and send this NRC with this vendor specific attribute.
          enumeration DcmRbDspSecurityNRCExceedNoOfAttempt [0..1]: {NumAttDelayAndNumAttLock, NumAttLock}, multiplicity set at link in variant link-time+post-build / pre-compile in variant pre-compile, origin=RB:AR42.1.0.0:2017-01-31, set at link in variant link-time+post-build / pre-compile in variant pre-compile, default-value=NumAttDelayAndNumAttLock  # This parameter is to choose NRC return value in case of Exceeded Number Invalid Unlock Attempts. Literal "NumAttDelayAndNumAttLock" is in accordance to ISO 14229-1; For every invalid key sent, NRC 35 (INVALID_KEY) is returned till configured no of attempts (NumAttDelay) is reached. When Failed Attempts reaches or exceeds configured value (>= NummAttDelay) NRC 36 (EXCEEDED NUMBER OF ATTEMPTS) is returned. Or In case the failed attempts reaches or exceeds no of attempts to Lock (NumAttLock) ,NRC 36 will be returned. The Literal "NumAttLock" specifys that only on reaching or exceeding Number of attempts for Lock (NumAttLock) ,NRC 36 will be sent. Untill then NRC 35 is returned on invalid attempt.
          boolean DcmRbDspSecurityStoreSeed: origin=RB:AR42.1.0.0:2017-01-31, set at link in variant link-time+post-build / pre-compile in variant pre-compile  # DcmDspSecurity - DcmDspSecurityStoreSeed = TRUE, print DCM_CFG_ON
          container DcmDspSecurityRow [0..31]  # Definition of a single Row of configuration for security level configuration (per security level) | The name of this container is used to define the name of the R-Port through which the DCM accesses the interface SecurityAccess_{SecurityLevel}. The R-Port is named SecurityAccess_{SecurityLevel} where {SecurityLevel} is the name of the container DcmDspSecurityRow. If there is no reference, no check of security level shall be done.
            integer DcmDspSecurityADRSize [0..1]: 1..4294967285, multiplicity set at link in variant link-time / pre-compile in variant post-build+pre-compile, set at link in variant link-time / pre-compile in variant post-build+pre-compile  # Size in bytes of the AccessDataRecord used in GetSeed
            boolean DcmDspSecurityAttemptCounterEnabled: scope=ECU, set at link in variant link-time / pre-compile in variant post-build+pre-compile  # This configuration parameter controls the existence of the APIs to set / get the attempt counter values towards application (Xxx_SetSecurityAttemptCounter() / Xxx_GetSecurityAttemptCounter()). | In case of enabled, the security attempt counter values are passed to application, whenever there is a change in the value. This allows storing the values in nonvolatile RAM and restoring them at ECU startup.
            function name DcmDspSecurityCompareKeyFnc [0..1]: multiplicity set at link in variant link-time / pre-compile in variant post-build+pre-compile, set at link in variant link-time / pre-compile in variant post-build+pre-compile  # Function name to request the result of a key comparison. | Parameter is only relevant if DcmDspSecurityUsePort=="USE_ ASYNCH_FNC". This parameter is related to the interface Xxx_CompareKey.
            float DcmDspSecurityDelayTime: 0..65535, set at link in variant link-time / pre-compile in variant post-build+pre-compile  # Delay time after failed security access in seconds. | This is started after DcmDspSecurityNumAttDelay number of failed security accesses. min: A negative value is not allowed.
            float DcmDspSecurityDelayTimeOnBoot: 0..65535, set at link in variant link-time / pre-compile in variant post-build+pre-compile  # Value of the delay timer in case of 'power on' in seconds. | This delay indicates the time at ECU boot power-on time during which the Dcm does not accept a security access. min: A negative value is not allowed.
            function name DcmDspSecurityGetAttemptCounterFnc [0..1]: multiplicity set at link in variant link-time / pre-compile in variant post-build+pre-compile, set at link in variant link-time / pre-compile in variant post-build+pre-compile  # Function name to request the value of an attempt counter. | This parameter is related to the interface Xxx_ GetSecurityAttemptCounter.
            function name DcmDspSecurityGetSeedFnc [0..1]: multiplicity set at link in variant link-time / pre-compile in variant post-build+pre-compile, set at link in variant link-time / pre-compile in variant post-build+pre-compile  # Callout function name used to request a seed. | This parameter is related to the interface Xxx_GetSeed.
            integer DcmDspSecurityKeySize: 1..4294967285, set at link in variant link-time / pre-compile in variant post-build+pre-compile  # size of the security key (in Bytes).
            integer DcmDspSecurityLevel: 1..63, set at pre-compile, symbolic-name-value=true  # Value of Security level. | The locked state cannot be configured explicitly. 1,2,3...63: configuration dependent - Conversion formula to calculate SecurityLevel out of tester requested SecurityAccessType parameter: SecurityLevel = (SecurityAccessType (requestSeed) + 1) / 2 Type: Dcm_SecLevelType
            integer DcmDspSecurityNumAttDelay: 1..255, set at link in variant link-time / pre-compile in variant post-build+pre-compile  # Number of failed security accesses after which the delay time is activated
            integer DcmDspSecuritySeedSize: 1..4294967285, set at link in variant link-time / pre-compile in variant post-build+pre-compile  # size of the security seed (in Bytes).
            function name DcmDspSecuritySetAttemptCounterFnc [0..1]: multiplicity set at link in variant link-time / pre-compile in variant post-build+pre-compile, set at link in variant link-time / pre-compile in variant post-build+pre-compile  # Function name to set the value of an attempt counter. | This parameter is related to the interface Xxx_ SetSecurityAttemptCounter.
            enumeration DcmDspSecurityUsePort: {USE_ASYNCH_CLIENT_SERVER, USE_ASYNCH_FNC}, set at pre-compile  # Defines which kind of interface shall be used for security access.
            integer DcmRbDspSecurityNumAttLock: 0..255, origin=RB:AR42.1.0.0:2017-01-31, set at pre-compile  # Number of failed security accesses after which security access is locked. 0 indicates that the security access will be left untouched and the ECU never locks.
            boolean DcmRbDspSecurityRowUseAsynchronousServerCallPoint [0..1]: multiplicity set at link in variant link-time+post-build / pre-compile in variant pre-compile, origin=RB:AR42.1.0.0:2017-01-31, set at link in variant link-time+post-build / pre-compile in variant pre-compile, default-value=false  # Only relevant in case DcmDspSecurityUsePort is set to USE_DATA_ASYNCH_CLIENT_SERVER.This parameter is used to select the type of Server Handling required.Set the value to TRUE for Asynchronous server call point handling else Synchronous server call point handling is carried out
            boolean DcmRbDspSecurityRowUseFlexibleLength [0..1]: origin=RB:AR42.8.0.0:2020-07-24, set at link in variant link-time+post-build / pre-compile in variant pre-compile, default-value=false  # Parameter to enable/ disable use of flexible Seed Length and Key Length for all security levels If configured as TRUE, flexible length is used for Seed and Key handling
        container DcmDspSession  # Parent container holding single rows to configure particular sessions
          boolean DcmRbDspSessionParamRecordEnabled [0..1]: multiplicity set at link in variant link-time+post-build / pre-compile in variant pre-compile, origin=RB:AR42.1.0.0:2017-01-31, set at link in variant link-time+post-build / pre-compile in variant pre-compile, default-value=true  # If DcmDspSessionParamRecordEnabled = true, then the session parameter record will be part of session control service positive response. If DcmDspSessionParamRecordEnabled = false, then the session parameter record will not be part of session control service positive response. Session parameter record conatins the P2 Can Server and P2* Can Server times according to ISO15765-3 CAN requirements
          reference DcmRbDspKWPDefaultSesRef [0..1]: multiplicity set at link in variant link-time+post-build / pre-compile in variant pre-compile, origin=RB:AR42.1.0.0:2017-01-31, set at link in variant link-time+post-build / pre-compile in variant pre-compile, destination=DcmDspSessionRow  # The DcmDspKWPDefaultSesRef is a reference container to DcmDspSessionRow. If the KWP protocol is using the Dcm Dsp session and security configurations (i.e. DcmDspSesSecUsedInProtocol is configured to KWP) then configure a Default Session for KWP protocol
          container DcmDspSessionRow [0..31]  # This container holds all parameters needed to configure a single session
            enumeration DcmDspSessionForBoot: {DCM_NO_BOOT, DCM_OEM_BOOT, DCM_SYS_BOOT}, set at link in variant link-time / pre-compile in variant post-build+pre-compile  # This parameter defines whether this diagnostic session allows to jump to Bootloader (OEM Bootloader or System Supplier Bootloader) and determines, from which unit the final response will be sent. | If this diagnostic session doesn't allow to jump to Bootloader the value DCM_NO_BOOT shall be chosen.
            integer DcmDspSessionLevel: 1..126, set at pre-compile, symbolic-name-value=true  # subFunction value of the DiagnosticSession. | 0, 127 and all values above 127 are reserved by ISO
            float DcmDspSessionP2ServerMax: 0..1, set at link in variant link-time / pre-compile in variant post-build+pre-compile  # This is the session value for P2ServerMax in seconds (per Session). | The AUTOSAR configuration standard is to use SI units, so this parameter is defined as a float value in seconds. DCM configuration tools must convert this float value to the appropriate value format for the use in the software implementation of DCM. This value is reported to the tester within the response to the 'Session Control' service.
            float DcmDspSessionP2StarServerMax: 0..100, set at link in variant link-time / pre-compile in variant post-build+pre-compile  # This is the session value for P2*ServerMax in seconds (per Session). | The AUTOSAR configuration standard is to use SI units, so this parameter is defined as a float value in seconds. DCM configuration tools must convert this float value to the appropriate value format for the use in the software implementation of DCM. This value is reported to the tester within the response to the 'Session Control' service.
        container DcmDspVehInfo [0..*]  # This container contains the configuration (parameters) for one single VehicleInfoType of service $09
          integer DcmDspVehInfoInfoType: 0..255, scope=ECU, set at link in variant link-time / pre-compile in variant post-build+pre-compile  # value of InfoType. | Within each DcmConfigSet all DcmDspVehInfoInfoType values shall be unique.
          boolean DcmDspVehInfoNODIProvResp [0..1]: set at pre-compile, default-value=false  # Indicate the Dcm, which side is responsible to fill the number of data items (NODI), Dcm or the provider of the InfoType data. In case the responsibility is on provider side, only one DcmDspVehInfoData container is allowed. | * true: Provider is responsible for providing the number of data items parameter * false or not existing: Dcm is responsible for providing the number of data items parameter
          function name DcmRbDspVehInfoSupportFnc [0..1]: scope=ECU, multiplicity set at pre-compile, set at pre-compile  # Function name to trigger the application to check if the requested infotype is supported or not.User can leave the field empty, if the check is not required for this Infotype.
          container DcmDspVehInfoData [1..*]  # Data Item of an InfoType; ShortName is post-fix of the port interface name.
            integer DcmDspVehInfoDataOrder: 0..255, scope=ECU, set at pre-compile  # Defines the order of the data item in the InfoType; values: 0..255; first data item having the order number 0; the next 1 and so on. | The configuration of order needs to be unique per InfoType.
            function name DcmDspVehInfoDataReadFnc [0..1]: scope=ECU, multiplicity set at pre-compile, set at pre-compile  # Callout function name for reading InfoType data item. Only required in case parameter 'DcmDspVehInfoDataUsePort' is set to 'false'
            integer DcmDspVehInfoDataSize: 0..255, scope=ECU, set at pre-compile  # Size in bytes of the InfoType data item.
            boolean DcmDspVehInfoDataUsePort: scope=ECU, set at pre-compile  # When this parameter is set to true the DCM will access the Data using an R-Port requiring a PortInterface IInfotypeServices_{VehInfoData}. | The R-Port is named InfotypeServices_{VehInfoData} where {VEHINFODATA} is the name of the container DcmDspVehInfoData. In that case, the DcmDspVehInfoDataReadFnc is ignored and the RTE APIs are used. When this parameter is set to false, the DCM calls the function defined in DcmDspVehInfoDataReadFnc.
        container DcmRbDspEcuResetRow [0..*]  # Container to define the resetTypes and the type of reset(jump to bootloader or normal reset ) for each subfunction of EcuReset Service. ResetTypes supported by the ECU but not configured under this container will be considered for normal reset.
          integer DcmRbDspEcuResetType: 0..127, origin=RB:AR42.1.0.0:2017-01-31, set at link in variant link-time / pre-compile in variant post-build+pre-compile, symbolic-name-value=true  # Value of the Ecu Reset Type (subfunction of EcuReset Service)
          enumeration DcmRbDspResetForBoot: {DCM_NO_BOOT, DCM_OEM_BOOT, DCM_SYS_BOOT, DCM_DRIVE_TO_DRIVE}, origin=RB:AR42.1.0.0:2017-01-31, set at link in variant link-time / pre-compile in variant post-build+pre-compile  # This parameter defines whether this resetType allows to jump to Bootloader (OEM Bootloader/ System Supplier Bootloader/ Drive to Drive Jump). If the resetType is not allowed to jump to Boot/Drive, i.e., used for normal reset, the value DCM_NO_BOOT shall be chosen.ResetTypes supported by the ECU but not configured under the container DcmDspEcuResetRow will be considered as DCM_NO_BOOT ( normal reset)
        container DcmRbDspReadDTC [0..1]  # This container contains the configuration (parameters) of the service Read DTC Information - 0x19 (per sub-function type) This container contains Rows of DcmDspReadDTCRow
          integer DcmRbDspReadDTCMaxNumDTCRead: 1..255, origin=RB:AR42.1.0.0:2017-01-31, set at link in variant link-time+post-build / pre-compile in variant pre-compile  # Maximum number of DTC that can be read in 1 service call
          integer DcmRbDspReadDTCMaxNumRecordRead: 1..255, origin=RB:AR42.1.0.0:2017-01-31, set at link in variant link-time+post-build / pre-compile in variant pre-compile  # Max Number of Records that can be read in 1 service call
        container DcmRbDspRoutineRange [0..*]  # This container defines the Routine Ranges
          boolean DcmRbDspRoutineRangeHasGaps: scope=ECU, origin=RB:AR42.5.0.0:2019-01-31, set at link in variant link-time / pre-compile in variant post-build+pre-compile  # Parameter specifying if there are gaps in the Routine range (parameter set to TRUE) or not (parameter set to FALSE)
          integer DcmRbDspRoutineRangeIdentifierLowerLimit: 0..65535, scope=ECU, origin=RB:AR42.5.0.0:2019-01-31, set at link in variant link-time / pre-compile in variant post-build+pre-compile  # Lower limit of Routine range.
          integer DcmRbDspRoutineRangeIdentifierUpperLimit: 0..65535, scope=ECU, origin=RB:AR42.5.0.0:2019-01-31, set at link in variant link-time / pre-compile in variant post-build+pre-compile  # Upper limit of Routine range.
          function name DcmRbDspRoutineRangeIsRidAvailableFnc [0..1]: scope=ECU, multiplicity set at pre-compile, origin=RB:AR42.5.0.0:2019-01-31, set at pre-compile  # Function name to request from application if a specific Routine is available within the range or not. | Only relevant if DcmRbDspRoutineRangeUsePort is set to false. This parameter is related to the interface Xxx_IsRidAvailable.
          boolean DcmRbDspRoutineRangeReqSequenceErrorEnabled [0..1]: multiplicity set at pre-compile, origin=RB:AR42.5.0.0:2019-01-31, set at pre-compile, default-value=true  # Indicates Request Sequence Error (NRC 0x24) shall be triggered for a RequestResults/Stop subfunction with/without a prior Start subfunction request for Routines which supports both RequestResults and Start subfunctions/ Stop and Start Subfunctions. | True:For a Routine which supports both RequestResults/Stop and Start Subfunction,NRC 0x24 shall be triggered if Routine Control tester request with RequestResults subfunction(0x03/Stop subfunction(0x02) comes for a Routine which is not started (without a prior Routine Control request with Start subfunction(0x01)) False:For a Routine which supports both RequestResults/Stop and Start Subfunction,positive response shall be triggered if Routine Control tester request with RequestResults subfunction(0x03)/Stop subfunction(0x02) comes without a prior Routine Control request with Start subfunction(0x01)
          boolean DcmRbDspRoutineRangeStopRoutineOnSessionChange [0..1]: multiplicity set at pre-compile, origin=RB:AR42.5.0.0:2019-01-31, set at pre-compile, default-value=false  # Indicates if the StopRoutine operation needs to be performed on any session change. True = Stop this Routine if it is active on transition to default session / Stop this routine if it is not supported in the new nondefault session. False = No action on session transitions Dependency: Applicable only if StopRoutine operation is supported for RID (DcmDspStopRoutineSupported = true), otherwise not valid.If the parameter is left unconfigured FALSE will be considered as the default value. | true = stopRoutine is supported on session change false = stopRoutine is not supported on session change
          boolean DcmRbDspRoutineRangeUseAsynchronousServerCallPoint [0..1]: multiplicity set at link in variant link-time+post-build / pre-compile in variant pre-compile, origin=RB:AR42.5.0.0:2019-01-31, set at link in variant link-time+post-build / pre-compile in variant pre-compile, default-value=false  # Only relevant in case DcmRbDspRoutineRangeUsePort is set to TRUE. This parameter is used to select the type of Server Handling required. Set the value to TRUE for Asynchronous server call point handling else Synchronous server call point handling is carried out
          boolean DcmRbDspRoutineRangeUsePort: scope=ECU, origin=RB:AR42.5.0.0:2019-01-31, set at pre-compile  # If this parameter is set to true, the DCM uses an R-Port requiring a PortInteface RoutineRange_{RangeRoutineName} where {RangeRoutineName} is the name of the container DcmDspRoutineRange. In that case, DcmRbDspRoutineRangeIsRidAvailableFnc, DcmRbDspRoutineRangeStartRoutineFnc, DcmRbDspRoutineRangeStopRoutineFnc and DcmRbDspRoutineRangeRequestRoutineResultsFnc will be ignored and the RTE APIs are used. When the parameter DcmRbDspRoutineRangeUsePort is false, the DCM calls the functions defined in DcmRbDspRoutineRangeIsRidAvailableFnc, DcmRbDspRoutineRangeStartRoutineFnc, DcmRbDspRoutineRangeStopRoutineFnc and DcmRbDspRoutineRangeRequestRoutineResultsFnc.
          function name DcmRbDspRoutineRangeUserRoutineModeRuleFnc [0..1]: multiplicity set at pre-compile, origin=RB:AR42.5.0.0:2019-01-31, set at pre-compile  # Function name used by the application to perform user specific checks before accessing a Routine. | In case the checks fails, NRC value set by the application can be returned to the tester. In case the function is not configured for the Routine, the DcmAppl API DcmAppl_UserRIDModeRuleService shall be called.
          integer DcmRbDspRoutineRangeInfoByte [0..1]: 0..255, scope=ECU, origin=RB:AR45.4.0.0:2023-02-13, set at link in variant link-time / pre-compile in variant post-build+pre-compile  # Manufacturer specific value reported to the tester for the all record identifiers. For OBD RIDS routine info byte value is always 0 as per J1979-2. For other RIDS routine info byte value shall be same as configured value
          container DcmRbDspRoutineRangeRequestRoutineResults [0..1]  # Provides the configuration of RequestResult subservice for a Range of Routines for RoutineControl service. | Existence indicates that the RequestRoutineResults in the Range Routines in RoutineControl is supported.
            boolean DcmRbDspRoutineRangeInterfaceArgumentIntegrity [0..1]: scope=ECU, multiplicity set at pre-compile, set at pre-compile, default-value=true  # Defines the value of ClientServerOperation.diagArgIntegrity for the created C/S interface of this routine
            function name DcmRbDspRoutineRangeRequestRoutineResultsFnc [0..1]: scope=ECU, multiplicity set at pre-compile, origin=RB:AR42.5.0.0:2019-01-31, set at pre-compile  # Function name for request to application the results of a routine in a Range. (RoutineRange_RequestResults-function) | This parameter is related to the interface Xxx_RequestResults.
            integer DcmRbDspRoutineRangeRequestRoutineResultsRole [0..1]: 0..4294967295, scope=ECU, multiplicity set at link in variant link-time / post-build in variant post-build / pre-compile in variant pre-compile, set at link in variant link-time / post-build in variant post-build / pre-compile in variant pre-compile  # Bitfield were each bit represents one dedicated role. A RoutineControl with sub-function requestResults is granted access if the bit value is 1. If a bit value is 0, the routine is not allowed for that role. If this parameter is not configured and the Service 0x29 (Authentication) is configured, the DcmDspAuthenticationDeauthenticatedRole will be considered for the role verification check so that when role is not configured, the routine will be allowed to be executed in all the deauthenticated states.
            reference DcmRbDspRoutineRangeRequestRoutineResultsCommonAuthorizationRef [0..1]: scope=ECU, multiplicity set at link in variant link-time / pre-compile in variant post-build+pre-compile, origin=RB:AR42.5.0.0:2019-01-31, set at link in variant link-time / pre-compile in variant post-build+pre-compile, destination=DcmDspCommonAuthorization  # Reference to DcmDspCommonAuthorization | Common authorization configuration taken from the referenced DcmRbDspRoutineRangeRequestRoutineResultsCommonAuthorizationRef. If there is no reference, no check on the commonly defined authorization conditions shall be done to get the routine result.
            container DcmRbDspRequestRoutineResultsIn [0..1]  # Provide description of input parameter of RequestResults subservice for RoutineControl service.
              container DcmRbDspRoutineRangeRequestRoutineResultsInSignal [1..*]: requires-index=true  # Provide description of a routine signal used in RoutineControl service.
                enumeration DcmRbDspRoutineSignalEndianness [0..1]: {BIG_ENDIAN, LITTLE_ENDIAN, OPAQUE}, multiplicity set at link in variant link-time / pre-compile in variant post-build+pre-compile, set at link in variant link-time / pre-compile in variant post-build+pre-compile  # Defines the endianness of the data belonging to a Request Routine Response In Signal.If projects configures OPAQUE no endianness conversion will be supported/applicable | If no DcmRbDspRoutineSignalEndianness is defined the value of DcmRbDspDataDefaultEndianness is applicable.
                integer DcmRbDspRoutineSignalLength [0..1]: 0..65535, multiplicity set at link in variant link-time / pre-compile in variant post-build+pre-compile, origin=RB:AR42.1.0.0:2017-01-31, set at link in variant link-time / pre-compile in variant post-build+pre-compile  # Provide the length of the Routine signal in bits.If DcmRbDspRoutineRequestResINSignal is configured as VARIABLE_LENGTH, then Dcm shall update the currentDataLength parameter of the configured DcmAppl API (DcmRbDspRequestResultsRoutineFnc) in BYTES before calling the API .CurrentDataLength parameter signifies the actual length of the variable length signal positioned at the end in request.
                integer DcmRbDspRoutineSignalPos: 0..65535, origin=RB:AR42.1.0.0:2017-01-31, set at link in variant link-time / pre-compile in variant post-build+pre-compile  # Provide the position of the signal in the RoutineControl request/response.The position is defined in bits. | The position is defined in bits.
                enumeration DcmRbDspRoutineSignalType: {BOOLEAN, SINT16, SINT16_N, SINT32, SINT32_N, SINT8, SINT8_N, UINT16, UINT16_N, UINT32, UINT32_N, UINT8, UINT8_N, VARIABLE_LENGTH}, origin=RB:AR42.1.0.0:2017-01-31, set at link in variant link-time / pre-compile in variant post-build+pre-compile  # Provide the type of the signal in the RoutineControl request/response.
                choice container DcmRbDspArgumentScaling [0..1]  # This container contains the configuration (parameters) of an alternative Diagnosis Representation. Out if this the scaling between Diagnosis and ECU internal representation and vice versa can be calculated.
                  container DcmRbDspAlternativeArgumentData [0..0]  # This container contains the configuration (parameters) of an alternative Diagnosis Representation by the means of a ArgumentDataPrototype.
                    foreign reference DcmRbDataElement [0..0]: origin=RB:AR42.5.0.0:2019-01-31, set at pre-compile, destination-type=ARGUMENT-DATA-PROTOTYPE  # Alternative Diagnosis Representation for the data defined by the means of a ArgumentDataPrototype
                  container DcmRbDspAlternativeDataProps [0..1]  # This container contains the configuration (parameters) of an alternative Diagnosis Representation by the means of ECU configuration parameters.The physical unit of the alternative data representation is defined by the DataPrototype referenced by DcmDspExternalSRDataElementClass. Additionally the definition of a text table mapping can be a defined for DcmDspDataTypeCategory TEXTTABLE and SCALE_LINEAR_AND_TEXTTABLE | The physical unit of the alternative data representation is defined by the DataPrototype referenced by DcmDspExternalSRDataElementClass. Additionally the definition of a text table mapping can be a defined for DcmDspDataTypeCategory TEXTTABLE and SCALE_LINEAR_AND_TEXTTABLE
                    container DcmRbDspLinearScale  # This container contains the configuration (parameters) of an linear scale of the alternative Diagnosis Representation.
                      float DcmRbDspDiagnosisRepresentationDataLowerRange: -Inf..Inf, scope=ECU, set at pre-compile  # Lower Range for this scale of the data in the alternative Diagnosis Representation.
                      float DcmRbDspDiagnosisRepresentationDataOffset: 0..Inf, scope=ECU, set at pre-compile, default-value=0  # Data offset of the alternative Diagnosis Representation for this scale.
                      float DcmRbDspDiagnosisRepresentationDataResolution: 0..Inf, scope=ECU, set at pre-compile  # Data resolution of the alternative Diagnosis Representation for this scale.
                      float DcmRbDspDiagnosisRepresentationDataUpperRange: -Inf..Inf, set at pre-compile  # Upper Range for this scale of the data in the alternative Diagnosis Representation.
                  container DcmRbDspAlternativeDataType [0..1]  # This container contains the configuration (parameters) of an alternative Diagnosis Representation by the means of an ApplicationDataType. | Additionally the definition of a text table mapping can be a defined for ApplicationDataTypes of category TEXTTABLE and SCALE_LINEAR_AND_TEXTTABLE.
                    foreign reference DcmRbApplicationDataType: set at pre-compile, destination-type=APPLICATION-DATA-TYPE  # Alternative Diagnosis Representation for the data defined by the means of a ApplicationPrimitiveDataType of category VALUE or BOOLEAN.
                    container DcmRbDspTextTableMapping [0..0]  # This container contains the configuration (parameters) of the mapping a DataPrototype typed by AutosarDataType that refer to a CompuMethods of category TEXTTABLE or SCALE_LINEAR_AND_TEXTTABLE. | Each DcmRbDspTextTableMapping defines a value pair which is used to map the ECU internal value (DcmRbDspInternalDataValue) to the vale used in the diagnosis representation (DcmRbDspDiagnosisRepresentationDataValue) and vice versa. The set of all DcmRbDspTextTableMappings defines the whole mapping of an data.
                      integer DcmRbDspDiagnosisRepresentationDataValue [0..0]: 0..18446744073709551615, scope=ECU, set at pre-compile, with-auto=true  # The data value in the diagnosis representation.
                      integer DcmRbDspInternalDataValue [0..0]: 0..18446744073709551615, scope=ECU, set at pre-compile  # The ECU internal data value.
            container DcmRbDspRequestRoutineResultsOut [0..1]  # Provide description of output parameter of RequestResult subservice for RoutineControl service.
              container DcmRbDspRequestRoutineResultsOutSignal [1..*]: requires-index=true  # Provide description of a routine signal used in RoutineControl service. | The ordering defined via the index attribute of the subcontainers in this list represents the order of the dataOutN elements in the XXX_RequestResult function call.
                enumeration DcmRbDspRoutineSignalEndianness [0..1]: {BIG_ENDIAN, LITTLE_ENDIAN, OPAQUE}, scope=ECU, multiplicity set at link in variant link-time / pre-compile in variant post-build+pre-compile, origin=RB:AR42.5.0.0:2019-01-31, set at link in variant link-time / pre-compile in variant post-build+pre-compile  # Defines the endianness of the data belonging to a Request Routine Response Out Signal. | If no DcmDspRoutineSignalEndianness is defined the value of DcmDspDataDefaultEndianness is applicable.
                integer DcmRbDspRoutineSignalLength [0..1]: 0..65535, scope=ECU, multiplicity set at link in variant link-time / pre-compile in variant post-build+pre-compile, origin=RB:AR42.5.0.0:2019-01-31, set at link in variant link-time / pre-compile in variant post-build+pre-compile  # Provide the length in bits of the signal in the RoutineControl request/response
                integer DcmRbDspRoutineSignalPos: 0..65535, scope=ECU, origin=RB:AR42.5.0.0:2019-01-31, set at link in variant link-time / pre-compile in variant post-build+pre-compile  # Provide the position of the signal in the RoutineControl request/response. | The position is defined in bits.
                enumeration DcmRbDspRoutineSignalType: {BOOLEAN, SINT16, SINT16_N, SINT32, SINT32_N, SINT8, SINT8_N, UINT16, UINT16_N, UINT32, UINT32_N, UINT8, UINT8_N, VARIABLE_LENGTH}, scope=ECU, origin=RB:AR42.5.0.0:2019-01-31, set at link in variant link-time / pre-compile in variant post-build+pre-compile  # Provide the type of the signal in the RoutineControl request/response.
                choice container DcmRbDspArgumentScaling [0..1]  # This container contains the configuration (parameters) of an alternative Diagnosis Representation. Out if this the scaling between Diagnosis and ECU internal representation and vice versa can be calculated.
                  container DcmRbDspAlternativeArgumentData [0..0]  # This container contains the configuration (parameters) of an alternative Diagnosis Representation by the means of a ArgumentDataPrototype.
                    foreign reference DcmRbDataElement [0..0]: origin=RB:AR42.5.0.0:2019-01-31, set at pre-compile, destination-type=ARGUMENT-DATA-PROTOTYPE  # Alternative Diagnosis Representation for the data defined by the means of a ArgumentDataPrototype
                  container DcmRbDspAlternativeDataProps [0..1]  # This container contains the configuration (parameters) of an alternative Diagnosis Representation by the means of ECU configuration parameters.The physical unit of the alternative data representation is defined by the DataPrototype referenced by DcmDspExternalSRDataElementClass. Additionally the definition of a text table mapping can be a defined for DcmDspDataTypeCategory TEXTTABLE and SCALE_LINEAR_AND_TEXTTABLE | The physical unit of the alternative data representation is defined by the DataPrototype referenced by DcmDspExternalSRDataElementClass. Additionally the definition of a text table mapping can be a defined for DcmDspDataTypeCategory TEXTTABLE and SCALE_LINEAR_AND_TEXTTABLE
                    container DcmRbDspLinearScale  # This container contains the configuration (parameters) of an linear scale of the alternative Diagnosis Representation.
                      float DcmRbDspDiagnosisRepresentationDataLowerRange: -Inf..Inf, scope=ECU, set at pre-compile  # Lower Range for this scale of the data in the alternative Diagnosis Representation.
                      float DcmRbDspDiagnosisRepresentationDataOffset: 0..Inf, scope=ECU, set at pre-compile, default-value=0  # Data offset of the alternative Diagnosis Representation for this scale.
                      float DcmRbDspDiagnosisRepresentationDataResolution: 0..Inf, scope=ECU, set at pre-compile  # Data resolution of the alternative Diagnosis Representation for this scale.
                      float DcmRbDspDiagnosisRepresentationDataUpperRange: -Inf..Inf, set at pre-compile  # Upper Range for this scale of the data in the alternative Diagnosis Representation.
                  container DcmRbDspAlternativeDataType [0..1]  # This container contains the configuration (parameters) of an alternative Diagnosis Representation by the means of an ApplicationDataType. | Additionally the definition of a text table mapping can be a defined for ApplicationDataTypes of category TEXTTABLE and SCALE_LINEAR_AND_TEXTTABLE.
                    foreign reference DcmRbApplicationDataType: set at pre-compile, destination-type=APPLICATION-DATA-TYPE  # Alternative Diagnosis Representation for the data defined by the means of a ApplicationPrimitiveDataType of category VALUE or BOOLEAN.
                    container DcmRbDspTextTableMapping [0..0]  # This container contains the configuration (parameters) of the mapping a DataPrototype typed by AutosarDataType that refer to a CompuMethods of category TEXTTABLE or SCALE_LINEAR_AND_TEXTTABLE. | Each DcmRbDspTextTableMapping defines a value pair which is used to map the ECU internal value (DcmRbDspInternalDataValue) to the vale used in the diagnosis representation (DcmRbDspDiagnosisRepresentationDataValue) and vice versa. The set of all DcmRbDspTextTableMappings defines the whole mapping of an data.
                      integer DcmRbDspDiagnosisRepresentationDataValue [0..0]: 0..18446744073709551615, scope=ECU, set at pre-compile, with-auto=true  # The data value in the diagnosis representation.
                      integer DcmRbDspInternalDataValue [0..0]: 0..18446744073709551615, scope=ECU, set at pre-compile  # The ECU internal data value.
          container DcmRbDspRoutineRangeStartRoutine [0..1]  # Provides the configuration of Start subservice for RoutineControl service.
            boolean DcmRbDspRoutineRangeInterfaceArgumentIntegrity [0..1]: scope=ECU, multiplicity set at pre-compile, set at pre-compile, default-value=true  # Defines the value of ClientServerOperation.diagArgIntegrity for the created C/S interface of this routine
            function name DcmRbDspRoutineRangeStartRoutineFnc [0..1]: scope=ECU, multiplicity set at pre-compile, set at pre-compile  # Function name for request to application to start a routine. (Routine_Start-function) | This parameter is related to the interface Xxx_Start.
            integer DcmRbDspRoutineRangeStartRoutineRole [0..1]: 0..4294967295, scope=ECU, multiplicity set at link in variant link-time / post-build in variant post-build / pre-compile in variant pre-compile, set at link in variant link-time / post-build in variant post-build / pre-compile in variant pre-compile  # Bitfield were each bit represents one dedicated role. A RoutineControl with sub-function startRoutine is granted access if the bit value is 1. If a bit value is 0, the routine is not allowed for that role. If this parameter is not configured and the Service 0x29 (Authentication) is configured, the DcmDspAuthenticationDeauthenticatedRole will be considered for the role verification check so that when role is not configured, the routine will be allowed to be executed in all the deauthenticated states.
            reference DcmRbDspRoutineRangeStartRoutineCommonAuthorizationRef [0..1]: scope=ECU, multiplicity set at link in variant link-time / pre-compile in variant post-build+pre-compile, set at link in variant link-time / pre-compile in variant post-build+pre-compile, destination=DcmDspCommonAuthorization  # Reference to DcmDspCommonAuthorization | Common authorization configuration taken from the referenced DcmRbDspStartRoutineCommonAuthorizationRef. If there is no reference, no check on the commonly defined authorization conditions shall be done to start the routine.
            container DcmRbDspStartRoutineIn [0..1]  # Provide description of input parameter of Start subservice for RoutineControl service
              container DcmRbDspStartRoutineInSignal [1..*]: requires-index=true  # Provide description of a routine signal used in RoutineControl service. | The ordering defined via the index attribute of the subcontainers in this list represents the order of the dataInN elements in the XXX_Start function call.
                enumeration DcmRbDspRoutineSignalEndianness [0..1]: {BIG_ENDIAN, LITTLE_ENDIAN, OPAQUE}, scope=ECU, multiplicity set at link in variant link-time / pre-compile in variant post-build+pre-compile, set at link in variant link-time / pre-compile in variant post-build+pre-compile  # Defines the endianness of the data belonging to a Start Routine In Signal. | If no DcmRbDspRoutineSignalEndianness is defined the value of DcmDspDataDefaultEndianness is applicable.
                integer DcmRbDspRoutineSignalLength [0..1]: 0..65535, scope=ECU, multiplicity set at link in variant link-time / pre-compile in variant post-build+pre-compile, set at link in variant link-time / pre-compile in variant post-build+pre-compile  # Provide the length in bits of the signal in the RoutineControl request/response
                integer DcmRbDspRoutineSignalPos: 0..65535, scope=ECU, set at link in variant link-time / pre-compile in variant post-build+pre-compile  # Provide the position of the signal in the RoutineControl request/response. | The position is defined in bits.
                enumeration DcmRbDspRoutineSignalType: {BOOLEAN, SINT16, SINT16_N, SINT32, SINT32_N, SINT8, SINT8_N, UINT16, UINT16_N, UINT32, UINT32_N, UINT8, UINT8_N, VARIABLE_LENGTH}, scope=ECU, set at link in variant link-time / pre-compile in variant post-build+pre-compile  # Provide the type of the signal in the RoutineControl request/response.
                choice container DcmRbDspArgumentScaling [0..1]  # This container contains the configuration (parameters) of an alternative Diagnosis Representation. Out if this the scaling between Diagnosis and ECU internal representation and vice versa can be calculated.
                  container DcmRbDspAlternativeDataProps [0..1]  # This container contains the configuration (parameters) of an alternative Diagnosis Representation by the means of ECU configuration parameters.The physical unit of the alternative data representation is defined by the DataPrototype referenced by DcmDspExternalSRDataElementClass. Additionally the definition of a text table mapping can be a defined for DcmDspDataTypeCategory TEXTTABLE and SCALE_LINEAR_AND_TEXTTABLE | The physical unit of the alternative data representation is defined by the DataPrototype referenced by DcmDspExternalSRDataElementClass. Additionally the definition of a text table mapping can be a defined for DcmDspDataTypeCategory TEXTTABLE and SCALE_LINEAR_AND_TEXTTABLE
                    container DcmRbDspLinearScale  # This container contains the configuration (parameters) of an linear scale of the alternative Diagnosis Representation.
                      float DcmRbDspDiagnosisRepresentationDataLowerRange: -Inf..Inf, scope=ECU, set at pre-compile  # Lower Range for this scale of the data in the alternative Diagnosis Representation.
                      float DcmRbDspDiagnosisRepresentationDataOffset: 0..Inf, scope=ECU, set at pre-compile, default-value=0  # Data offset of the alternative Diagnosis Representation for this scale.
                      float DcmRbDspDiagnosisRepresentationDataResolution: 0..Inf, scope=ECU, set at pre-compile  # Data resolution of the alternative Diagnosis Representation for this scale.
                      float DcmRbDspDiagnosisRepresentationDataUpperRange: -Inf..Inf, scope=ECU, set at pre-compile  # Upper Range for this scale of the data in the alternative Diagnosis Representation.
                  container DcmRbDspAlternativeDataType [0..1]  # This container contains the configuration (parameters) of an alternative Diagnosis Representation by the means of an ApplicationDataType. | Additionally the definition of a text table mapping can be a defined for ApplicationDataTypes of category TEXTTABLE and SCALE_LINEAR_AND_TEXTTABLE.
                    foreign reference DcmRbApplicationDataType: set at pre-compile, destination-type=APPLICATION-DATA-TYPE  # Alternative Diagnosis Representation for the data defined by the means of a ApplicationPrimitiveDataType of category VALUE or BOOLEAN.
                    container DcmRbDspTextTableMapping [0..0]  # This container contains the configuration (parameters) of the mapping a DataPrototype typed by AutosarDataType that refer to a CompuMethods of category TEXTTABLE or SCALE_LINEAR_AND_TEXTTABLE. | Each DcmRbDspTextTableMapping defines a value pair which is used to map the ECU internal value (DcmRbDspInternalDataValue) to the vale used in the diagnosis representation (DcmRbDspDiagnosisRepresentationDataValue) and vice versa. The set of all DcmRbDspTextTableMappings defines the whole mapping of an data.
                      integer DcmRbDspDiagnosisRepresentationDataValue [0..0]: 0..18446744073709551615, scope=ECU, set at pre-compile, with-auto=true  # The data value in the diagnosis representation.
                      integer DcmRbDspInternalDataValue [0..0]: 0..18446744073709551615, scope=ECU, set at pre-compile  # The ECU internal data value.
            container DcmRbDspStartRoutineOut [0..1]  # Provide description of output parameter of Start subservice for RoutineControl service.
              container DcmRbDspStartRoutineOutSignal [1..*]: requires-index=true  # Provide description of a routine signal used in RoutineControl service. | The ordering defined via the index attribute of the subcontainers in this list represents the order of the dataOutN elements in the XXX_Start function call.
                enumeration DcmRbDspRoutineSignalEndianness [0..1]: {BIG_ENDIAN, LITTLE_ENDIAN, OPAQUE}, scope=ECU, multiplicity set at link in variant link-time / pre-compile in variant post-build+pre-compile, set at link in variant link-time / pre-compile in variant post-build+pre-compile  # Defines the endianness of the data belonging to a Start Routine Out Signal. | If no DcmRbDspRoutineSignalEndianness is defined the value of DcmDspDataDefaultEndianness is applicable.
                integer DcmRbDspRoutineSignalLength [0..1]: 0..65535, scope=ECU, multiplicity set at link in variant link-time / pre-compile in variant post-build+pre-compile, set at link in variant link-time / pre-compile in variant post-build+pre-compile  # Provide the length in bits of the signal in the RoutineControl request/response.
                integer DcmRbDspRoutineSignalPos [0..1]: 0..65535, scope=ECU, multiplicity set at link in variant link-time / pre-compile in variant post-build+pre-compile, set at link in variant link-time / pre-compile in variant post-build+pre-compile  # Provide the position of the signal in the RoutineControl request/response. | The position is defined in bits.
                enumeration DcmRbDspRoutineSignalType: {BOOLEAN, SINT16, SINT16_N, SINT32, SINT32_N, SINT8, SINT8_N, UINT16, UINT16_N, UINT32, UINT32_N, UINT8, UINT8_N, VARIABLE_LENGTH}, scope=ECU, set at link in variant link-time / pre-compile in variant post-build+pre-compile  # Provide the type of the signal in the RoutineControl request/response.
                choice container DcmRbDspArgumentScaling [0..1]  # This container contains the configuration (parameters) of an alternative Diagnosis Representation. Out if this the scaling between Diagnosis and ECU internal representation and vice versa can be calculated.
                  container DcmRbDspAlternativeDataProps [0..1]  # This container contains the configuration (parameters) of an alternative Diagnosis Representation by the means of ECU configuration parameters.The physical unit of the alternative data representation is defined by the DataPrototype referenced by DcmDspExternalSRDataElementClass. Additionally the definition of a text table mapping can be a defined for DcmDspDataTypeCategory TEXTTABLE and SCALE_LINEAR_AND_TEXTTABLE | The physical unit of the alternative data representation is defined by the DataPrototype referenced by DcmDspExternalSRDataElementClass. Additionally the definition of a text table mapping can be a defined for DcmDspDataTypeCategory TEXTTABLE and SCALE_LINEAR_AND_TEXTTABLE
                    container DcmRbDspLinearScale  # This container contains the configuration (parameters) of an linear scale of the alternative Diagnosis Representation.
                      float DcmRbDspDiagnosisRepresentationDataLowerRange: -Inf..Inf, scope=ECU, set at pre-compile  # Lower Range for this scale of the data in the alternative Diagnosis Representation.
                      float DcmRbDspDiagnosisRepresentationDataOffset: 0..Inf, scope=ECU, set at pre-compile, default-value=0  # Data offset of the alternative Diagnosis Representation for this scale.
                      float DcmRbDspDiagnosisRepresentationDataResolution: 0..Inf, scope=ECU, set at pre-compile  # Data resolution of the alternative Diagnosis Representation for this scale.
                      float DcmRbDspDiagnosisRepresentationDataUpperRange: -Inf..Inf, scope=ECU, set at pre-compile  # Upper Range for this scale of the data in the alternative Diagnosis Representation.
                  container DcmRbDspAlternativeDataType [0..1]  # This container contains the configuration (parameters) of an alternative Diagnosis Representation by the means of an ApplicationDataType. | Additionally the definition of a text table mapping can be a defined for ApplicationDataTypes of category TEXTTABLE and SCALE_LINEAR_AND_TEXTTABLE.
                    foreign reference DcmRbApplicationDataType: set at pre-compile, destination-type=APPLICATION-DATA-TYPE  # Alternative Diagnosis Representation for the data defined by the means of a ApplicationPrimitiveDataType of category VALUE or BOOLEAN.
                    container DcmRbDspTextTableMapping [0..0]  # This container contains the configuration (parameters) of the mapping a DataPrototype typed by AutosarDataType that refer to a CompuMethods of category TEXTTABLE or SCALE_LINEAR_AND_TEXTTABLE. | Each DcmRbDspTextTableMapping defines a value pair which is used to map the ECU internal value (DcmRbDspInternalDataValue) to the vale used in the diagnosis representation (DcmRbDspDiagnosisRepresentationDataValue) and vice versa. The set of all DcmRbDspTextTableMappings defines the whole mapping of an data.
                      integer DcmRbDspDiagnosisRepresentationDataValue [0..0]: 0..18446744073709551615, scope=ECU, set at pre-compile, with-auto=true  # The data value in the diagnosis representation.
                      integer DcmRbDspInternalDataValue [0..0]: 0..18446744073709551615, scope=ECU, set at pre-compile  # The ECU internal data value.
          container DcmRbDspRoutineRangeStopRoutine [0..1]  # Provides the configuration of Stop subservice for RoutineControl service. | Existence indicates that the StopRoutine in the RoutineControl is supported.
            boolean DcmRbDspRoutineRangeInterfaceArgumentIntegrity [0..1]: scope=ECU, multiplicity set at pre-compile, set at pre-compile, default-value=true  # Defines the value of ClientServerOperation.diagArgIntegrity for the created C/S interface of this routine
            function name DcmRbDspRoutineRangeStopRoutineFnc [0..1]: scope=ECU, multiplicity set at pre-compile, set at pre-compile  # Function name for request to application to stop a routine. (Routine_Stop-function) | This parameter is related to the interface Xxx_Stop.
            integer DcmRbDspRoutineRangeStopRoutineRole [0..1]: 0..4294967295, scope=ECU, multiplicity set at link in variant link-time / post-build in variant post-build / pre-compile in variant pre-compile, set at link in variant link-time / post-build in variant post-build / pre-compile in variant pre-compile  # Bitfield were each bit represents one dedicated role. A RoutineControl with sub-function stopRoutine is granted access if the bit value is 1. If a bit value is 0, the routine is not allowed for that role. If this parameter is not configured and the Service 0x29 (Authentication) is configured, the DcmDspAuthenticationDeauthenticatedRole will be considered for the role verification check so that when role is not configured, the routine will be allowed to be executed in all the deauthenticated states.
            reference DcmRbDspRoutineRangeStopRoutineCommonAuthorizationRef [0..1]: scope=ECU, multiplicity set at link in variant link-time / pre-compile in variant post-build+pre-compile, set at link in variant link-time / pre-compile in variant post-build+pre-compile, destination=DcmDspCommonAuthorization  # Reference to DcmDspCommonAuthorization | Common authorization configuration taken from the referenced DcmRbDspStopRoutineCommonAuthorizationRef. If there is no reference, no check on the commonly defined authorization conditions shall be done to stop the routine.
            container DcmRbDspStopRoutineIn [0..1]  # Provide description of input parameter of Stop subservice for RoutineControl service.
              container DcmRbDspStopRoutineInSignal [1..*]: requires-index=true  # Provide description of a routine signal used in RoutineControl service. | The ordering defined via the index attribute of the subcontainers in this list represents the order of the dataInN elements in the XXX_Stop function call.
                enumeration DcmRbDspRoutineSignalEndianness [0..1]: {BIG_ENDIAN, LITTLE_ENDIAN, OPAQUE}, scope=ECU, multiplicity set at link in variant link-time / pre-compile in variant post-build+pre-compile, set at link in variant link-time / pre-compile in variant post-build+pre-compile  # Defines the endianness of the data belonging to a Stop Routine In Signal. | If no DcmRbDspRoutineSignalEndianness is defined the value of DcmDspDataDefaultEndianness is applicable.
                integer DcmRbDspRoutineSignalLength [0..1]: 0..65535, scope=ECU, multiplicity set at link in variant link-time / pre-compile in variant post-build+pre-compile, set at link in variant link-time / pre-compile in variant post-build+pre-compile  # Provide the length in bits of the signal in the RoutineControl request/response
                integer DcmRbDspRoutineSignalPos: 0..65535, scope=ECU, set at link in variant link-time / pre-compile in variant post-build+pre-compile  # Provide the position of the signal in the RoutineControl request/response. | The position is defined in bits.
                enumeration DcmRbDspRoutineSignalType: {BOOLEAN, SINT16, SINT16_N, SINT32, SINT32_N, SINT8, SINT8_N, UINT16, UINT16_N, UINT32, UINT32_N, UINT8, UINT8_N, VARIABLE_LENGTH}, scope=ECU, set at link in variant link-time / pre-compile in variant post-build+pre-compile  # Provide the type of the signal in the RoutineControl request/response.
                choice container DcmRbDspArgumentScaling [0..1]  # This container contains the configuration (parameters) of an alternative Diagnosis Representation. Out if this the scaling between Diagnosis and ECU internal representation and vice versa can be calculated.
                  container DcmRbDspAlternativeDataProps [0..1]  # This container contains the configuration (parameters) of an alternative Diagnosis Representation by the means of ECU configuration parameters.The physical unit of the alternative data representation is defined by the DataPrototype referenced by DcmDspExternalSRDataElementClass. Additionally the definition of a text table mapping can be a defined for DcmDspDataTypeCategory TEXTTABLE and SCALE_LINEAR_AND_TEXTTABLE | The physical unit of the alternative data representation is defined by the DataPrototype referenced by DcmDspExternalSRDataElementClass. Additionally the definition of a text table mapping can be a defined for DcmDspDataTypeCategory TEXTTABLE and SCALE_LINEAR_AND_TEXTTABLE
                    container DcmRbDspLinearScale  # This container contains the configuration (parameters) of an linear scale of the alternative Diagnosis Representation.
                      float DcmRbDspDiagnosisRepresentationDataLowerRange: -Inf..Inf, scope=ECU, set at pre-compile  # Lower Range for this scale of the data in the alternative Diagnosis Representation.
                      float DcmRbDspDiagnosisRepresentationDataOffset: 0..Inf, scope=ECU, set at pre-compile, default-value=0  # Data offset of the alternative Diagnosis Representation for this scale.
                      float DcmRbDspDiagnosisRepresentationDataResolution: 0..Inf, scope=ECU, set at pre-compile  # Data resolution of the alternative Diagnosis Representation for this scale.
                      float DcmRbDspDiagnosisRepresentationDataUpperRange: -Inf..Inf, scope=ECU, set at pre-compile  # Upper Range for this scale of the data in the alternative Diagnosis Representation.
                  container DcmRbDspAlternativeDataType [0..1]  # This container contains the configuration (parameters) of an alternative Diagnosis Representation by the means of an ApplicationDataType. | Additionally the definition of a text table mapping can be a defined for ApplicationDataTypes of category TEXTTABLE and SCALE_LINEAR_AND_TEXTTABLE.
                    foreign reference DcmRbApplicationDataType: set at pre-compile, destination-type=APPLICATION-DATA-TYPE  # Alternative Diagnosis Representation for the data defined by the means of a ApplicationPrimitiveDataType of category VALUE or BOOLEAN.
                    container DcmRbDspTextTableMapping [0..0]  # This container contains the configuration (parameters) of the mapping a DataPrototype typed by AutosarDataType that refer to a CompuMethods of category TEXTTABLE or SCALE_LINEAR_AND_TEXTTABLE. | Each DcmRbDspTextTableMapping defines a value pair which is used to map the ECU internal value (DcmRbDspInternalDataValue) to the vale used in the diagnosis representation (DcmRbDspDiagnosisRepresentationDataValue) and vice versa. The set of all DcmRbDspTextTableMappings defines the whole mapping of an data.
                      integer DcmRbDspDiagnosisRepresentationDataValue [0..0]: 0..18446744073709551615, scope=ECU, set at pre-compile, with-auto=true  # The data value in the diagnosis representation.
                      integer DcmRbDspInternalDataValue [0..0]: 0..18446744073709551615, scope=ECU, set at pre-compile  # The ECU internal data value.
            container DcmRbDspStopRoutineOut [0..1]  # Provide description of output parameter of Stop subservice for RoutineControl service.
              container DcmRbDspStopRoutineOutSignal [1..*]: requires-index=true  # Provide description of a routine signal used in RoutineControl service. | The ordering defined via the index attribute of the subcontainers in this list represents the order of the dataOutN elements in the XXX_Stop function call.
                enumeration DcmRbDspRoutineSignalEndianness [0..1]: {BIG_ENDIAN, LITTLE_ENDIAN, OPAQUE}, scope=ECU, multiplicity set at link in variant link-time / pre-compile in variant post-build+pre-compile, set at link in variant link-time / pre-compile in variant post-build+pre-compile  # Defines the endianness of the data belonging to a Stop Routine Out Signal. | If no DcmRbDspRoutineSignalEndianness is defined the value of DcmDspDataDefaultEndianness is applicable.
                integer DcmRbDspRoutineSignalLength [0..1]: 0..65535, scope=ECU, multiplicity set at link in variant link-time / pre-compile in variant post-build+pre-compile, set at link in variant link-time / pre-compile in variant post-build+pre-compile  # Provide the length in bits of the signal in the RoutineControl request/response
                integer DcmRbDspRoutineSignalPos: 0..65535, scope=ECU, set at link in variant link-time / pre-compile in variant post-build+pre-compile  # Provide the position of the signal in the RoutineControl request/response. | The position is defined in bits.
                enumeration DcmRbDspRoutineSignalType: {BOOLEAN, SINT16, SINT16_N, SINT32, SINT32_N, SINT8, SINT8_N, UINT16, UINT16_N, UINT32, UINT32_N, UINT8, UINT8_N, VARIABLE_LENGTH}, scope=ECU, set at link in variant link-time / pre-compile in variant post-build+pre-compile  # Provide the type of the signal in the RoutineControl request/response.
                choice container DcmRbDspArgumentScaling [0..1]  # This container contains the configuration (parameters) of an alternative Diagnosis Representation. Out if this the scaling between Diagnosis and ECU internal representation and vice versa can be calculated.
                  container DcmRbDspAlternativeDataProps [0..1]  # This container contains the configuration (parameters) of an alternative Diagnosis Representation by the means of ECU configuration parameters.The physical unit of the alternative data representation is defined by the DataPrototype referenced by DcmDspExternalSRDataElementClass. Additionally the definition of a text table mapping can be a defined for DcmDspDataTypeCategory TEXTTABLE and SCALE_LINEAR_AND_TEXTTABLE | The physical unit of the alternative data representation is defined by the DataPrototype referenced by DcmDspExternalSRDataElementClass. Additionally the definition of a text table mapping can be a defined for DcmDspDataTypeCategory TEXTTABLE and SCALE_LINEAR_AND_TEXTTABLE
                    container DcmRbDspLinearScale  # This container contains the configuration (parameters) of an linear scale of the alternative Diagnosis Representation.
                      float DcmRbDspDiagnosisRepresentationDataLowerRange: -Inf..Inf, scope=ECU, set at pre-compile  # Lower Range for this scale of the data in the alternative Diagnosis Representation.
                      float DcmRbDspDiagnosisRepresentationDataOffset: 0..Inf, scope=ECU, set at pre-compile, default-value=0  # Data offset of the alternative Diagnosis Representation for this scale.
                      float DcmRbDspDiagnosisRepresentationDataResolution: 0..Inf, scope=ECU, set at pre-compile  # Data resolution of the alternative Diagnosis Representation for this scale.
                      float DcmRbDspDiagnosisRepresentationDataUpperRange: -Inf..Inf, scope=ECU, set at pre-compile  # Upper Range for this scale of the data in the alternative Diagnosis Representation.
                  container DcmRbDspAlternativeDataType [0..1]  # This container contains the configuration (parameters) of an alternative Diagnosis Representation by the means of an ApplicationDataType. | Additionally the definition of a text table mapping can be a defined for ApplicationDataTypes of category TEXTTABLE and SCALE_LINEAR_AND_TEXTTABLE.
                    foreign reference DcmRbApplicationDataType: set at pre-compile, destination-type=APPLICATION-DATA-TYPE  # Alternative Diagnosis Representation for the data defined by the means of a ApplicationPrimitiveDataType of category VALUE or BOOLEAN.
                    container DcmRbDspTextTableMapping [0..0]  # This container contains the configuration (parameters) of the mapping a DataPrototype typed by AutosarDataType that refer to a CompuMethods of category TEXTTABLE or SCALE_LINEAR_AND_TEXTTABLE. | Each DcmRbDspTextTableMapping defines a value pair which is used to map the ECU internal value (DcmRbDspInternalDataValue) to the vale used in the diagnosis representation (DcmRbDspDiagnosisRepresentationDataValue) and vice versa. The set of all DcmRbDspTextTableMappings defines the whole mapping of an data.
                      integer DcmRbDspDiagnosisRepresentationDataValue [0..0]: 0..18446744073709551615, scope=ECU, set at pre-compile, with-auto=true  # The data value in the diagnosis representation.
                      integer DcmRbDspInternalDataValue [0..0]: 0..18446744073709551615, scope=ECU, set at pre-compile  # The ECU internal data value.
        container DcmRbDspTestResultByObdmid [0..1]  # This container contains the configuration (parameters) of the "Request on-board monitoring test results" service (Service $06).
          container DcmRbDspTestResultObdmidTid [1..*]  # This container contains the configuration (parameters) of a OBDMID and the assigned TIDs for the "Request on-board monitoring test results" service (Service $06).
            integer DcmRbDspTestResultObdmid: 0..255, origin=RB:AR42.1.0.0:2017-01-31, set at link in variant link-time / pre-compile in variant post-build+pre-compile  # OBDMID for Service $06
            container DcmRbDspTestResultObdmidTids [1..*]  # This container contains the configuration (parameters) of the TIDs belonging to the OBDMID for the "Request on-board monitoring test results" service (Service $06).
              function name DcmRbDspTestResultObdmidGetDTRValueFnc [0..1]: multiplicity set at pre-compile, origin=RB:AR42.1.0.0:2017-01-31, set at pre-compile  # Function name for reading value by TID (DcmRbDspTestResultObdmidGetDTRValueFnc-function).This is only relevant if DcmRbDspTestResultObdmidUsePort==FALSE.
              integer DcmRbDspTestResultObdmidTidUaSid: 0..255, origin=RB:AR42.1.0.0:2017-01-31, set at link in variant link-time / pre-compile in variant post-build+pre-compile  # Unit And Scaling ID for Service $06
              boolean DcmRbDspTestResultObdmidUsePort: origin=RB:AR42.1.0.0:2017-01-31, set at pre-compile  # If this is false, the DCM will use the function defined in DcmRbDspTestResultObdmidGetDTRValueFnc.If this is true, R-Port requiring the interface. The name of this port is the name of the container.
              reference DcmRbDspTestResultObdmidTidRef: origin=RB:AR42.1.0.0:2017-01-31, set at link in variant link-time / post-build in variant post-build / pre-compile in variant pre-compile, destination=DcmRbDspTestResultTid  # Link to reported TIDs of this OBDMID | upperMultiplicity / lowerMultiplicity:: At least one TID must be reported for an OBDMID
          container DcmRbDspTestResultTid [1..*]  # This container contains the configuration (parameters) of a single TID for the "Request on-board monitoring test results" service (Service $06). | The DCM will access the Data using an R-Port requiring a PortInterface DTRServices. The R-Port is named DtrServices_<OBDMID>_<TID> where <TID> is the name of the container DcmRbDspTestResultTid and <OBDMID> is the name of the container DcmRbDspTestResultObdmidTid.
            integer DcmRbDspTestResultTestId: 0..255, origin=RB:AR42.1.0.0:2017-01-31, set at link in variant link-time / pre-compile in variant post-build+pre-compile  # Test Id for Service $06
      container DcmPageBufferCfg  # This container contains the configuration (parameters) for Page Buffer handling
        boolean DcmPagedBufferEnabled: scope=ECU, set at pre-compile  # Allow to enable or disable the Paged buffer mechanism. | true = Paged buffer handling enabled false = Paged Buffer handling disabled If set to true, pduRCancelTransmit and pduRCancelReceive should be enabled.
      container DcmProcessingConditions [0..1]  # This container contains the configuration for mode arbitration functionality of the Dcm
        container DcmModeCondition [1..*]  # This container contains the configuration of a mode condition or an environmental conditions which can be used as argument in DcmModeRules. | One DcmModeCondition shall contain either one DcmSwcModeRef or one DcmBswModeRef or one DcmSwcSRDataElementRef. Please note that the Dcm acts as well as mode manager. Therefore the references DcmSwcModeRef or one DcmBswModeRef. might point to provided ModeDeclarationGroupPrototypes of the Dcm itself as well as to provided ModeDeclarationGroupPrototypes of other Bsw Modules or software components. In case of a configured DcmSwcModeRef or DcmBswModeRef only the DcmConditionType DCM_EQUALS or DCM_EQUALS_NOT are applicable. In case of DcmSwcSRDataElementRef all literals of DcmConditionType are possible.
          enumeration DcmConditionType: {DCM_EQUALS, DCM_EQUALS_NOT, DCM_GREATER_OR_EQUAL, DCM_GREATER_THAN, DCM_LESS_OR_EQUAL, DCM_LESS_THAN}, set at pre-compile  # This parameter specifies what kind of comparison that is made for the evaluation of the mode condition.
          integer DcmRbSwcSRDataElementValue [0..1]: multiplicity set at link in variant link-time / pre-compile in variant post-build+pre-compile, origin=RB:AR42.2.0.0:2017-07-31, set at link in variant link-time / pre-compile in variant post-build+pre-compile  # This Parameter is used as constant value of type numerical.This value is used for comparison agsinst DcmSRDataElementRef.Enter the value in decimal eg:5,11.
          instance reference DcmBswModeRef [0..1]: multiplicity set at pre-compile, set at pre-compile, destination-context=MODE-DECLARATION-GROUP-PROTOTYPE, destination-type=MODE-DECLARATION  # This parameter references a mode of a ModeDeclarationGroupPrototype provided by a Basic Software Module used for the condition. | Please note that such ModeDeclarationGroupPrototype are owned by a Basic Software Module Description in the role providedModeGroup.
          reference DcmModeConditionCertificateCompareElementRef [0..0]: scope=ECU, multiplicity set at pre-compile, set at pre-compile, destination=KeyMCertificateElement  # Reference to a certificate data element that provides the compare value.
          instance reference DcmSwcModeRef [0..1]: multiplicity set at pre-compile, set at pre-compile, destination-context=ROOT-SW-COMPOSITION-PROTOTYPE SW-COMPONENT-PROTOTYPE P-PORT-PROTOTYPE MODE-DECLARATION-GROUP-PROTOTYPE, destination-type=MODE-DECLARATION  # This parameter references a mode in a particular mode request port of a software component that is used for the condition.
          choice reference DcmSwcSRDataElementRef [0..1]: multiplicity set at pre-compile, set at pre-compile, destination=[DcmDspExternalSRDataElementClass, DcmDspPidService01ExternalSRDataElementClass]  # Reference to environmental conditions. | It is possible to reference a S/R Receiver-Port to read physical values and compare (equal, greater, less,...) them with a configured value that is defined by DcmSwcDataElementValue.
          choice container DcmSwcDataElementValue [0..0]  # This container contains the configuration of a compare value.
            container DcmSwcDataElementArray [0..0]  # This container contains the configuration of a array compare value.
              container DcmSwcDataElementArrayElement [0..*]  # This container contains the configuration of a array element compare value.
                integer DcmSwcDataElementArrayElementIndex [0..0]: 0..18446744073709551615, set at pre-compile  # Index to an element of the compare value array.
                integer DcmSwcDataElementArrayElementValue [0..0]: 0..18446744073709551615, set at pre-compile  # Value of an array element compare value.
            container DcmSwcDataElementPrimitive [0..0]  # This container contains the configuration of a primitive compare value.
              integer DcmSwcDataElementPrimitiveValue [0..0]: 0..18446744073709551615, set at pre-compile  # Primitive compare value.
        container DcmModeRule [1..*]  # This container contains the configuration of a mode rule which represents a logical expression with DcmModeConditions or other DcmModeRules as arguments. | All arguments are processed with the operator defined by DcmLogicalOperator, for instance: Argument_A AND Argument_B AND Argument_C
          enumeration DcmLogicalOperator [0..1]: {DCM_AND, DCM_OR}, multiplicity set at pre-compile, set at pre-compile  # This parameter specifies the logical operator to be used in the logical expression. If the expression only consists of a single condition this parameter shall not be used.
          integer DcmModeRuleNrcValue [0..1]: 1..255, scope=ECU, multiplicity set at link in variant link-time / pre-compile in variant pre-compile, set at link in variant link-time / pre-compile in variant pre-compile  # Optional parameter which defines the NRC to be sent in case the mode rule condition is not valid.
          choice reference DcmArgumentRef [1..*]: multiplicity set at pre-compile, requires-index=true, set at pre-compile, destination=[DcmModeCondition, DcmModeRule]  # This is a choice reference either to a mode condition or a an other mode rule serving as sub-expression.
    container DcmGeneral  # Contains general configuration parameters valid for the entire Dcm module.
      boolean DcmDDDIDStorage [0..1]: multiplicity set at pre-compile, set at pre-compile, default-value=false  # This configuration switch defines, whether DDDID definition is stored non-volatile or not. | true: DDDID are stored non-volatile false: DDDID are only maintained volatile
      boolean DcmDevErrorDetect: set at pre-compile, default-value=false  # Switches the development error detection and notification on or off. | * true: detection and notification is enabled. * false: detection and notification is disabled.
      boolean DcmEnableSecurityEventReporting: scope=ECU, set at pre-compile, default-value=false  # Switches the reporting of security events to the IdsM: Tags: atp.Status=draft | - true: reporting is enabled. - false: reporting is disabled.
      string DcmHeaderFileInclusion [0..0]: scope=ECU, multiplicity set at pre-compile, set at pre-compile, regular-expression=[a-zA-Z0-9_]([a-zA-Z0-9\._])*  # Name of the header file(s) to be included by the Dcm module containing the used C-callback declarations.
      boolean DcmRespondAllRequest: scope=ECU, set at pre-compile  # If set to FALSE the Dcm will not respond to diagnostic request that contains a service ID which is in the range from 0x40 to 0x7F or in the range from 0xC0 to 0xFF (Response IDs).
      float DcmTaskTime: 1E-4..0.1, set at link in variant link-time / pre-compile in variant post-build+pre-compile  # Allow to configure the time for the periodic cyclic task. Please note: This configuration value shall be equal to the value in the RTE module. | The AUTOSAR configuration standard is to use SI units, so this parameter is defined as float value in seconds. Dcm configuration tools must convert this float value to the appropriate value format for the use in the software implementation of Dcm. min: A negative value and zero is not allowed. upperMultiplicity: Exactly one TaskTime must be specified per configuration. lowerMultiplicity: Exactly one TaskTime must be specified per configuration.
      boolean DcmVersionInfoApi: set at pre-compile, default-value=false  # Preprocessor switch to enable or disable the output Version info of the functionality.
      boolean DcmRbOBDonUDSEnabled [0..1]: scope=ECU, origin=RB:AR45.3.0.0:2022-06-27, set at link in variant link-time / pre-compile in variant post-build+pre-compile, default-value=false  # If this parameter is set to true, OBDonUDS protocol is enabled. If this parameter is not configured or set to false, OBDonUDS protocol is disabled.
      reference DcmVinRef [0..1]: multiplicity set at pre-compile, set at pre-compile, destination=DcmDspDid  # Reference to the Did containing the VIN Information. | This parameter is needed for function Dcm_GetVin
      container DcmRbGeneral  # This container contains the configuration (parameters) for Component wide parameters
        boolean DcmRbApplCallRequiredOnReqReception [0..1]: multiplicity set at pre-compile, origin=RB:AR42.1.0.0:2017-01-31, set at pre-compile, default-value=false  # Parameter to enable/disable the invocation of the application function from Dcm StartofReception/CopyRxData/RxIndication when a request is received at the Dcm. Autosar stack already ensures with Autosar 4.0 that every N-PDU is copied immediately to Application buffer (DSL/DSD). This parameter enables the feature which will provide an option for the Customer Teams to start working the receiving data (DSP) even before the reception is completed. This is achieved through the call-outs DcmAppl_StartOfReception, DcmAppl_CopyRxData and DcmAppl_TpRxIndication from Dcm which can provide the buffer pointer, total length, currently received length etc.. If set to TRUE, then DcmAppl_StartOfReception, DcmAppl_CopyRxData and DcmAppl_TpRxIndication will be called from Dcm. If set to FALSE or left unconfigured, then the mentioned functions will not be called from Dcm
        boolean DcmRbApplTxConfirmationRequiredAlways [0..1]: multiplicity set at pre-compile, origin=RB:AR42.1.0.0:2017-01-31, set at pre-compile, default-value=true  # Parameter to enable the Tx confirmation call for application. If the parameter is set to TRUE, then confirmation to the application after transmission of response will be provided even if service is located inside DSP. Also confirmation to the application will be sent in case of suppression of responses in case ApplTxConfirmationRequiredAlways is TRUE. If ApplTxConfirmationRequiredAlways is TRUE, Dcm Appl API DcmAppl_DcmConfirmation will be called from Dcm.
        boolean DcmRbDemSREnabled [0..1]: multiplicity set at pre-compile, origin=RB:AR42.1.0.0:2017-04-31, set at pre-compile, default-value=false  # Enable / Disable Generation of Sender-Receiver Interfaces for Dem
        boolean DcmRbDiagAdaptSupport [0..1]: multiplicity set at pre-compile, origin=RB:AR42.1.0.0:2017-01-31, set at pre-compile, default-value=false  # Preprocessor switch to enable or disable rba_DiagAdapt Support in DCM.This is used to support vendor specific MEDC17 services along with DCM.
        boolean DcmRbDspSecurityStoreDelayCountAndTimerOnJump [0..1]: multiplicity set at pre-compile, origin=RB:AR42.1.0.0:2017-01-31, set at pre-compile, default-value=false  # Parameter to allow the user to decide on whether DelayCount and DelayTimer values needs to be stored during Boot Loader interactions. If set to TRUE, DelayCount and DelayTimer values shall be stored during Boot Loader interactions. If set to FALSE, DelayCount and DelayTimer values shall not be stored during Boot Loader interactions. If the parameter is left unconfigured, DelayCount and DelayTimer values shall not be stored during Boot Loader interactions.
        float DcmRbEcuResetTime [0..1]: 0..100, multiplicity set at link in variant link-time / pre-compile in variant post-build+pre-compile, origin=RB:AR42.1.0.0:2017-01-31, set at link in variant link-time / pre-compile in variant post-build+pre-compile  # The parameter provides the time taken for reset of the ECU and it is relevant only in case of bootloader jump. If the parameter is configured and during jump from boot using Dsp supported EcuReset service(0x11) or DiagnosticSessionControl service(0x10), if the time configured is greater than the remaining P2/P2* time ,Dcm shall again trigger a wait pend response and shall wait for a positive confirmation before triggering function to perform the reset. The parameter if configured should be in multiples of DcmTaskTime and shoule be less than the P2*Max configured for the protocol used for jump to bootloader. | The AUTOSAR configuration standard is to use SI units, so this parameter is defined as float value in seconds. DCM configuration tools must convert this float value to the appropriate value format for the use in the software implementation of DCM. A negative value is not allowed
        string DcmRbOSCounterId [0..1]: multiplicity set at link in variant link-time / pre-compile in variant post-build+pre-compile, origin=RB:AR42.1.0.0:2017-01-31, set at link in variant link-time / pre-compile in variant post-build+pre-compile  # The counterID is used by OStimer.The user shall configure the parameter as a string, which would be the name of the counter in the AUTOSAR OS
        string DcmRbOSCounterMacro [0..1]: multiplicity set at link in variant link-time / pre-compile in variant post-build+pre-compile, origin=RB:AR42.1.0.0:2017-01-31, set at link in variant link-time / pre-compile in variant post-build+pre-compile  # Macro used to calculate the current system time (Ticks)
        enumeration DcmRbOSTimerUse: origin=RB:AR42.1.0.0:2017-01-31, set at pre-compile  # Choose between Project Specific , AUTOSAR Specific and Cyclic Count Project Specific : CPU timer will be used for timer monitoring. Corresponding Project Specific OScounterMacro and OScounterID has to be configured with this option Project can make necessary changes in file os_bsw.h file which will be included when project specific is chosen AUTOSAR Specific : CPU timer will be used for timer monitoring. Corresponding AUTOSAR Specific OScounterMacro and OScounterID has to be configured with this option Autosar specific needs to be selected if the project wants to use mcu counter. Project can make necessary changes in file Dcm_Cfg_Timer.h file which will be included when autosar specific is chosen Cyclic Count: The Dcm scheduled cycle time will be used as reference for calculating the time. Cyclic Count E.g : If Dcm_mainfunction is scheduled in 5ms rastor & is called twice; The total time elapsed is calculated as Dcm task time X 2 Cyclic Count : With this option , there is no need to configure OScounterID & OScounterMAcro
          ProjectSpecific  # CPU timer will be used for timer monitoring. Corresponding MEDC17 OScounterMacro and OScounterID has to be configured with this option
          AutosarSpecific  # CPU timer will be used for timer monitoring. Corresponding AUTOSAR Specific OScounterMacro and OScounterID has to be configured with this option
          CyclicCount  # Cyclic Count: The Dcm scheduled cycle time will be used as reference for calculating the time. E.g : If Dcm_mainfunction is scheduled in 5ms rastor & is called twice; The total time elapsed is calculated as Dcm task time X 2With this option , there is no need to configure OScounterID & OScounterMAcro
        boolean DcmRbParallelProcessingAllowed [0..1]: origin=RB:AR42.5.0.0:2019-04-31, set at pre-compile, default-value=false  # If Configured - TRUE , then separate resources are allocated for OBD and non-OBD execution and the requests from these two protocols are handled separately without Pre-Emption. If set to true, pduRCancelTransmit and pduRCancelReceive should be enabled. If Configure - FALSE . Then only one Protocol is active at a time and Protocols are Pre-Empted based on Protocol Priority
        boolean DcmRbQueuingOfRequestEnabled [0..1]: multiplicity set at pre-compile, origin=RB:AR42.1.0.0:2017-01-31, set at pre-compile  # Parameter to enable/disable the queuing of request reception, which is received in parallel to a running request processing. If set to TRUE, Queuing of request shall be enabled in Dcm. The queuing shall be done with a depth of 1 queued buffer returning FC_CTS to the tester. If the third request arrives, FC_WAIT has to be sent until one of the buffers is released. If set to FALSE or left unconfigured,then Queuing of request shall be disabled in Dcm.
        boolean DcmRbRTEsupportsPRportFunctionality: multiplicity set at link in variant link-time+post-build / pre-compile in variant pre-compile, origin=RB:AR42.7.0.0:2019-12-05, set at link in variant link-time+post-build / pre-compile in variant pre-compile, default-value=false  # Enables generation of PR port (incase conditions of generation of said Port are met) provided the RTE component used supports full PR port functionality.
        boolean DcmRbRespondToRequestAfterEcuReset [0..1]: multiplicity set at pre-compile, origin=RB:AR42.1.0.0:2017-01-31, set at pre-compile, default-value=true  # The parameter is used to enable/disable the processing of new tester requests after the successful processing of Dsp EcuReset Service(0x11) request and before the actual reset happens. TRUE - DCM shall respond to further requests after sending the positive response of EcuReset (call of Dcm_TpTxConfirmation ) during reset- processing FALSE - DCM shall ignore all further requests during reset-processing. If the parameter is left unconfigured ,the default value (TRUE )will be taken.
        boolean DcmRbRestoringEnabled [0..1]: multiplicity set at pre-compile, origin=RB:AR42.1.0.0:2017-01-31, set at pre-compile, default-value=false  # Enable / Disable restoring of Diagnostic information (Jump from BootLoader)
        integer DcmRbSignalDefaultValue [0..1]: 0..255, multiplicity set at pre-compile, origin=RB:AR42.1.0.0:2017-01-31, set at pre-compile, default-value=0  # Default value to be configured for Signal Data with gaps.The value configured shall be used to fill the gaps if existing between signal data of a DID.The default value of this parameter is 0.
        boolean DcmRbSingleBufferConceptDisabled [0..1]: multiplicity set at pre-compile, origin=RB:AR42.1.0.0:2017-01-31, set at pre-compile, default-value=false  # Parameter to enable/disable the concept of single buffer sharing for reception and transmission. If set to TRUE, single buffer concept shall be disabled and a separate reception and transmission buffer will be assigned to the protocol. If set to FALSE,single buffer concept shall be enabled and a single buffer will be shared for reception and transmission of protocols. If the parameter is left unconfigured, the single buffer concept shall be used. In case Protocol Preemption is enabled (through the configuration of multiple protocols with different DcmDslProtocolPriority) , it is recommended to configure separate Buffers for Reception and Transmission to avoid data corruption. Possible use case : Low Prio request is in progress, a high priority request is received as an interrupt. The request buffer is over written by the response of the low prio protocol. This scenario can occur when the control is in the service and the response is yet to be filled/ being filled and a SOR for a high prio request is received. After the RxIndication is processed and the control is given back to the service, with a single buffer concept, the request can potentially be over written by the response which will inturn lead to an incorrect final response for the high priority request.
        boolean DcmRbStoringEnabled [0..1]: multiplicity set at link in variant link-time+post-build / pre-compile in variant pre-compile, origin=RB:AR42.1.0.0:2017-01-31, set at link in variant link-time+post-build / pre-compile in variant pre-compile, default-value=false  # Enable / Disable storing of Diagnostic information (Jump to BootLoader)
        boolean DcmRbSwApplComponentNameGeneration [0..1]: multiplicity set at link in variant link-time+post-build / pre-compile in variant pre-compile, origin=RB:AR42.7.0.0:2019-10-01, set at link in variant link-time+post-build / pre-compile in variant pre-compile  # Enable / Disable generation of application Sw Component names in Flatview File(or Assembly connection file).This is mandatory when dcmDspExternalSRDataElementClass is configured.
        string DcmRbSwCompositionPath [0..1]: multiplicity set at link in variant link-time / pre-compile in variant post-build+pre-compile, origin=RB:AR42.7.0.0:2019-10-01, set at link in variant link-time / pre-compile in variant post-build+pre-compile, default-value=RB/PT/PCT_EcuFlatView/SwComponentTypes/EcuFlatView  # This Parameter is used to provide path to SwComposition in Flatview File.This is mandatory when dcmDspExternalSRDataElementClass is configured. e.g RB/PT/PCT_XXX/SwComponentTypes/XXX. Also the last name in the string(in given example "XXX") will be considered to generate the name of the flatview file e.g Dcm_Cfg_SWCD_XXX_Connectors.arxml
        string DcmRbSwDcmComponentName [0..1]: multiplicity set at link in variant link-time / pre-compile in variant post-build+pre-compile, origin=RB:AR42.7.0.0:2019-10-01, set at link in variant link-time / pre-compile in variant post-build+pre-compile, default-value=CPT_Dcm  # This Parameter is used to provide name of Dcm software component in flatview file(or Assembly connection file).TThis is mandatory when dcmDspExternalSRDataElementClass is configured.
        boolean DcmRbSwDcmComponentNameGeneration [0..1]: multiplicity set at link in variant link-time+post-build / pre-compile in variant pre-compile, origin=RB:AR42.7.0.0:2019-10-01, set at link in variant link-time+post-build / pre-compile in variant pre-compile  # Enable / Disable generation of Dcm Component name in Flatview File(or Assembly connection file).This is mandatory when dcmDspExternalSRDataElementClass is configured.
        integer DcmRbVINMaxNumRespPend [0..1]: 0..255, scope=ECU, origin=RB:AR42.8.0.0:2020-06-16, set at link in variant link-time / pre-compile in variant post-build+pre-compile  # This parameter is introduced to fetch the Vehicle Identification Number(VIN) from VIN DID, When this parameter is configured, DCM will try to fetch the VIN data until VIN wait pend count reaches the configured range. If this parameter is not configured, then DcmDslDiagRespMaxNumRespPend parameter value will be considered as default value. | DCM will wait to fetch VIN DID data till the configured time elapses.
        reference DcmRbDcmClientSIDTable [0..1]: scope=ECU, origin=RB:AR45.4.0.0:2023-02-13, set at link in variant link-time / pre-compile in variant post-build+pre-compile, destination=DcmDsdServiceTable  # Reference to a DcmDsdServiceTable that is used for diagnostic request processing for this protocol via DcmClient. A reference to a DcmDsdServiceTable containing Dcm internal services has to be configured here. This is needed for the DcmClient feature where the actual DcmDsdServiceTable referenced from the DcmDslProtocolRow->DcmDslProtocolSIDTable contains external services, which will be called by Dcm when a request is received on thet protocol. The external service implementation will use the callback Dcm_DcmClientServiceHandler() to call the Dcm internal services configured in DcmRbDcmClientSIDTable to collect the data from the Host ECU and then will merge that with the data from the Client ECU and send as a final response via the external service handler.
      container DcmSecurityEventRefs [0..1]: multiplicity set at pre-compile  # Container for the references to IdsMEvent elements representing the security events that the Dcm module shall report to the IdsM in case the coresponding security related event occurs (and if DcmEnableSecurityEventReporting is set to "true"). The standardized security events in this container can be extended by vendor-specific security events. Tags: atp.Status=draft
        reference DIAG_SEV_AUTHENTICATION_SUCCESSFUL [0..0]: multiplicity set at pre-compile, set at pre-compile, destination=IdsMEvent  # Successfully authenticated (via Authentication $29) Tags: atp.Status=draft
        reference DIAG_SEV_CERTIFICATE_FAILURE [0..0]: multiplicity set at pre-compile, set at pre-compile, destination=IdsMEvent  # The tester tried an authentication with an invalid certificate. Tags: atp.Status=draft
        reference DIAG_SEV_CLEAR_DTC_SUCCESSFUL [0..0]: multiplicity set at pre-compile, set at pre-compile, destination=IdsMEvent  # DTC information has been cleared by SID 0x14 ClearDTCInformation Tags: atp.Status=draft
        reference DIAG_SEV_COMMUNICATION_CONTROL_SWITCHED_OFF [0..0]: multiplicity set at pre-compile, set at pre-compile, destination=IdsMEvent  # ECU communication was switched off with service CommunicationControl. Tags: atp.Status=draft
        reference DIAG_SEV_DTC_SETTING_SWITCHED_OFF [0..0]: multiplicity set at pre-compile, set at pre-compile, destination=IdsMEvent  # DTC setting switched off with service 0x85 (ControlDTCSetting). Tags: atp.Status=draft
        reference DIAG_SEV_ECU_RESET [0..0]: multiplicity set at pre-compile, set at pre-compile, destination=IdsMEvent  # ECU had been reset by SID 0x11 ResetECU. Tags: atp.Status=draft
        reference DIAG_SEV_ECU_UNLOCK_SUCCESSFUL [0..0]: multiplicity set at pre-compile, set at pre-compile, destination=IdsMEvent  # Successfully unlocked the ECU (via Security Access $27), per Level Tags: atp.Status=draft
        reference DIAG_SEV_INCORRECT_MESSAGE_LENGTH_OR_FORMAT [0..0]: multiplicity set at pre-compile, set at pre-compile, destination=IdsMEvent  # Received request message does not match the specified length or the format of the parameters is different from the specified ones for that service. NRC 0x13 (incorrectMessageLengthOrInvalidFormat) was returned. Tags: atp.Status=draft
        reference DIAG_SEV_NUMBER_OF_FAILED_AUTHENTICATION_ATTEMPTS_EXCEEDED [0..0]: multiplicity set at pre-compile, set at pre-compile, destination=IdsMEvent  # Number of failed authentication attempts - OEM specific Tags: atp.Status=draft
        reference DIAG_SEV_REQUEST_DOWNLOAD [0..0]: multiplicity set at pre-compile, set at pre-compile, destination=IdsMEvent  # A diagnostic data download sequence was requested with SID 0x34. Tags: atp.Status=draft
        reference DIAG_SEV_REQUEST_OUT_OF_RANGE [0..1]: multiplicity set at pre-compile, set at pre-compile, destination=IdsMEvent  # A diagnostic request with a parameter that is out of range of the allowed bounds was received. A NRC 0x31 (requestOutOfRange) was returned. Tags: atp.Status=draft
        reference DIAG_SEV_REQUEST_SEQUENCE_ERROR [0..0]: multiplicity set at pre-compile, set at pre-compile, destination=IdsMEvent  # A diagnostic service was received in the wrong sequence order. NRC 0x24 (requestSequenceError) was returned. Tags: atp.Status=draft
        reference DIAG_SEV_REQUESTED_ACTIONS_REQUIRES_AUTHENTICATION [0..0]: multiplicity set at pre-compile, set at pre-compile, destination=IdsMEvent  # A diagnostic request was received while the required authentication to execute this service is not given. NRC 0x34 (authenticationRequired) was returned. Tags: atp.Status=draft
        reference DIAG_SEV_SECURITY_ACCESS_DENIED [0..0]: multiplicity set at pre-compile, set at pre-compile, destination=IdsMEvent  # Tester has sent an diagnostic request without meeting the servers security level requirements for that service. NRC 0x33 (securityAccessDenied) was returned. Tags: atp.Status=draft
        reference DIAG_SEV_SECURITY_ACCESS_INVALID_KEY [0..0]: multiplicity set at pre-compile, set at pre-compile, destination=IdsMEvent  # Security Access failed because the tester has sent an invalid key to the server. An NRC 0x35 (invalidKey) was returned. Tags: atp.Status=draft
        reference DIAG_SEV_SECURITY_ACCESS_NUMBER_OF_ATTEMPTS_EXCEEDED [0..0]: multiplicity set at pre-compile, set at pre-compile, destination=IdsMEvent  # Security Access failed and the number of invalid attempts has been exceeded. NRC 0x36 (exceedNumberOfAttempts) was returned. Tags: atp.Status=draft
        reference DIAG_SEV_SECURITY_ACCESS_REQUIRED_TIME_DELAY_NOT_EXPIRED [0..0]: multiplicity set at pre-compile, set at pre-compile, destination=IdsMEvent  # A further attempt to unlock the ECU was taken before the delay time had expired. NRC 0x37 (requiredTimeDelayNotExpired) was sent. Tags: atp.Status=draft
        reference DIAG_SEV_SERVICE_NOT_SUPPORTED [0..0]: multiplicity set at pre-compile, set at pre-compile, destination=IdsMEvent  # A diagnostic service was requested that is not supported or not supported in the active session. NRC 0x11 (serviceNotSupported) or NRC 0x7F (serviceNotSupportedInActiveSession) was returned. Tags: atp.Status=draft
        reference DIAG_SEV_SUBFUNCTION_NOT_SUPPORTED [0..0]: multiplicity set at pre-compile, set at pre-compile, destination=IdsMEvent  # A subfunction of a diagnostic service was requested that is not supported for the requested service. Tags: atp.Status=draft
        reference DIAG_SEV_WRITE_DATA [0..0]: multiplicity set at pre-compile, set at pre-compile, destination=IdsMEvent  # Diagnostic data identifier has been written by SID 0x2E. Tags: atp.Status=draft
        reference DIAG_SEV_WRITE_INV_DATA [0..0]: multiplicity set at pre-compile, set at pre-compile, destination=IdsMEvent  # Tester writes invalid data with service WriteDataByIdentifier. Tags: atp.Status=draft
