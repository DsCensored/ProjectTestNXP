[part 1 of 2: package /AUTOSAR_Dcm/EcucModuleDefs]
AUTOSAR XML (schema 4-2-2)
package /AUTOSAR_Dcm/EcucModuleDefs
  module definition Dcm [0..1]: category=VENDOR_SPECIFIC_MODULE_DEFINITION, refined-module-def=Dcm, variants link-time/post-build/pre-compile  # Configuration of the Dcm (Diagnostic Communications Manager) module.
    container DcmConfigSet  # This container contains the configuration parameters and sub containers of the DCM module supporting multiple configuration sets.
      container DcmDsd  # These parameters configure the Diagnostic Service Dispatcher submodule.
        boolean DcmRbDsdRequestManufacturerNotificationEnabled: scope=ECU, origin=RB:AR45.0.0.0:2021-05-03, set at pre-compile  # Allows to enable or disable the requested notification mechanism for the Manufacturer.
        boolean DcmRbDsdRequestSupplierNotificationEnabled: scope=ECU, origin=RB:AR45.0.0.0:2021-05-03, set at pre-compile  # Allows to enable or disable the requested notification mechanism for the Supplier.
        boolean DcmRbDsdRequestASPManufacturerNotificationEnabled [0..1]: scope=ECU, origin=RB:AR45.4.0.0:2023-01-31, set at pre-compile  # Only relevant when dcmDsdRequestManufacturerNotificationEnabled parameter is TRUE.This parameter is used to select the type of Server Handling required. TRUE indicates Asynchronous Server Call Point handling shall be used for every Manufacturer ServiceRequestNotification. FALSE indicates Synchronous server call point handling shall be used.
        container DcmDsdServiceRequestManufacturerNotification [0..*]: requires-index=true  # The name of this container is used to define the name of the R-Port through which the DCM accesses the interface ServiceRequestNotification. | The R-Port is named ServiceRequestManufacturerNotification_{Name} where {Name} is the name of the container DcmDsdServiceRequestManufacturerNotification. The lowerMultiplicity is 0: If DcmRbDsdRequestManufacturerNotificationEnabled = false the Indication API is not available.
        container DcmDsdServiceRequestSupplierNotification [0..*]: requires-index=true  # The name of this container is used to define the name of the R-Port through which the DCM accesses the interface ServiceRequestNotification. | The R-Port is named ServiceRequestSupplierNotification_<SWC> where <SWC> is the name of the container DcmDsdServiceRequestSupplierNotification. The lowerMultiplicity is 0: If DcmDsdRequestSupplierNotification = false the Indication API is not available.
        container DcmDsdServiceTable [1..256]  # This container contains the configuration (DSD parameters) for a Service Identifier Table. | Note: It is allowed to add OBD services to a DcmDsdServiceTable related to a UDS Protocol. But it is not allowed to add UDS services to a DcmDsdServiceTable related to an OBD Protocol.
          integer DcmDsdSidTabId: 0..255, scope=ECU, set at link in variant link-time / pre-compile in variant post-build+pre-compile  # Due to using possibly more service tables, the unique DcmDsdSidTabId can be used to identify them.
          integer DcmRbNRCForService [0..1]: 1..254, multiplicity set at link in variant link-time+post-build / pre-compile in variant pre-compile, origin=RB:AR42.1.0.0:2017-01-31, set at link in variant link-time+post-build / pre-compile in variant pre-compile, default-value=127  # The NRC updated in this field shall be returned for any request in the protocol referring this service table if the service is not supported in active session. ISO recommends that the parameter should be set to 0x7F for UDS.Users may configure any NRC value for this parameter, according to project requirements, for other protocols.
          container DcmDsdService [1..*]  # This container contains the configuration (DSD parameters) for a Service.
            integer DcmDsdServiceRole [0..1]: 0..4294967295, scope=ECU, multiplicity set at link in variant link-time / post-build in variant post-build / pre-compile in variant pre-compile, set at link in variant link-time / post-build in variant post-build / pre-compile in variant pre-compile  # Bitfield were each bit represents one dedicated role. A diagnostic service is granted access if the bit value is 1. If a bit value is 0, the service is not allowed to be executed for that role. If this parameter is not configured and the Service 0x29 (Authentication) is configured, the DcmDspAuthenticationDeauthenticatedRole will be considered for the role verification check so that when role is not configured, the service will be allowed to be executed in all the deauthenticated states.
            boolean DcmDsdServiceUsed [0..0]: set at link in variant link-time / post-build in variant post-build / pre-compile in variant pre-compile, default-value=true  # Allows to activate or deactivate the usage of a Service. This parameter can be used for multi-purpose ECUs. | true - service is available false - service is not available
            function name DcmDsdSidTabFnc [0..1]: scope=ECU, multiplicity set at link in variant link-time / pre-compile in variant post-build+pre-compile, set at link in variant link-time / pre-compile in variant post-build+pre-compile  # Callback function of the ECU Supplier specific component for the particular service. The function's prototype is as described for <Module>_<DiagnosticService>. If this parameter is not configured, the service is handled Dcm-internally.
            integer DcmDsdSidTabServiceId: 0..255, scope=ECU, set at link in variant link-time / pre-compile in variant post-build+pre-compile  # Identifier of the service. | The possible service identifiers are defined in ISO 14229-1 and ISO 15031-5.
            boolean DcmDsdSidTabSubfuncAvail: scope=ECU, set at link in variant link-time / pre-compile in variant post-build+pre-compile  # Information about whether the service has subfunctions or not. This parameter is used for the handling of the "suppressPosRspMsgIndicationBit" as defined in ISO 14229-1, which can be used as a reference for the configuration. | true - service has subfunctions, suppressPosRspMsgIndicationBit is available false - service has no subfunctions, suppressPosRspMsgIndicationBit is not available
            string DcmRbDsdSidTabSidInitFunction [0..1]: multiplicity set at link in variant link-time+post-build / pre-compile in variant pre-compile, origin=RB:AR42.1.0.0:2017-01-31, set at link in variant link-time+post-build / pre-compile in variant pre-compile  # Function pointer of the service initializing function.User may see the function name for Dcm specific services by pressing "Ctrl+Enter"
            function name DcmRbDsdSidTabUserModeRuleFnc [0..1]: multiplicity set at pre-compile, origin=RB:AR42.1.0.0:2017-01-31, set at pre-compile  # Function name used by the application to perform user specific checks on the SID.In case the checks fails, NRC value set by the application can be returned to the tester. In case the function is not configured for SID, the DcmAppl API Xxx_UserServiceModeRuleService shall be called.
            reference DcmDsdSidTabModeRuleRef [0..1]: scope=ECU, multiplicity set at link in variant link-time / pre-compile in variant post-build+pre-compile, set at link in variant link-time / pre-compile in variant post-build+pre-compile, destination=DcmModeRule  # Reference to a DcmDspModeRule which controls the execution of the service. If there is no reference configured, no mode rule check shall be performed.
            reference DcmDsdSidTabSecurityLevelRef [0..*]: scope=ECU, multiplicity set at link in variant link-time / pre-compile in variant post-build+pre-compile, set at link in variant link-time / pre-compile in variant post-build+pre-compile, destination=DcmDspSecurityRow  # Reference to a Security Level in which the service is allowed to be executed. Multiple references are allowed for a service. | Please refer to ISO 14229-1, ISO 15031-5 and chapter "Verification of the Service Security Access levels." If there is no reference configured, no service security verification shall be performed.
            reference DcmDsdSidTabSessionLevelRef [0..*]: scope=ECU, multiplicity set at link in variant link-time / pre-compile in variant post-build+pre-compile, set at link in variant link-time / pre-compile in variant post-build+pre-compile, destination=DcmDspSessionRow  # Reference to a Session Level in which the service is allowed to be executed. Multiple references are allowed for a service. | Please refer to ISO 14229-1, ISO 15031-5 and chapter "Verification of the Diagnostic Session". If there is no reference configured, no diagnostic session verification shall be performed.
            container DcmDsdSubService [0..*]  # This container contains the configuration (DSD parameters) for a subservice of a service. Only those services may have subservices, which have the DcmDsdSidTabSubfuncAvail configured as TRUE. It is not advisable to configure Sub-Functions for RoutineControl Service(0x31).Any DcmDsdSubService configuration for RoutineControl Service(0x31) service will be ignored.
              function name DcmDsdSubServiceFnc [0..1]: multiplicity set at link in variant link-time / pre-compile in variant post-build+pre-compile, set at link in variant link-time / pre-compile in variant post-build+pre-compile  # Callback function of the ECU Supplier specific component for the particular Subservice. The function's prototype is as described for <Module>_<DiagnosticService>_<SubService>. Hint: Dcm_OpStatusType is used instead of Dcm_ExtendedOpStatusType. At the moment this parameter is supported only for the subservice 0x04-TransmitCertificate in Service 0x29-Authentication. For all the other subservices this shall be not configured. For subservices of service 0x19-RDTC, please use the parameter DcmRbDsdSubFuncServHandler. | If this parameter is not configured, the subservice is handled Dcm-internally.
              integer DcmDsdSubServiceId: 0..127, scope=ECU, set at link in variant link-time / pre-compile in variant post-build+pre-compile  # Identifier of the subservice. | The possible subservice identifiers are defined in ISO 14229-1 and ISO 15031-5.
              integer DcmDsdSubServiceRole [0..1]: 0..4294967295, scope=ECU, multiplicity set at link in variant link-time / post-build in variant post-build / pre-compile in variant pre-compile, set at link in variant link-time / post-build in variant post-build / pre-compile in variant pre-compile  # Bitfield were each bit represents one dedicated role. A sub-function of a diagnostic service is granted access if the bit value is 1. If a bit value is 0, the service is not allowed to be executed for that role. If this parameter is not configured and the Service 0x29 (Authentication) is configured, the DcmDspAuthenticationDeauthenticatedRole will be considered for the role verification check so that when role is not configured, the sub-service will be allowed to be executed in all the deauthenticated states.
              boolean DcmDsdSubServiceUsed [0..0]: set at link in variant link-time / post-build in variant post-build / pre-compile in variant pre-compile, default-value=true  # Allows to activate or deactivate the usage of a Subservice. This parameter can be used for multi-purpose ECUs. | true - subservice is available false - subservice is not available.
              function name DcmRbDsdSubFuncServHandler [0..1]: multiplicity set at link in variant link-time / pre-compile in variant post-build+pre-compile, origin=RB:AR42.1.0.0:2017-01-31, set at link in variant link-time / pre-compile in variant post-build+pre-compile  # DcmRbDsdSubFuncServHandler is used for modules configuring SubFuncServHandler for RDTC subfunction outside Dcm module | If it is not configured the sub-service is handled Dcm-internally.
              function name DcmRbDsdSubServiceUserModeRuleFnc [0..1]: multiplicity set at pre-compile, origin=RB:AR42.1.0.0:2017-01-31, set at pre-compile  # Function name used by the application to perform user specific checks on the subfunction.In case the checks fails, NRC value set by the application can be returned to the tester. In case the function is not configured for sub service , the DcmAppl API DcmAppl_UserSubServiceModeRuleService shall be called. | Function name used by the application to perform user specific checks on the subfunction.In case the checks fails, NRC value set by the application can be returned to the tester. In case the function is not configured for sub service, the DcmAppl API DcmAppl_UserSubServiceModeRuleService shall be called.
              reference DcmDsdSubServiceModeRuleRef [0..1]: scope=ECU, multiplicity set at link in variant link-time / pre-compile in variant post-build+pre-compile, set at link in variant link-time / pre-compile in variant post-build+pre-compile, destination=DcmModeRule  # Reference to a DcmDspModeRule which controls the execution of the subservice. | If there is no reference configured, no mode rule check shall be performed.
              reference DcmDsdSubServiceSecurityLevelRef [0..*]: scope=ECU, multiplicity set at link in variant link-time / pre-compile in variant post-build+pre-compile, set at link in variant link-time / pre-compile in variant post-build+pre-compile, destination=DcmDspSecurityRow  # Reference to a Security Level in which the subservice is allowed to be executed. Multiple references are allowed for a subservice. | Please refer to ISO 14229-1, ISO 15031-5 and chapter "Verification of the Service Security Access levels." If there is no reference configured, no subservice security verification shall be performed.
              reference DcmDsdSubServiceSessionLevelRef [0..*]: scope=ECU, multiplicity set at link in variant link-time / pre-compile in variant post-build+pre-compile, set at link in variant link-time / pre-compile in variant post-build+pre-compile, destination=DcmDspSessionRow  # Reference to a Session Level in which the subservice is allowed to be executed. Multiple references are allowed for a subservice. | Please refer to ISO 14229-1, ISO 15031-5 and chapter "Verification of the Diagnostic Session". If there is no reference configured, no diagnostic session verification shall be performed.
      container DcmDsl  # These parameters configure the Diagnostic Session Layer submodule.
        container DcmDslBuffer [1..256]  # This container contains the configuration of a diagnostic buffer.
          integer DcmDslBufferSize: 8..4294967294, scope=ECU, set at pre-compile  # Size of the diagnostic buffer in bytes. | For a linear buffer the size shall be as large as the longest diagnostic message (request or response). For a paged buffer the size has impacts on the application performance.
        container DcmDslCallbackDCMRequestService [0..*]  # Each DcmDslCallbackDCMRequestService container defines an R-Port with the CallbackDCMRequestServices interface which the Dcm uses to ask permission for protocol changes from the application software. The R-Port has the name CallbackDCMRequestServices_<SWC> where <SWC> is the name of this container.
        container DcmDslDiagResp  # This container contains the configuration of the automatic requestCorrectlyReceivedResponsePending response management in the Dcm.
          integer DcmDslDiagRespMaxNumRespPend [0..1]: 0..255, scope=ECU, set at link in variant link-time / pre-compile in variant post-build+pre-compile  # Maximum number of negative responses with response code 0x78 (requestCorrectlyReceivedResponsePending) allowed for a request. If Dcm reaches this limit, an automatic 0x10 (generalReject) final response will be trasmitted and the service processing will be cancelled. Value 0x00 means that no NRC 0x78 response will be transmitted.
          boolean DcmDslDiagRespOnSecondDeclinedRequest: scope=ECU, set at link in variant link-time / pre-compile in variant post-build+pre-compile  # Defines the reaction upon a second request (ClientB) that can not be processed (e.g. due to priority assessment). | TRUE: when the second request (Client B) can not be processed, it shall be answered with NRC21 BusyRepeatRequest. FALSE: when the second request (Client B) can not be processed, it shall not be responded.
        container DcmDslProtocol  # This container contains the configurations of the diagnostic protocols used in Dcm.
          container DcmDslProtocolRow [1..*]  # This container contains the configuration of one particular diagnostic protocol used in Dcm.
            integer DcmDslProtocolMaximumResponseSize [0..1]: 1..65535, scope=ECU, multiplicity set at pre-compile, set at pre-compile, default-value=4095  # This parameter is mandatory and defines the maximum length of the response message in case DcmPagedBufferEnabled == TRUE In case the user leaves the parameter unconfigured, Dcm shall fill the value during generate Id as 4095 for CAN(If CanTpFlexibleDataRateSupport is not configured/ configured as FALSE in CanTp) and as 65535 for other protocols (Flexray, IP,CAN (if CanTpFlexibleDataRateSupport ios configured as TRUE)). Values configured by the user wil be overwritten by Dcm in this case.If paged buffer is enabled and the generated Response for a Request is longer than DcmDslProtocolMaximumResponseSize configured for the active protocol, the Dcm service shall respond with NRC 0x14 (DCM_E_RESPONSETOOLONG).Vendor specific services using paged buffer should also do a check based on this parameter. If paged buffer is disabled and the generated Response for a Request is longer than Dcm_MsgContextType structure element resMaxDataLen, the Dcm shall respond with NRC 0x14 (DCM_E_RESPONSETOOLONG).
            integer DcmDslProtocolPriority: 0..255, scope=ECU, set at link in variant link-time / pre-compile in variant post-build+pre-compile  # Protocol priority used during protocol preemption. A higher priority protocol may preempt a lower priority protocol. If Protocol Premption is required then pduRCancelTransmit and pduRCancelReceive should be enabled | Lower numeric values represent higher protocol priority: 0 - Highest protocol priority 255 - Lowest protocol priority
            boolean DcmDslProtocolRowUsed [0..0]: set at link in variant link-time / post-build in variant post-build / pre-compile in variant pre-compile, default-value=true  # Allows to activate or deactivate the usage of a Protocol. This parameter can be used for multi-purpose ECUs. | true - protocol is available false - protocol is not available.
            enumeration DcmDslProtocolTransType [0..1]: {TYPE1, TYPE2}, scope=ECU, set at link in variant link-time / pre-compile in variant post-build+pre-compile  # This parameter is used only if the protocol is of type DCM_ROE_ON_xxx or DCM_PERIODICTRANS_ON_xxx. It selects the transmission type of the protocol. TYPE1: Messages for ROE or Periodic Transmission uses the DcmTxPduId used for normal diagnostic responses. The outgoing messages must be synchronized with normal outgoing messages, which have a higher priority. TYPE2: Messages for ROE or Periodic Transmission are sent on a separate DcmTxPduId.
            enumeration DcmDslProtocolType: {DCM_OBD_ON_CAN, DCM_OBD_ON_FLEXRAY, DCM_OBD_ON_IP, DCM_OBD_ON_KLINE, DCM_PERIODICTRANS_ON_CAN, DCM_PERIODICTRANS_ON_FLEXRAY, DCM_PERIODICTRANS_ON_IP, DCM_ROE_ON_CAN, DCM_ROE_ON_FLEXRAY, DCM_ROE_ON_IP, DCM_SUPPLIER_1, DCM_SUPPLIER_10, DCM_SUPPLIER_11, DCM_SUPPLIER_12, DCM_SUPPLIER_13, DCM_SUPPLIER_14, DCM_SUPPLIER_15, DCM_SUPPLIER_2, DCM_SUPPLIER_3, DCM_SUPPLIER_4, DCM_SUPPLIER_5, DCM_SUPPLIER_6, DCM_SUPPLIER_7, DCM_SUPPLIER_8, DCM_SUPPLIER_9, DCM_UDS_ON_CAN, DCM_UDS_ON_FLEXRAY, DCM_UDS_ON_IP, DCM_ACEA_ON_CAN, DCM_ACEA_ON_FLEXRAY, DCM_KWP_ON_KLINE, DCM_KWP_ON_CAN, DCM_CARB_ON_KLINE}, scope=ECU, set at pre-compile, symbolic-name-value=true  # The diagnostic protocol type for the DCM DSL protocol that is being configured. | Implementation Type: Dcm_ProtocolType
            integer DcmDspProtocolEcuAddr [0..1]: 0..65535, scope=ECU, set at pre-compile  # Ecu source address used for diagnostic communication. This parameter is required for Generic Connections.
            boolean DcmRbDslProtocolNRC21OnPriorityAssessmentReject [0..1]: multiplicity set at link in variant link-time / post-build in variant post-build / pre-compile in variant pre-compile, origin=RB:AR42.1.0.0:2017-01-31, set at link in variant link-time / post-build in variant post-build / pre-compile in variant pre-compile  # This parameter defines the reaction when a new requests arrives on this protocol, when there is already a request with higher or same priority under processing. TRUE: answer with NRC21 BusyRepeatRequest FALSE: silently ignore the request DcmDslProtocolRows for which DcmRbDslProtocolNRC21OnPriorityAssessmentReject is configured, the Dcm shall consider the parameter DcmRbDslProtocolNRC21OnPriorityAssessmentReject instead of DcmDslDiagRespOnSecondDeclinedRequest for rejection of a second declined request. | TRUE: answer with NRC21 BusyRepeatRequest. FALSE: silently ignore the request
            integer DcmRbMinimumPageSize [0..1]: 8..4294967294, scope=ECU, origin=RB:R22_07:2022-07-31, set at pre-compile  # Configuration of minimum page size for a consecutive page when DcmPagedBufferEnabled == TRUE. The consecutive page will be transmitted as soon as it is filled with the minimum page size. This has should be configured as such to avoid any timeout in the Tps while waiting for the consecutive page to be filled. This should not be greater than the DcmDslBufferSize referenced by the DcmDslProtocolRxBufferRef of this DcmDslProtocolRow. In case the parameter is left unconfigured and DcmPagedBufferEnabled == TRUE, then the DcmDslBufferSize referenced by the DcmDslProtocolRxBufferRef of this DcmDslProtocolRow will be considered as the DcmRbMinimumPageSize
            boolean DcmSendRespPendOnRestart: set at link in variant link-time / pre-compile in variant post-build+pre-compile, default-value=true  # If set to TRUE, the Dcm will send a NRC 0x78 before a transition to bootloader or performing an ECU reset. If set to False, no 0x78 is send in this case.
            float DcmTimStrP2ServerAdjust: 0..1, scope=ECU, set at link in variant link-time / pre-compile in variant post-build+pre-compile  # This parameter is used to guarantee that the diagnostic response is available on the bus before reaching P2 by adjusting the current DcmDspSessionP2ServerMax. | This parameter mainly represents the software architecture dependent communication delay between the time the transmission is initiated by DCM and the time when the message is actually transmitted to the bus. The parameter value is defined in seconds and must be a multiple of DcmTaskTime.
            float DcmTimStrP2StarServerAdjust: 0..5, scope=ECU, set at link in variant link-time / pre-compile in variant post-build+pre-compile  # This parameter is used to guarantee that the diagnostic response is available on the bus before reaching P2Star by adjusting the current DcmDspSessionP2StarServerMax. | This parameter mainly represents the software architecture dependent communication delay between the time the transmission is initiated by DCM and the time when the message is actually transmitted to the bus. The parameter value is defined in seconds and must be a multiple of DcmTaskTime.
            reference DcmDemClientRef [0..1]: scope=ECU, multiplicity set at pre-compile, set at pre-compile, destination=DemClient  # Reference to DemClient in Dem configuration. | Used by the Dem to distinguish different client calls.
            reference DcmDslProtocolRxBufferRef [0..1]: scope=ECU, set at link in variant link-time / pre-compile in variant post-build+pre-compile, destination=DcmDslBuffer  # Reference to a configured diagnostic buffer that is used for diagnostic request reception for the protocol.
            reference DcmDslProtocolSIDTable [0..1]: scope=ECU, set at link in variant link-time / pre-compile in variant post-build+pre-compile, destination=DcmDsdServiceTable  # Reference to a service table that is used for diagnostic request processing for this protocol.
            reference DcmDslProtocolTxBufferRef [0..1]: scope=ECU, set at link in variant link-time / pre-compile in variant post-build+pre-compile, destination=DcmDslBuffer  # Reference to a configured diagnostic buffer that is used for diagnostic response transmission for the protocol.
            choice container DcmDslConnection [1..*]  # This container contains the configuration of a communication channel for one particular protocol. | Note that it is allowed to communicate with multiple testers, therefore multiple connections may be configured for a protocol.
              container DcmDslMainConnection [0..1]  # This container contains the configuration for a main connection of a diagnostic protocol. Additionally it may contain references to ROE and Periodic connections if the protocol type or protocol transmission type needs them.
                integer DcmDslProtocolRxConnectionId: 0..65535, scope=ECU, multiplicity set at pre-compile, set at link in variant link-time / pre-compile in variant post-build+pre-compile, symbolic-name-value=true  # Unique identifier of the tester which uses this connection for diagnostic communication.
                integer DcmDslProtocolRxTesterSourceAddr [0..1]: 0..65535, scope=ECU, multiplicity set at pre-compile, set at link in variant link-time / pre-compile in variant post-build+pre-compile  # Tester source address uniquely describes a client and will be used e.g within the jump to Bootloader interfaces. This parameter is not required for generic connections (DcmPdus with MetaDataLength >= 1).
                reference DcmDslPeriodicTransmissionConRef [0..1]: scope=ECU, multiplicity set at pre-compile, set at link in variant link-time / pre-compile in variant post-build+pre-compile, destination=DcmDslPeriodicTransmission  # Reference to a periodic transmission connection which is used for the processing of periodic transmission events.
                reference DcmDslProtocolComMChannelRef: scope=ECU, set at link in variant link-time / pre-compile in variant post-build+pre-compile, destination=ComMChannel  # Reference to the ComMChannel on which the DcmDslProtocolRxPdu is received and the DcmDslProtocolTxPdu is transmitted.
                reference DcmDslROEConnectionRef [0..1]: scope=ECU, multiplicity set at pre-compile, set at link in variant link-time / pre-compile in variant post-build+pre-compile, destination=DcmDslResponseOnEvent  # Reference to a ResponseOnEvent connection which is used for the processing of ResponseOnEvent events.
                container DcmDslProtocolRx [1..*]  # This container contains the configuration parameters of a reception channel in a diagnostic connection. The following parameters needs to be configured per protocol. Please keep in mind, that the parameter DcmDslProtocolRxPduId can be given several times per protocol and that the combination from DcmDslProtocolRxPduId and DcmDslProtocolRxAddrType is unique. | The PDU referenced by this reception channel can consume meta data items of type SOURCE_ADDRESS_16 and TARGET_ADDRESS_16.
                  enumeration DcmDslProtocolRxAddrType: {DCM_FUNCTIONAL_TYPE, DCM_PHYSICAL_TYPE}, scope=ECU, set at link in variant link-time / pre-compile in variant post-build+pre-compile  # Selects the addressing type of the reception channel. Physical addressing is used for 1:1 communication, functional addressing is used for 1:N communication. | For details refer to ISO 14229-1.
                  integer DcmDslProtocolRxPduId: 0..65535, scope=ECU, set at pre-compile, symbolic-name-value=true  # Identifier of the PDU that is used for this reception channel. The user need not update this field. Instead the user may invoke generateId for Dcm inorder to automatically configure the same.
                  reference DcmDslProtocolRxPduRef: scope=ECU, set at link in variant link-time / pre-compile in variant post-build+pre-compile, destination=Pdu  # Reference to a Pdu in EcuC that is used for this reception channel.
                container DcmDslProtocolTx  # This container contains the configuration parameters of a transmission channel in a diagnostic connection. | The PDU referenced by this transmission channel can produce meta data items of type TARGET_ADDRESS_16 and SOURCE_ADDRESS_16.
                  integer DcmDslTxConfirmationPduId: 0..65535, scope=ECU, set at pre-compile, symbolic-name-value=true  # Identifier of the PDU that is used by the lower level module for transmission confirmation of responses on this channel. The user need not update this field. Instead, the user may invoke generateId for Dcm inorder to automatically configure the same.
                  reference DcmDslProtocolTxPduRef: scope=ECU, set at link in variant link-time / pre-compile in variant post-build+pre-compile, destination=Pdu  # Reference to a Pdu in EcuC that is used for this transmission channel.
              container DcmDslPeriodicTransmission [0..1]  # This container contains the configuration of a periodic transmission connection.
                container DcmDslPeriodicConnection [0..255]: requires-index=true  # This container contains the configuration of a transmission channel for a periodic transmission connection. | The PDU referenced by this transmission channel can produce meta data items of type TARGET_ADDRESS_16 and SOURCE_ADDRESS_16.
                  integer DcmDslPeriodicTxConfirmationPduId: 0..65535, scope=ECU, set at pre-compile, symbolic-name-value=true  # Identifier of the PDU that is used by the lower level module for transmission confirmation of responses on this channel. The user need not update this field. Instead, the user may invoke generateId for Dcm inorder to automatically configure the same.
                  reference DcmDslPeriodicTxPduRef: scope=ECU, set at link in variant link-time / pre-compile in variant post-build+pre-compile, destination=Pdu  # Reference to a Pdu in EcuC that is used for this periodic transmission channel. It is only needed for Type2 Periodic Transmissions configurations.One or several DcmDslPeriodicTxPduRef can be defined if Periodic Transmission is enabled and TYPE2 Periodic Transmissions is configured.DcmDslPeriodicTxPduRef does not need to be defined if Periodic Transmission is not enabled or TYPE1 Periodic Transmissions is configured.
              container DcmDslResponseOnEvent [0..1]  # This container contains the configuration of a ResponseOnEvent connection. | The PDU referenced by this transmission channel can produce meta data items of type TARGET_ADDRESS_16 and SOURCE_ADDRESS_16.
                integer DcmDslRoeTxConfirmationPduId [0..1]: 0..65535, scope=ECU, multiplicity set at pre-compile, set at pre-compile, symbolic-name-value=true  # Identifier of the PDU that is used by the lower level module for transmission confirmation of responses on this connection.
                reference DcmDslRoeTxPduRef [0..1]: scope=ECU, multiplicity set at pre-compile, set at link in variant link-time / pre-compile in variant post-build+pre-compile, destination=Pdu  # Reference to a Pdu in EcuC that is used for this ResponseOnEvent transmission connection (only needed for ROE Transmission Type is TYPE2). One PDU required if ROE Transmission Type is TYPE2. No PDU required if ROE Transmission Type is TYPE1.
            container DcmRbDslKWPTimings [0..1]  # Timings set required for KWP protocol
              float DcmRbP2MaxDefaultTime: 0..4293, origin=RB:AR42.1.0.0:2017-01-31, set at link in variant link-time+post-build / pre-compile in variant pre-compile  # Default time of P2 max (This time activated during the start of communication) in seconds
              float DcmRbP2MaxLimitTime: 0..4293, origin=RB:AR42.1.0.0:2017-01-31, set at link in variant link-time+post-build / pre-compile in variant pre-compile  # Limit time of P2 max (Aceess timing parameter service while changing the ECU timngs cross check the limit by refering this configured value) in seconds
              float DcmRbP3MaxDefaultTime: 0..4293, origin=RB:AR42.1.0.0:2017-01-31, set at link in variant link-time+post-build / pre-compile in variant pre-compile  # Default time of P3 max (This time activated during the start of communication) in seconds
              float DcmRbP3MaxLimitTime: 0..4293, origin=RB:AR42.1.0.0:2017-01-31, set at link in variant link-time+post-build / pre-compile in variant pre-compile  # Limit time of P3 max (Aceess timing parameter service while changing the ECU timngs cross check the limit by refering this configured value) in seconds
        container DcmRbDslKWPSplitResponseFeature [0..1]  # The container to enable/disable the feature of splitting the responses for KWP services. If configured, the split of responses from any service shall be supported for KWP2000 services. If not configured, the split of responses by the services shall be disabled. Based on the configuration of the above container, the compiler switch DCM_CFG_SPLITRESPSUPPORTEDFORKWP shall be generated. This container shall be effective only if there is a KWP protocol configured.
          float DcmRbDslKWPTimeBetweenSplitResponses: 0..4293.0, origin=RB:AR42.1.0.0:2017-01-31, set at link in variant link-time / pre-compile in variant post-build+pre-compile  # The parameter to define the timing between any 2 split responses in seconds. The timing has to be in multiples of DcmTaskTime. This parameter is mandatory if the container DcmRbDslKWPSplitResponseFeature is configured. The value in the parameter shall be generated as DCM_CFG_SPLITRESPONSETIMEFORKWP.
      container DcmDsp [0..1]  # These parameters apply to Diagnostic Service Processing. There will always be one set of these parameters per Dcm. | Please note: Although the multiplicity is set to 0..1. It can be expected that this container exists in any valid DCM configuration.
        boolean DcmDspDDDIDcheckPerSourceDID [0..1]: multiplicity set at link in variant link-time / pre-compile in variant post-build+pre-compile, set at link in variant link-time / pre-compile in variant post-build+pre-compile  # Defines the check for session, security and mode dependencies per source DIDs with a ReadDataByIdentifier (0x22). | true: Dcm module shall check the session, security and mode dependencies per source DIDs with a ReadDataByIdentifier (0x22) with DID in the range 0xF200 to 0xF3FF false: Dcm module shall not check the session, security and mode dependencies per source DIDs with a ReadDataByIdentifier (0x22) with DID in the range 0xF200 to 0xF3FF
        enumeration DcmDspDataDefaultEndianness: {BIG_ENDIAN, LITTLE_ENDIAN, OPAQUE}, set at link in variant link-time / pre-compile in variant post-build+pre-compile  # Defines the default endianness belonging to a DID, RID or PID if the corresponding data does not define an endianness.
        boolean DcmDspEnableObdMirror: scope=ECU, set at link in variant link-time / pre-compile in variant post-build+pre-compile, default-value=false  # DcmDspEnableObdMirror defines whether a DID inside the OBD range (F400-F4FF) and the OBD InfoType range (F800-F8FF) shall get the DID value as defined for OBD on reception of the UDS Service ReadDataByIdentifier (0x22), or not. | It also defines whether a RID inside the OBD range (E000-E0FF) shall handle the RID as defined for OBD on reception of the UDS Service RoutineControl (0x31), or not.
        integer DcmDspMaxDidToRead [0..1]: 1..65535, scope=ECU, multiplicity set at link in variant link-time / pre-compile in variant post-build+pre-compile, set at link in variant link-time / pre-compile in variant post-build+pre-compile  # Indicates the maximum allowed DIDs in a single "ReadDataByIdentifier" request. If not configured then no limitation is applied,i.e,any number of DIDs in the request is supported.
        integer DcmDspMaxPeriodicDidToRead [0..1]: 1..65535, multiplicity set at link in variant link-time / pre-compile in variant post-build+pre-compile, set at link in variant link-time / pre-compile in variant post-build+pre-compile  # Indicates the maximum allowed periodicDIDs which can be read in a single "ReadDataByPeriodicIdentifier" request.
        integer DcmDspPowerDownTime [0..1]: 0..255, scope=ECU, multiplicity set at link in variant link-time / pre-compile in variant post-build+pre-compile, set at link in variant link-time / pre-compile in variant post-build+pre-compile  # This parameter indicates to the client the minimum time of the stand-by sequence the server will remain in the power-down sequence. The resolution of this parameter is one second per count.Values 0x00-0xFE are valid representing 0-254s.The resolution of this parameter is one second per count. The following values are valid: 00 - FE hex: 0 - 254 s powerDownTime; FF hex: indicates a failure or time not available. This value needs to be defined by the integrator according to the ECU capabilities. This parameter has to be available if the service EcuReset, sub-service enableRapidPowerShutDown is configured. | The resolution of this parameter is one second per count. The following values are valid: 00 - FE hex: 0 - 254 s powerDownTime; FF hex: indicates a failure or time not available. This value needs to be defined by the integrator according to the ECU capabilities. This parameter has to be available if the service EcuReset, sub-service enableRapidPowerShutDown is configured.
        boolean DcmRbDspAutoConfigureDEMOBDPIDs [0..1]: multiplicity set at pre-compile, origin=RB:AR42.8.0.0:2020-07-01, set at pre-compile, default-value=false  # If the parameter is configured as TRUE, DCM will forward configuration of DEM relevant OBD Pid's [PID$01,PID$1C,PID$21,PID$30,PID$31,PID$41,PID$4D,PID$4E]. All these pid's are configured only for service$01.Ensure that static configuration doesn't exist for these pid's, otherwise it will result in build error because of multiple configuration.
        boolean DcmRbDspLimitRDBIRespToBufSize [0..1]: multiplicity set at pre-compile, origin=RB:AR42.1.0.0:2017-01-31, set at pre-compile, default-value=false  # Preprocessor switch to enable or disable cut short positive response of RDBI in case if total response length of DID is greater than the available size of DCM response buffer. If set to false, the cutting positive response for RDBI service is disabled i.e., when ever the total response length of DIDs in a request is greater than the available DCM buffer size, the software will simply respond with NRC RESPONSE_TOO_LONG (NRC0x14) IF set to TRUE, the cutting positive response feature for RDBI service is enabled i.e., when the total response length of DIDs in a request is greater than the available DCM buffer size, the software will positively respond to the tester with DIDs which can be accommodated within the available DCM buffer. If the parameter is let unconfigured ,then the FALSE will be considered as the the default value and the if the response length is greater than the DCM buffer size NRC 0x14 will be triggered.
        integer DcmRbDspRdbiPagedBufferPageSize [0..1]: 7..255, scope=ECU, multiplicity set at link in variant link-time / pre-compile in variant post-build+pre-compile, set at link in variant link-time / pre-compile in variant post-build+pre-compile  # This parameter is introduced as part of Issue Reported by Problem 447063. Recommended to use maximum value of TxPduLength of all available TxPDUs where RDBI Paged responses are available. For Example, Standard CAN : 8/7 bytes. CANFD : 62/64 Bytes and so on.
        boolean DcmRbDspRdbiPagedBufferEnabled [0..1]: multiplicity set at pre-compile, origin=RB:AR42.1.0.0:2017-01-31, set at pre-compile, default-value=false  # Vendor specific parameter to enable or disable the support of Paged Buffer for RDBI service. Inorder to support PagedBuffer for RDBI service in addition to this parameter, "DcmPagedBufferEnabled" should also be enabled. When this parameter is set to TRUE RDBI paged buffer support is enabled and the signal size of the DID can be greater than the page size (provided that the use port is configured as USE_RDBI_PAGED_FNC) or the DID should be fit within the page size,based on the configuration of use port of the signal(provided that the use port is configured to any value other than USE_RDBI_PAGED_FNC). When this parameter is set to false or not configured,RDBI paged buffer support is disabled
        boolean DcmRbDspSequenceCheckRequestDownloadDisabled [0..1]: multiplicity set at pre-compile, origin=RB:AR42.1.0.0:2017-01-31, set at pre-compile, default-value=false  # Parameter which decides whether sequence check is enabled or disabled for RequestDownload.If the parameter is set to FALSE , a sequence check shall be done according to the ISO 14229-1 NRC sequence if an RequestDownload request is received if Upload/Download is already active (A previous RequestUpload which is not yet completed with a successful RequestTransferExit request. A negative response with NRC set to 0x22 (ConditionsNotCorrect) shall be send in this case. If the parameter is set to TRUE, no sequence check will be done if a RequestDownload request is received when upload/download is already active.If the parameter is left unconfigured ,then FALSE will be considered as the default value and therefore the sequence check will be enabled..
        boolean DcmRbDspSequenceCheckRequestUploadDisabled [0..1]: multiplicity set at pre-compile, origin=RB:AR42.1.0.0:2017-01-31, set at pre-compile, default-value=false  # Parameter whihc decides whether sequence check is enabled or disabled for RequestUpload.If the parameter is set to FALSE , a sequence check shall be done according to the ISO 14229-1 NRC sequence if an RequestUpload request is received if Upload is already active (A previous RequestUpload which is not yet completed with a successful RequestTransferExit request. A negative response with NRC set to 0x22 (ConditionsNotCorrect) shall be send in this case. If the parameter is set to TRUE, no sequence check will be done if a RequestUpload request is received when upload is already active.If the parameter is left unconfigured ,then FALSE will be considered as the default value and therefore the sequence check will be enabled.
        enumeration DcmRbDspSesSecUsedInProtocol [0..1]: multiplicity set at link in variant link-time+post-build / pre-compile in variant pre-compile, origin=RB:AR42.1.0.0:2017-01-31, set at link in variant link-time+post-build / pre-compile in variant pre-compile, default-value=UDS  # The DcmRbDspSesSecUsedInProtocol is a reference container to DcmDslProtocolRow which uses the Dsp Session and Security Configuration.Configure the protocol that will be using the DcmDspSession and DcmDspSecurity Services. If configured as UDS: UDS protocol shall use the DcmDsp session and security configuration. If configured as KWP: KWP protocol shall use the DcmDsp session and security configuration.
          UDS  # The UDS protocol is using the DcmDsp session and security configuration.
          KWP  # The KWP protocol is using the DcmDsp session and security configuration.
        boolean DcmRbDspTransferDataMaxLenChkRequired [0..1]: multiplicity set at pre-compile, origin=RB:AR42.1.0.0:2017-01-31, set at pre-compile, default-value=true  # Parameter which decides whether the length for TransferData requests/ response following a RequestDownload / RequestUpload needs to be checked against the maxNumberOfBlockLength passed in the RequestUpload/RequestDownload response.If the parameter is configured as TRUE or left unconfigured , Dcm will check if the length for TransferData requests/ response following a RequestDownload / RequestUpload is equal to the parameter maxNumberOfBlockLength passed in response of RequestDownload/RequestUpload service.If the parameter is configured as FALSE, Dcm will not check the length against maxNumberOfBlockLength passed in the RequestUpload/RequestDownload response
        container DcmDspAuthentication [0..1]  # This container contains the configuration for the UDS service Authentication (0x29).
          integer DcmDspAuthenticationDeauthenticatedRole: 1..4294967295, scope=ECU, set at pre-compile  # Role used for service authentication verification in the deauthenticated state.
          float DcmDspAuthenticationDefaultSessionTimeOut [0..1]: 0..4294967295, scope=ECU, multiplicity set at pre-compile, set at pre-compile  # Defines the number of seconds after which the Dcm makes a transition to deauthenticated state, in case of no active communication.
          integer DcmDspAuthenticationGeneralNRC [0..1]: 0..255, scope=ECU, set at pre-compile  # Defines the NRC that shall be send as replacement of all ISO 14229-1 defined NRCs in case of invalid certificate or content.
          integer DcmDspAuthenticationRoleSize: 1..4, scope=ECU, set at pre-compile  # Defines the size in bytes for the role element within a certificate.
          integer DcmDspAuthenticationWhiteListDIDMaxSize [0..1]: 1..255, scope=ECU, set at pre-compile  # Defines the maximum size in bytes for the white list element within a certificate.
          integer DcmDspAuthenticationWhiteListMemorySelectionMaxSize [0..1]: 1..255, scope=ECU, set at pre-compile  # Defines the maximum size in bytes for the white list element within a certificate.
          integer DcmDspAuthenticationWhiteListRIDMaxSize [0..1]: 1..255, scope=ECU, set at pre-compile  # Defines the maximum size in bytes for the white list element within a certificate.
          integer DcmDspAuthenticationWhiteListServicesMaxSize [0..1]: 1..255, scope=ECU, set at pre-compile  # Defines the maximum size in bytes for the white list element within a certificate.
          reference DcmDspAuthenticationGeneralNRCModeRuleRef [0..1]: scope=ECU, multiplicity set at pre-compile, set at pre-compile, destination=DcmModeRule  # Mode rule that defines if the general NRC shall be send for all failures due to invalid certificate or content.
          reference DcmDspAuthenticationPersistStateModeRuleRef [0..1]: scope=ECU, multiplicity set at pre-compile, set at pre-compile, destination=DcmModeRule  # References a mode rule that defines if the authentication state shall be persisted in non-volatile memory.
          container DcmDspAuthenticationConnection [0..*]  # This container contains the authentication configuration use for a dsl connection.
            integer DcmDspAuthenticationEcuChallengeLength: 1..65535, set at pre-compile  # Length in byte of the ECU challenge
            reference DcmDspAuthenticationCertificatePublicKeyStoreJobRef [0..0]: scope=ECU, multiplicity set at pre-compile, set at pre-compile, destination=CsmJob  # Reference to a CsmJob used to store the public key within the Csm.
            reference DcmDspAuthenticationClientChallengeSignJobRef [0..1]: scope=ECU, multiplicity set at pre-compile, set at pre-compile, destination=CsmJob  # Reference to a job used to sign the client challenge. Mandatory only if sub-service 0x02 - verifyCertificateBiDirectional is configured.
            reference DcmDspAuthenticationConnectionCertificateRef: scope=ECU, multiplicity set at pre-compile, set at pre-compile, destination=KeyMCertificate  # Reference to a KeyMCertificate used to store the certificate within the KeyM.
            reference DcmDspAuthenticationConnectionMainConnectionRef: scope=ECU, multiplicity set at pre-compile, set at pre-compile, destination=DcmDslMainConnection  # Reference to the dsl diagnostic connection that uses this authentication configuration.
            reference DcmDspAuthenticationECUCertificateKeyElementRef [0..0]: scope=ECU, multiplicity set at pre-compile, set at pre-compile, destination=CryptoKeyElement  # Reference to a CryptoKeyElement used as server certificate during bi-directional authentication.
            reference DcmDspAuthenticationECUCertificateRef [0..1]: scope=ECU, multiplicity set at pre-compile, set at pre-compile, destination=KeyMCertificate  # Reference to a KeyMCertificate with the server certificate for bi-directional authentication. Mandatory only if sub-service 0x02 - verifyCertificateBiDirectional is configured.
            reference DcmDspAuthenticationPublicKeyElementRef [0..0]: scope=ECU, multiplicity set at pre-compile, set at pre-compile, destination=KeyMCertificateElement  # Reference to a certificate data element with the public key in the certificate.
            reference DcmDspAuthenticationRandomJobRef: scope=ECU, multiplicity set at pre-compile, set at pre-compile, destination=CsmJob  # Reference to a certificate parse job used to parse the authentication certificate.
            reference DcmDspAuthenticationRoleElementRef: scope=ECU, multiplicity set at pre-compile, set at pre-compile, destination=KeyMCertificateElement  # Reference to a certificate data element with the role in the certificate.
            reference DcmDspAuthenticationTargetIdentificationModeRuleRef [0..0]: scope=ECU, multiplicity set at pre-compile, set at pre-compile, destination=DcmModeRule  # Reference to a mode rule that is used to evaluate the target identification.
            reference DcmDspAuthenticationVerifyProofOfOwnerShipClientJobRef: scope=ECU, multiplicity set at pre-compile, set at pre-compile, destination=CsmJob  # Reference to a CsmJob used to verify the proof of ownership client in the Csm.
            reference DcmDspAuthenticationWhiteListDIDElementRef [0..1]: scope=ECU, multiplicity set at pre-compile, set at pre-compile, destination=KeyMCertificateElement  # Reference to a certificate data element with the white list for data identifiers in the certificate.
            reference DcmDspAuthenticationWhiteListMemorySelectionElementRef [0..1]: scope=ECU, multiplicity set at pre-compile, set at pre-compile, destination=KeyMCertificateElement  # Reference to a certificate data element with the white list for user defined memory selection in the certificate.
            reference DcmDspAuthenticationWhiteListRIDElementRef [0..1]: scope=ECU, multiplicity set at pre-compile, set at pre-compile, destination=KeyMCertificateElement  # Reference to a certificate data element with the white list for routine identifiers in the certificate.
            reference DcmDspAuthenticationWhiteListServicesElementRef [0..1]: scope=ECU, multiplicity set at pre-compile, set at pre-compile, destination=KeyMCertificateElement  # Reference to a certificate data element with the white list in the certificate.
          container DcmDspAuthenticationTransmitCertificate [0..*]  # This container contains the authentication configuration for the subfunction trasnmitCertificate.
            integer DcmDspAuthenticationTransmitCertificateEvaluationId: 0..65535, origin=RB:AR45.3.1.0:2022-10-31, set at pre-compile  # Certificate evaluation id.
            reference DcmDspAuthenticationTransmitCertificateRef: scope=ECU, multiplicity set at pre-compile, origin=RB:AR45.3.1.0:2022-10-31, set at pre-compile, destination=KeyMCertificate  # Reference to a KeyMCertificate used to handle the certificate.
        container DcmDspClearDTC [0..1]  # This container contains the configuration for the Clear DTC service.
          function name DcmDspClearDTCCheckFnc [0..1]: scope=ECU, multiplicity set at pre-compile, set at pre-compile  # Callback function for condition check, manufacturer / supplier specific checks on the groupOfDTC, which is requested to clear. | This parameter is related to the interface : Xxx_ClearDTCCheckFnc.
          reference DcmDspClearDTCModeRuleRef [0..1]: scope=ECU, multiplicity set at link in variant link-time / pre-compile in variant post-build+pre-compile, set at link in variant link-time / pre-compile in variant post-build+pre-compile, destination=DcmModeRule  # Reference to DcmModeRule | Mode rule which controls to clear the DTCs. If there is no reference, no check of the mode rule shall be done.
        container DcmDspComControl [0..1]  # Provides the configuration of the CommunicationControl mechanism.
          container DcmDspComControlAllChannel [0..*]  # Collection of ComM channels which shall be controlled if all networks are addressed.
            boolean DcmDspComControlAllChannelUsed [0..0]: set at link in variant link-time / post-build in variant post-build / pre-compile in variant pre-compile, default-value=true  # Allow to activate or deactivate the usage of a ComM channel collection to be controlled, for multi purpose ECUs | true = ComM channel collection used false = ComM channel collection not used
            reference DcmDspAllComMChannelRef: scope=ECU, set at link in variant link-time / post-build in variant post-build / pre-compile in variant pre-compile, destination=ComMChannel  # Reference to ComM channel.
          container DcmDspComControlSetting [0..1]  # Provide the configuration of the Communication control.
            function name DcmRbDspComControlReEnableUserModeRuleFnc [0..1]: multiplicity set at pre-compile, origin=RB:AR42.1.0.0:2017-01-31, set at pre-compile  # Function name used by the application to perform user specific check to verify if communication modes needs to be re-enabled for the channels.In case the checks fails, communication modes shall be re-enabled. In case the function is not configured , the DcmAppl API DcmAppl_UserCommCtrlReEnableModeRuleService shall be called. | Function name used by the application to perform user specific check to verify if communication modes needs to be re-enabled for the channels.In case the checks fails, communication modes shall be re-enabled. In case the function is not configured for sub service, the DcmAppl API DcmAppl_UserCommCtrlReEnableModeRuleService shall be called.
            reference DcmDspComControlCommunicationReEnableModeRuleRef [0..1]: scope=ECU, multiplicity set at link in variant link-time / pre-compile in variant post-build+pre-compile, set at link in variant link-time / pre-compile in variant post-build+pre-compile, destination=DcmModeRule  # Reference to DcmModeRule Mode rule which controls re-enabling of communication by DCM. The DCM module shall call BswM_Dcm_CommunicationMode_CurrentState(DCM_ENABLE_RX_TX_NORM_NM)) in case that the referenced mode rule is not fulfilled anymore. | of communication by DCM. [ref. SWS_Dcm_00753]
          container DcmDspComControlSpecificChannel [0..*]  # Assigns subnet number to ComM channel which will be controlled.
            boolean DcmDspComControlSpecificChannelUsed [0..0]: set at link in variant link-time / post-build in variant post-build / pre-compile in variant pre-compile, default-value=true  # Allow to activate or deactivate the usage of a Subnet assigned to the ComM channel which will be controlled, for multi purpose ECUs. | true = Subnet used false = Subnet not used
            integer DcmDspSubnetNumber: 1..14, scope=ECU, set at pre-compile  # Subnet Number which controls the specific ComMChannel.
            reference DcmDspSpecificComMChannelRef: scope=ECU, set at link in variant link-time / post-build in variant post-build / pre-compile in variant pre-compile, destination=ComMChannel  # Reference to ComM channel.
          container DcmDspComControlSubNode [0..65535]  # This container gives information about the node identification number and the ComM channel used to address a sub-network.
            integer DcmDspComControlSubNodeId: 1..65535, scope=ECU, set at link in variant link-time / pre-compile in variant post-build+pre-compile  # The node identification number DcmDspComControlSubNodeId is addressed by the CommunicationControl (0x28) request.
            boolean DcmDspComControlSubNodeUsed: set at link in variant link-time / post-build in variant post-build / pre-compile in variant pre-compile, default-value=true  # This parameter determines if a node control function is available or not.
            reference DcmDspComControlSubNodeComMChannelRef: scope=ECU, set at link in variant link-time / post-build in variant post-build / pre-compile in variant pre-compile, destination=ComMChannel  # This parameter references a ComM channel where this node is connected to.
        container DcmDspCommonAuthorization [0..*]  # This container contains the configuration (parameters) for the common Authorization being equal for several services / sub-services.
          reference DcmDspCommonAuthorizationModeRuleRef [0..1]: scope=ECU, multiplicity set at link in variant link-time / pre-compile in variant post-build+pre-compile, set at link in variant link-time / pre-compile in variant post-build+pre-compile, destination=DcmModeRule  # Reference to DcmModeRule | Mode rule which controls this service/ sub-service. If there is no reference, no check of the mode rule shall be done.
          reference DcmDspCommonAuthorizationSecurityLevelRef [0..*]: scope=ECU, multiplicity set at link in variant link-time / pre-compile in variant post-build+pre-compile, set at link in variant link-time / pre-compile in variant post-build+pre-compile, destination=DcmDspSecurityRow  # Reference to DcmDspSecurityRow | Security levels allowed to control this service/ sub-service. If there is no reference, no check of security level shall be done.
          reference DcmDspCommonAuthorizationSessionRef [0..*]: scope=ECU, multiplicity set at link in variant link-time / pre-compile in variant post-build+pre-compile, set at link in variant link-time / pre-compile in variant post-build+pre-compile, destination=DcmDspSessionRow  # Reference to DcmDspSessionRow | Sessions allowed to control this service/ sub-service. If there is no reference, no check of session level shall be done.
        container DcmDspControlDTCSetting [0..1]  # Provide the configuration of the ControlDTCSetting mechanism.
          function name DcmRbDspControlDTCSettingReEnableUserModeRuleFnc [0..1]: multiplicity set at pre-compile, origin=RB:AR42.1.0.0:2017-01-31, set at pre-compile  # Function name used by the application to perform user specific check to verify if DTC setting needs to be re-enabled.In case the checks fails, DTC setting shall be re-enabled. In case the function is not configured , the DcmAppl API DcmAppl_UserDTCSettingEnableModeRuleService shall be called.
          boolean DcmSupportDTCSettingControlOptionRecord [0..1]: scope=ECU, multiplicity set at pre-compile, set at pre-compile, default-value=false  # This configuration switch defines if the DTCSettingControlOptionRecord is in general supported in the request message or not.
          reference DcmDspControlDTCSettingReEnableModeRuleRef [0..1]: scope=ECU, multiplicity set at link in variant link-time / pre-compile in variant post-build+pre-compile, set at link in variant link-time / pre-compile in variant post-build+pre-compile, destination=DcmModeRule  # Reference to DcmModeRule | Mode rule which controls re-enabling of controlDTCsetting by DCM. The DCM module shall execute a ControlDTCSetting.Off (call Dem_EnableDTCSetting()) in case that the referenced mode rule is not fulfilled anymore.
        container DcmDspData [0..*]  # This container contains the configuration (parameters) of a Data belonging to a DID
          integer DcmDspDataByteSize [0..1]: 0..65535, scope=ECU, multiplicity set at link in variant link-time / pre-compile in variant post-build+pre-compile, set at link in variant link-time / pre-compile in variant post-build+pre-compile  # Defines the array length in bytes or the the maximum array length for variable datalengths. If DcmDspDataByteSize parameter is configured then the parameter DcmDspDataSize shall not be configured and both parameter shall not be configured at a time, either one of them has to be configured. If DcmDspDataByteSize is configured, then DcmDspDidByteOffset shall be used. If the the parameter DcmDspDataUsePort is configured as USE_DATA_SENDER_RECEIVER/USE_BLOCK_ID, the user need not update this field. Instead the user may invoke generateId for Dcm inorder to automatically configure the same depending on parameter DcmDspDataType/DcmDspDataBlockIdRef->NvMNvBlockLength.respectively
          function name DcmDspDataConditionCheckReadFnc [0..1]: scope=ECU, multiplicity set at pre-compile, set at pre-compile  # Function name to demand application if the conditions (e.g. System state) to read the DID are correct. (ConditionCheckRead-function). | Multiplicity shall be equal to parameter DcmDspDataReadFnc. This parameter is related to the interface Xxx_ConditionCheckRead.
          boolean DcmDspDataConditionCheckReadFncUsed [0..1]: multiplicity set at pre-compile, set at pre-compile  # This parameter determines if a condition check function is available or not.
          function name DcmDspDataEcuSignal [0..0]: scope=ECU, multiplicity set at pre-compile, set at pre-compile  # Function name to control the access to a certain ECU Signal by the DCM. (IoHwAb_Dcm_<symbolic name of ECU signal>-function).
          enumeration DcmDspDataEndianness [0..1]: {BIG_ENDIAN, LITTLE_ENDIAN, OPAQUE}, multiplicity set at link in variant link-time / pre-compile in variant post-build+pre-compile, set at link in variant link-time / pre-compile in variant post-build+pre-compile  # Defines the endianness of the data belonging to a DID in a diagnostic request or response message.
          function name DcmDspDataFreezeCurrentStateFnc [0..1]: scope=ECU, multiplicity set at pre-compile, set at pre-compile  # Function name to request to application to freeze the current state of an IOControl. (FreezeCurrentState-function). | This parameter is related to the interface Xxx_FreezeCurrentState.
          function name DcmDspDataGetScalingInfoFnc [0..0]: scope=ECU, multiplicity set at pre-compile, set at pre-compile  # Function name to request to application the scaling information of the DID. (GetScalingInformation-function). | This parameter is related to the interface Xxxx_GetScalingInformation.
          function name DcmDspDataReadDataLengthFnc [0..1]: scope=ECU, multiplicity set at pre-compile, set at pre-compile  # Function name to request from application the data length of a DID. (ReadDataLength-function). | This parameter is related to the interface Xxx_ReadDataLength.
          function name DcmDspDataReadEcuSignal [0..0]: scope=ECU, multiplicity set at pre-compile, set at pre-compile  # Function name for read access to a certain ECU Signal by the DCM. (IoHwAb_Dcm_Read<EcuSignalName>-function). | Only relevant if DcmDspDataUsePort==USE_ECU_SIGNAL.
          function name DcmDspDataReadFnc [0..1]: multiplicity set at pre-compile, set at pre-compile  # Function name to request from application the data value of a DID. | (ReadData-function). This parameter is related to the interface Xxx_ReadData.
          function name DcmDspDataResetToDefaultFnc [0..1]: scope=ECU, multiplicity set at pre-compile, set at pre-compile  # Function name to request to application to reset an IOControl to default value. (ResetToDefault-function). | This parameter is related to the interface Xxx_ResetToDefault.
          function name DcmDspDataReturnControlToEcuFnc [0..1]: scope=ECU, multiplicity set at pre-compile, set at pre-compile  # Function name to request to application to return control to ECU of an IOControl. (ReturnControlToECU-function). | This parameter is related to the interface Xxx_ReturnControlToECU.
          function name DcmDspDataShortTermAdjustmentFnc [0..1]: scope=ECU, multiplicity set at pre-compile, set at pre-compile  # Function name to request to application to adjust the IO signal. (ShortTermAdjustment-function). | This parameter is related to the interface Xxx_ShortTermAdjustment.
          integer DcmDspDataSize [0..1]: 0..65535, scope=ECU, multiplicity set at link in variant link-time / pre-compile in variant post-build+pre-compile, set at link in variant link-time / pre-compile in variant post-build+pre-compile  # Length of data in bits associated to the Data. If Data has variable datalength, that corresponds to the maximum datalength. If DcmDspDataSize parameter is configured then the parameter DcmDspDataByteSize shall not be configured and both parameter shall not be configured at a time, either one of them has to be configured. If DcmDspDataSize is configred, then DcmDspDidDataPos shall be used. If the the parameter DcmDspDataUsePort is configured as USE_DATA_SENDER_RECEIVER/USE_BLOCK_ID, the user need not update this field. Instead the user may invoke generateId for Dcm inorder to automatically configure the same depending on parameter DcmDspDataType/DcmDspDataBlockIdRef->NvMNvBlockLength.respectively
          enumeration DcmDspDataType: {BOOLEAN, SINT16, SINT16_N, SINT32, SINT32_N, SINT8, SINT8_N, UINT16, UINT16_N, UINT32, UINT32_N, UINT8, UINT8_DYN, UINT8_N}, scope=ECU, set at link in variant link-time / pre-compile in variant post-build+pre-compile  # Provide the implementation data type of data belonging to a DID.
          enumeration DcmDspDataUsePort: {USE_BLOCK_ID, USE_DATA_ASYNCH_CLIENT_SERVER, USE_DATA_ASYNCH_FNC, USE_DATA_SENDER_RECEIVER, USE_DATA_SENDER_RECEIVER_AS_SERVICE, USE_DATA_SYNCH_CLIENT_SERVER, USE_DATA_SYNCH_FNC, USE_DATA_RDBI_PAGED_FNC}, scope=ECU, set at pre-compile  # Defines which interface shall be used to access the data.
          function name DcmDspDataWriteFnc [0..1]: scope=ECU, multiplicity set at pre-compile, set at pre-compile  # Function name to request application to write the data value of a DID. (WriteData-function). | This parameter is related to the interface Xxx_WriteData.
          add info DcmDspOdxDataDescription [0..0]: multiplicity set at pre-compile, set at pre-compile  # Defines additional description for ODX documentation
          string DcmRbDspDataArrayInfoSubElement [0..1]: multiplicity set at link in variant link-time / pre-compile in variant post-build+pre-compile, origin=RB:AR42.2.0.0:2017-07-31, set at link in variant link-time / pre-compile in variant post-build+pre-compile  # String Input which contains the information Sub Array Index for DcmSubElementInImplDataElementInstance or structure type info for DcmSubElementInDataElementInstance. If DcmSubElementInDataElementInstance is configured then this parameter should the structure Type as well as the as the sub-structure type separated by commas: eg: struct Test { uint8 A, uint32 B }; If B is the SubElement required then this parameter must be filled with - Test,B If DcmSubElementInImplDataElementInstance is configured then this parameter should contain the sub array index to be accessed:
          boolean DcmRbDspDataUseAsynchronousServerCallPoint [0..1]: multiplicity set at link in variant link-time+post-build / pre-compile in variant pre-compile, origin=RB:AR42.1.0.0:2017-01-31, set at link in variant link-time+post-build / pre-compile in variant pre-compile, default-value=false  # Only relevant in case DcmDspDataUsePort is set to USE_DATA_ASYNCH_CLIENT_SERVER.This parameter is used to select the type of Server Handling required.Set the value to TRUE for Asynchronous server call point handling else Synchronous server call point handling is carried out
          reference DcmDspDataBlockIdRef [0..1]: scope=ECU, multiplicity set at pre-compile, set at pre-compile, destination=NvMBlockDescriptor  # NRAM blockId to access the data. | Only relevant if DcmDspDataUsePort==USE_BLOCK_ID.
          reference DcmDspDataInfoRef [0..0]: scope=ECU, set at pre-compile, destination=DcmDspDataInfo  # Reference to 1 DcmDspDataInfo
          choice container DcmDspDiagnosisScaling [0..1]  # This container contains the configuration (parameters) of an alternative Diagnosis Representation. Out if this the scaling between Diagnosis and ECU internal representation and vice versa can be calculated.
            container DcmDspAlternativeDataInterface [0..0]  # This container contains the configuration (parameters) of an alternative Diagnosis Representation by the means of a VariableDataPrototoype in a DataInterface. | Additionally a reference to PortInterfaceMapping can be defined which provide already the mapping rules between the VariableDataPrototoype in a DataInterface used by the software component (DcmDspExternalSRDataElementClass) and the intended Diagnosis Representation defined by DcmDataElement.
              foreign reference DcmDataElement [0..0]: set at pre-compile, destination-type=VARIABLE-DATA-PROTOTYPE  # Alternative Diagnosis Representation for the data defined by the means of a VariableDataPrototoype in a DataInterface. | The CompuMethod of the data type of the referenced VariableDataPrototype will be applied to the data type of the VariableDataPrototype in the interface used by the Dcm.
              foreign reference DcmPortInterfaceMapping [0..0]: multiplicity set at pre-compile, set at pre-compile, destination-type=PORT-INTERFACE-MAPPING  # Optional reference to PortInterfaceMapping which defines the mapping rules. | The PortInterfaceMapping is used to get the DataPrototypeMapping that describes a conversion between the data prototype referenced by DcmDataElement and the data prototype referenced from DcmDspExternalSRDataElementClass.
            container DcmDspAlternativeDataType [0..1]  # This container contains the configuration (parameters) of an alternative Diagnosis Representation by the means of an ApplicationDataType. | Additionally the definition of a text table mapping can be a defined for ApplicationDataTypes with a CompuMethod of category TEXTTABLE and SCALE_LINEAR_AND_TEXTTABLE.
              foreign reference DcmApplicationDataType: set at pre-compile, destination-type=APPLICATION-DATA-TYPE  # Alternative Diagnosis Representation for the data defined by the means of a ApplicationDataType of category VALUE, BOOLEAN or ARRAY. | The CompuMethod that applies to the referenced ApplicationDataType in case of category VALUE or BOOLEAN will be applied to the data type of the VariableDataPrototype in the interface used by the Dcm.
              container DcmDspTextTableMapping [0..*]  # The purpose of the DcmDspTextTableMapping is to associate a texttable value defined in the context of the Dcm to a texttable value defined in the context of a CompuMethod referenced by a DataType that shall be taken to create a dataElement in a SenderReceiverInterface. By this means it is possible to create a primitive version of a TexttableMapping (which can only be applied if a dataElement already exists). | In other words, the DcmDspTextTableMapping provides a similar mechanism to the TexttableMapping in a situation where the TexttableMapping cannot be applied since the SenderReceiverInterface for the PortPrototype on the Dcm ServiceComponent does not yet exist.
                integer DcmDspDiagnosisRepresentationDataValue: 0..18446744073709551615, scope=ECU, set at pre-compile  # The data value in the diagnosis representation.
                integer DcmDspInternalDataValue: 0..18446744073709551615, scope=ECU, set at pre-compile  # The ECU internal data value.
            container DcmDspAlternativeDiagnosticDataElement [0..0]  # This container contains the configuration (parameters) of an alternative Diagnosis Representation by the means of Diagnostic Extract.
              foreign reference DcmDspDiagnosticDataElementRef [0..0]: set at pre-compile, destination-type=DIAGNOSTIC-DATA-ELEMENT  # Alternative Diagnosis Representation for the data defined by the means of a DiagnosticDataElement in the Diagnostic Extract. | This EcucForeignReference enables the access to all SwDataDefProps, in particular BaseType, CompuMethod and DataConstr The CompuMethod and DataConstr that applies to the referenced DiagnosticDataElement will be applied to the data type of the VariableDataPrototype in the interface used by the Dcm. The mapped ImplementationDataType needs to match the given BaseType.
            container DcmDspAlternativeDataProps [0..1]  # This container contains the configuration (parameters) of an alternative Diagnosis Representation by the means of ECU configuration parameters. | The physical unit of the alternative data representation is defined by the DataPrototype referenced by DcmDspExternalSRDataElementClass. Additionally the definition of a text table mapping can be a defined for DcmDspDataTypeCategory TEXTTABLE and SCALE_LINEAR_AND_TEXTTABLE
              enumeration DcmDspDataTypeCategory [0..0]: {LINEAR, SCALE_LINEAR_AND_TEXTTABLE, TEXTTABLE}, scope=ECU, set at pre-compile, with-auto=true  # Data category of the alternative Diagnosis Representation.
              container DcmDspLinearScale [0..1]  # This container contains the configuration (parameters) of an linear scale of the alternative Diagnosis Representation.
                float DcmDspDiagnosisRepresentationDataLowerRange: -Inf..Inf, scope=ECU, set at pre-compile  # Lower Range for this scale of the data in the alternative Diagnosis Representation.
                float DcmDspDiagnosisRepresentationDataOffset: 0..Inf, scope=ECU, set at pre-compile, default-value=0  # Data offset of the alternative Diagnosis Representation for this scale.
                float DcmDspDiagnosisRepresentationDataResolution: 0..Inf, scope=ECU, set at pre-compile  # Data resolution of the alternative Diagnosis Representation for this scale.
                float DcmDspDiagnosisRepresentationDataUpperRange: -Inf..Inf, scope=ECU, set at pre-compile  # Upper Range for this scale of the data in the alternative Diagnosis Representation.
              container DcmDspTextTableMapping [0..0]  # This container contains the configuration (parameters) of the mapping a DataPrototype typed by AutosarDataType that refer to a CompuMethods of category TEXTTABLE or SCALE_LINEAR_AND_TEXTTABLE. | Each DcmDspTextTableMapping defines a value pair which is used to map the ECU internal value (DcmDspInternalDataValue) to the vale used in the diagnosis representation (DcmDspDiagnosisRepresentationDataValue) and vice versa. The set of all DcmDspTextTableMappings defines the whole mapping of an data.
                integer DcmDspDiagnosisRepresentationDataValue [0..0]: 0..18446744073709551615, scope=ECU, set at pre-compile  # The data value in the diagnosis representation.
                integer DcmDspInternalDataValue [0..0]: 0..18446744073709551615, scope=ECU, set at pre-compile, with-auto=true  # The ECU internal data value.
          container DcmDspDidDataSupportInfo [0..1]  # This container defines the supported information.
            integer DcmDspDidDataSupportInfoBit: 0..255, scope=ECU, set at link in variant link-time / pre-compile in variant post-build+pre-compile  # Referenced Bit of the SupportInfo
            reference DcmDspDidDataSupportInfoRef: scope=ECU, multiplicity set at link in variant link-time / pre-compile in variant post-build+pre-compile, set at link in variant link-time / pre-compile in variant post-build+pre-compile, destination=DcmDspDidSupportInfo  # Reference to DcmDspDidSupportInfo
          choice container DcmDspExternalSRDataElementClass [0..1]  # This container defines the source of data in a provided port which shall be read respectively the target of data in a required port which shall be written. | This container shall contain either one DcmSubElementInDataElementInstance OR DcmDataElementInstance OR DcmSubElementInImplDataElementInstance reference.
            container DcmDataElementInstance [0..1]  # Instance Reference to the primitive data in a port where the data element is typed with an ApplicationPrimitveDataType or an ImplementationDataType.
              instance reference DcmDataElementInstanceRef: set at pre-compile, destination-context=ROOT-SW-COMPOSITION-PROTOTYPE SW-COMPONENT-PROTOTYPE PORT-PROTOTYPE, destination-type=AUTOSAR-DATA-PROTOTYPE  # Instance Reference to the primitive or array data which shall be read or written. | Supported are VariableDataPrototypes in SenderReceiverInterfaces and NvDataInterfaces and ParameterDataPrototypes in ParameterInterfaces (read only). This reference is applicable if the AutosarDataPrototype is typed with a ApplicationPrimitiveDataType of category VALUE or BOOLEAN or ApplicationArrayDataType or if the AutosarDataPrototype is typed with a ImplementationDataType of category VALUE, ARRAY or TYPE_REFERENCE that in turn boils down to VALUE or ARRAY
            container DcmSubElementInDataElementInstance [0..1]  # Instance Reference to the primitve sub-element (at any level) of composite data in a port where the data element is typed with an ApplicationCompositeDataType.
              instance reference DcmSubElementInDataElementInstanceRef: set at pre-compile, destination-context=ROOT-SW-COMPOSITION-PROTOTYPE SW-COMPONENT-PROTOTYPE PORT-PROTOTYPE AUTOSAR-DATA-PROTOTYPE APPLICATION-COMPOSITE-ELEMENT-DATA-PROTOTYPE*, destination-type=APPLICATION-COMPOSITE-ELEMENT-DATA-PROTOTYPE  # Instance Reference to the primitve sub-element (at any level) of composite data in a port which shall be read. | Supported are VariableDataPrototypes in SenderReceiverInterfaces and NvDataInterfaces and ParameterDataPrototypes in ParameterInterfaces (read only). This reference is applicable if the AutosarDataPrototype is typed with a ApplicationCompositeDataType. Note: One or more class attributes are too long to display. Please refer to diagram INTERNAL_DcmDspSRData for the class attributes.
            container DcmSubElementInImplDataElementInstance [0..1]  # Instance Reference to the primitve sub-element (at any level) of composite data in a port where the data element is typed with an ImplementationDataType.
              instance reference DcmSubElementInImplDataElementInstanceRef: set at pre-compile, destination-context=ROOT-SW-COMPOSITION-PROTOTYPE SW-COMPONENT-PROTOTYPE PORT-PROTOTYPE AUTOSAR-DATA-PROTOTYPE IMPLEMENTATION-DATA-TYPE-ELEMENT*, destination-type=IMPLEMENTATION-DATA-TYPE-ELEMENT  # Instance Reference to the primitve sub-element (at any level) of composite data in a port which shall be read. | Supported are VariableDataPrototypes in SenderReceiverInterfaces and NvDataInterfaces and ParameterDataPrototypes in ParameterInterfaces (read only). This reference is applicable if the AutosarDataPrototype is typed with a ImplementationDataType of category STRUCTURE or ARRAY. Please note that in case of ARRAY the index attribute in the target reference has to be set to select a single array element. Note: One or more class attributes are too long to display. Please refer to diagram INTERNAL_DcmDspSRData for the class attributes.
        container DcmDspDataInfo [0..0]  # This container contains the configuration (parameters) of one Data.
          integer DcmDspDataScalingInfoSize [0..0]: 0..4294967295, scope=ECU, multiplicity set at link in variant link-time / pre-compile in variant post-build+pre-compile, set at link in variant link-time / pre-compile in variant post-build+pre-compile  # If Scaling information service is available for this Data, it provides the size in bytes of the scaling information.
        container DcmDspDid [0..*]  # This container contains the configuration (parameters) of the DID.
          integer DcmDspDidIdentifier: 0..65535, scope=ECU, set at link in variant link-time / pre-compile in variant post-build+pre-compile  # 2 byte Identifier of the DID | Within each DcmConfigSet all DcmDspDidIdentifier values shall be unique.
          integer DcmDspDidSize [0..1]: 0..65535, scope=ECU, set at link in variant link-time / pre-compile in variant post-build+pre-compile  # Length of a DID in byte(s).
          enumeration DcmDspDidUsePort: {USE_ATOMIC_NV_DATA_INTERFACE, USE_ATOMIC_SENDER_RECEIVER_INTERFACE, USE_ATOMIC_SENDER_RECEIVER_INTERFACE_AS_SERVICE, USE_DATA_ELEMENT_SPECIFIC_INTERFACES}, set at pre-compile, default-value=USE_DATA_ELEMENT_SPECIFIC_INTERFACES  # Selects application interface type for DID data elements between a single operation for all data elements or data element specific operations.
          boolean DcmDspDidUsed [0..0]: scope=ECU, set at link in variant link-time / post-build in variant post-build / pre-compile in variant pre-compile  # Allow to activate or deactivate the usage of a DID, for multi purpose ECUs | true = DID available false = DID not available
          boolean DcmRbAtomicSenderReceiverCommunication: multiplicity set at link in variant link-time+post-build / pre-compile in variant pre-compile, origin=RB:AR42.7.0.0:2019-11-19, set at link in variant link-time+post-build / pre-compile in variant pre-compile, default-value=false  # This parameter is used to select the type of communication required.Set the value to TRUE for Atomic SenderReceiver communication else regular SenderReceiver communication will be carried out
          function name DcmRbDspIsDIDAvailableFnc [0..1]: multiplicity set at pre-compile, origin=RB:AR42.1.0.0:2017-01-31, set at pre-compile  # Function name to request the application to check if the DID requested is supported in the variant.The user can leave the field empty if the check is not required for this DID
          reference DcmDspDidBndMBlockIdRef [0..0]: scope=ECU, multiplicity set at pre-compile, set at pre-compile, destination=BndMBlockDescriptor  # Associate this DID with a BndM blockId. Tags: atp.Status=draft
          reference DcmDspDidInfoRef: scope=ECU, set at link in variant link-time / pre-compile in variant post-build+pre-compile, destination=DcmDspDidInfo  # Reference to DcmDspDidInfo containing information on this DID.
          reference DcmDspDidRef [0..0]: scope=ECU, multiplicity set at link in variant link-time / pre-compile in variant post-build+pre-compile, requires-index=true, set at link in variant link-time / pre-compile in variant post-build+pre-compile, destination=DcmDspDid  # Reference to DcmDspDid in case this DID refer to one or serveral other DID's
          container DcmDspDidExtRoe [0..1]  # Provide information to manage a responseOnEvent request on this DID externally. If this container doesn't exist, an ROE event on this DID will be managed internally.In RTA-BSW DCM internally managed DIDs are not supported, if the projects want monitoring of DID as per Autosar 4.0.2, then it is mandatory to configure the DcmDspDidExtRoe | The R-Port for ROEServices interface is named ROEServices_<SWC> where <SWC> is the name of this container.
            function name DcmDspDidRoeActivateFnc [0..1]: multiplicity set at link in variant link-time / pre-compile in variant post-build+pre-compile, set at link in variant link-time / pre-compile in variant post-build+pre-compile  # Function name to activate/deactivate an ROE event managed externally.This parameter is related to the interface xxx_ActivateEvent.This parameter is to be configured mandatorily if atleast one of the signal of the DID is of the following DcmDspDataUsePort==USE_DATA_SYNCH_FNC/USE_DATA_ASYNCH_FNC/USE_BLOCK_ID. IF all the signals of the DID are set to ===USE_DATA_SENDER_RECEIVER/USE_DATA_ASYNCH_CLIENT_SERVER/USE_DATA_SYNCH_CLIENT_SERVER | Only relevant if DcmDspDataUsePort== USE_DATA_SYNCH_FNC/USE_DATA_ASYNCH_FNC. This parameter is related to the interface xxx_ActivateEvent.
            integer DcmDspDidRoeEventId: 0..255, set at link in variant link-time / pre-compile in variant post-build+pre-compile  # EventId to be used within Apis Dcm_TriggerOnEvent() and xxx_ActivateEvent()
          container DcmDspDidSignal [0..*]  # This container defines the reference to 1 DcmDspData container and position relevant for this DID.
            integer DcmDspDidByteOffset [0..1]: 0..65535, scope=ECU, set at link in variant link-time / pre-compile in variant post-build+pre-compile  # Defines the absolute byte offset of the data defined by DcmDspDidDataRef reference to DcmDspData container in the DID.
            integer DcmDspDidDataPos [0..1]: 0..65535, scope=ECU, set at link in variant link-time / pre-compile in variant post-build+pre-compile  # Defines the position of the data defined by DcmDspDidDataRef reference to DcmDspData container in the DID. | The position is defined in bits.
            reference DcmDspDidDataRef: scope=ECU, set at link in variant link-time / pre-compile in variant post-build+pre-compile, destination=DcmDspData  # Reference to 1 DcmDspData container relevant for this DID.
          container DcmDspDidSupportInfo [0..1]  # This container defines the support information to declare the usability of the data bytes within the DIDs
            integer DcmDspDidSupportInfoLen: 0..255, scope=ECU, set at link in variant link-time / pre-compile in variant post-build+pre-compile  # Length of the support information in bytes.
            integer DcmDspDidSupportInfoPos: 0..255, scope=ECU, set at link in variant link-time / pre-compile in variant post-build+pre-compile  # Length of the support information in bytes.
        container DcmDspDidInfo [0..*]  # This container contains the configuration (parameters) of the DID's Info
          integer DcmDspDDDIDMaxElements [0..1]: 1..255, multiplicity set at link in variant link-time / pre-compile in variant post-build+pre-compile, set at link in variant link-time / pre-compile in variant post-build+pre-compile  # Maximum number of source elements of a DDDID.
          boolean DcmDspDidDynamicallyDefined: scope=ECU, set at link in variant link-time / pre-compile in variant post-build+pre-compile  # Indicates if this DID can be dynamically defined | true = DID can be dynamically defined false = DID can not be dynamically defined
          container DcmDspDidControl [0..1]  # This container contains the configuration (parameters) of the DID control.
            enumeration DcmDspDidControlMask: {DCM_CONTROLMASK_EXTERNAL, DCM_CONTROLMASK_INTERNAL, DCM_CONTROLMASK_NO}, scope=ECU, set at pre-compile, default-value=DCM_CONTROLMASK_INTERNAL  # This indicates the presence of "controlEnableMask" in SWC service interfaces and defines how the Dcm treats a service request.
            integer DcmDspDidControlMaskSize [0..1]: 1..4294967294, scope=ECU, set at pre-compile  # The value defines the size of the controlEnableMaskRecord in bytes.
            integer DcmDspDidControlRole [0..1]: 0..4294967295, scope=ECU, multiplicity set at link in variant link-time / post-build in variant post-build / pre-compile in variant pre-compile, set at link in variant link-time / post-build in variant post-build / pre-compile in variant pre-compile  # Bitfield were each bit represents one dedicated role. A DID is granted IOcontrol access if the bit value is 1. If a bit value is 0, the DID is not allowed to be controlled for that role. If this parameter is not configured and the Service 0x29 (Authentication) is configured, the DcmDspAuthenticationDeauthenticatedRole will be considered for the role verification check so that when role is not configured, the DID control will be allowed to be executed in all the deauthenticated states.
            boolean DcmDspDidFreezeCurrentState: scope=ECU, set at pre-compile  # This indicates the presence of "FreezeCurrentState".
            boolean DcmDspDidResetToDefault: scope=ECU, set at pre-compile  # This indicates the presence of "ResetToDefault".
            boolean DcmDspDidShortTermAdjustment: scope=ECU, set at pre-compile  # This indicates the presence of "ShortTermAdjustment".
            function name DcmRbDspDidControlUserModeRuleFnc [0..1]: multiplicity set at pre-compile, origin=RB:AR42.1.0.0:2017-01-31, set at pre-compile  # Function name used by the application to perform user specific checks before IO Control of a DID.In case the checks fails, NRC value set by the application can be returned to the tester. In case the function is not configured for DID Control, the DcmAppl API DcmAppl_UserDIDModeRuleService shall be called.
            boolean DcmRbDspIoCtrlResetOnSessSecurityChange [0..1]: multiplicity set at pre-compile, origin=RB:AR42.1.0.0:2017-01-31, set at pre-compile, default-value=true  # Indicates if resetting of IOControl on session / security change is enabled / disabled. | True = IOcontrol on session / security change is enabled False = IOcontrol on session / security change is disabled
            reference DcmDspDidControlModeRuleRef [0..1]: scope=ECU, multiplicity set at link in variant link-time / pre-compile in variant post-build+pre-compile, set at link in variant link-time / pre-compile in variant post-build+pre-compile, destination=DcmModeRule  # Reference to DcmModeRule | Mode rule which controls this DID. If there is no reference, no check of the mode rule shall be done.
            reference DcmDspDidControlSecurityLevelRef [0..*]: scope=ECU, multiplicity set at link in variant link-time / pre-compile in variant post-build+pre-compile, set at link in variant link-time / pre-compile in variant post-build+pre-compile, destination=DcmDspSecurityRow  # Reference to DcmDspSecurityRow | Security levels allowed to control this DID. If there is no reference, no check of security level shall be done.
            reference DcmDspDidControlSessionRef [0..*]: scope=ECU, multiplicity set at link in variant link-time / pre-compile in variant post-build+pre-compile, set at link in variant link-time / pre-compile in variant post-build+pre-compile, destination=DcmDspSessionRow  # Reference to DcmDspSessionRow | Sessions allowed to control this DID. If there is no reference, no check of session level shall be done.
            container DcmDspDidControlEnableMask [0..32]  # The shortname of the container value defines the symbol of the controlMask.
              integer DcmDspDidControlMaskBitPosition: 0..31, scope=ECU, set at pre-compile  # Defines the position of the bit in the controlMask starting. The counting order is from the most significant bit (MSB first) to least significant bit. A value of 0 identifies the most significant bit in the MSB of the control enable mask. A value of 0 represents also the first controlState parameter. | The bit endianness is identical to the controlMask in UDS. The number of possible and available bits is given by DcmDspDidControlMaskSize.
          container DcmDspDidRead [0..1]  # This container contains the configuration (parameters) of the DID read.
            integer DcmDspDidReadRole [0..1]: 0..4294967295, scope=ECU, multiplicity set at link in variant link-time / post-build in variant post-build / pre-compile in variant pre-compile, set at link in variant link-time / post-build in variant post-build / pre-compile in variant pre-compile  # Bitfield were each bit represents one dedicated role. A DID is granted read access if the bit value is 1. If a bit value is 0, the DID is not allowed to be read for that role. If this parameter is not configured and the Service 0x29 (Authentication) is configured, the DcmDspAuthenticationDeauthenticatedRole will be considered for the role verification check so that when role is not configured, the DID Read will be allowed to be executed in all the deauthenticated states. | Reading DIDs is possible by different UDS services. This setting applies to all possible DID read operations.
            function name DcmRbDspDidReadUserModeRuleFnc [0..1]: multiplicity set at pre-compile, origin=RB:AR42.1.0.0:2017-01-31, set at pre-compile  # Function name used by the application to perform user specific checks before Reading a DID.In case the checks fails, NRC value set by the application can be returned to the tester. In case the function is not configured for DID Read, the DcmAppl API DcmAppl_UserDIDModeRuleService shall be called.
            reference DcmDspDidReadModeRuleRef [0..1]: scope=ECU, multiplicity set at link in variant link-time / pre-compile in variant post-build+pre-compile, set at link in variant link-time / pre-compile in variant post-build+pre-compile, destination=DcmModeRule  # Reference to DcmModeRule | Mode rule which controls to read this DID. If there is no reference, no check of the mode rule shall be done.
            reference DcmDspDidReadSecurityLevelRef [0..*]: scope=ECU, multiplicity set at link in variant link-time / pre-compile in variant post-build+pre-compile, set at link in variant link-time / pre-compile in variant post-build+pre-compile, destination=DcmDspSecurityRow  # Reference to DcmDspSecurityRow Referenced security levels are allowed to read this DID. | If there is no reference, no check of security level shall be done.
            reference DcmDspDidReadSessionRef [0..*]: scope=ECU, multiplicity set at link in variant link-time / pre-compile in variant post-build+pre-compile, set at link in variant link-time / pre-compile in variant post-build+pre-compile, destination=DcmDspSessionRow  # Reference to DcmDspSessionRow Referenced sessions are allowed to read this DID. | If there is no reference, no check of session level shall be done.
          container DcmDspDidWrite [0..1]  # This container contains the configuration (parameters) of the DID write.
            integer DcmDspDidWriteRole [0..1]: 0..4294967295, scope=ECU, multiplicity set at link in variant link-time / post-build in variant post-build / pre-compile in variant pre-compile, set at link in variant link-time / post-build in variant post-build / pre-compile in variant pre-compile  # Bitfield were each bit represents one dedicated role. A DID is granted write access if the bit value is 1. If a bit value is 0, the DID is not allowed to be written for that role. If this parameter is not configured and the Service 0x29 (Authentication) is configured, the DcmDspAuthenticationDeauthenticatedRole will be considered for the role verification check so that when role is not configured, the DID Write will be allowed to be executed in all the deauthenticated states.
            function name DcmRbDspDidWriteUserModeRuleFnc [0..1]: multiplicity set at pre-compile, origin=RB:AR42.1.0.0:2017-01-31, set at pre-compile  # Function name used by the application to perform user specific checks before writing a DID.In case the checks fails, NRC value set by the application can be returned to the tester. In case the function is not configured for DID Write, the DcmAppl API DcmAppl_UserDIDModeRuleService shall be called.
            reference DcmDspDidWriteModeRuleRef [0..1]: scope=ECU, multiplicity set at link in variant link-time / pre-compile in variant post-build+pre-compile, set at link in variant link-time / pre-compile in variant post-build+pre-compile, destination=DcmModeRule  # Reference to DcmModeRule | Mode rule which controls to write this DID. If there is no reference, no check of the mode rule shall be done.
            reference DcmDspDidWriteSecurityLevelRef [0..*]: scope=ECU, multiplicity set at link in variant link-time / pre-compile in variant post-build+pre-compile, set at link in variant link-time / pre-compile in variant post-build+pre-compile, destination=DcmDspSecurityRow  # Reference to DcmDspSecurityRow Referenced security levels are allowed to wirte this DID. | If there is no reference, no check of security level shall be done.
            reference DcmDspDidWriteSessionRef [0..*]: scope=ECU, multiplicity set at link in variant link-time / pre-compile in variant post-build+pre-compile, set at link in variant link-time / pre-compile in variant post-build+pre-compile, destination=DcmDspSessionRow  # Reference to DcmDspSessionRow Referenced sessions are allowed to write this DID. | If there is no reference, no check of session level shall be done.
        container DcmDspDidRange [0..*]  # This container defines the DID Range
          boolean DcmDspDidRangeHasGaps: scope=ECU, set at link in variant link-time / pre-compile in variant post-build+pre-compile  # Parameter specifying if there are gaps in the DID range (parameter set to TRUE) or not (parameter set to FALSE)
          integer DcmDspDidRangeIdentifierLowerLimit: 0..65535, scope=ECU, set at link in variant link-time / pre-compile in variant post-build+pre-compile  # Lower limit of DID range.
          integer DcmDspDidRangeIdentifierUpperLimit: 0..65535, scope=ECU, set at link in variant link-time / pre-compile in variant post-build+pre-compile  # Upper limit of DID range.
          function name DcmDspDidRangeIsDidAvailableFnc [0..1]: scope=ECU, multiplicity set at pre-compile, set at pre-compile  # Function name to request from application if a specific DID is available within the range or not. | Only relevant if DcmDspDidRangeUsePort is set to false. This parameter is related to the interface Xxx_IsDidAvailable.
          integer DcmDspDidRangeMaxDataLength: 0..65535, scope=ECU, set at link in variant link-time / pre-compile in variant post-build+pre-compile  # Maximum data length in bytes
          function name DcmDspDidRangeReadDataLengthFnc [0..1]: scope=ECU, multiplicity set at pre-compile, set at pre-compile  # Function name to request from application the length of the data of a range DID. | Only relevant if DcmDspDidRangeUsePort is set to false. This parameter is related to the interface Xxx_ReadDidRangeDataLength.
          function name DcmDspDidRangeReadDidFnc [0..1]: scope=ECU, multiplicity set at pre-compile, set at pre-compile  # Function name to request from application the data range value of a DID.(ReadData-function). | Only relevant if DcmDspDidRangeUsePort is set to false. This parameter is related to the interface Xxx_ReadDidData.
          boolean DcmDspDidRangeUsePort: scope=ECU, set at pre-compile  # When the parameter DcmDspDidRangeUsePort is set to true the DCM will access the Data using an R-Port requiring a PortInteface DataServices_DIDRange. In that case, DcmDspDidRangeIsDidAvailableFnc, DcmDspDidRangeReadDidFnc and DcmDspDidRangeWriteDidFnc are ignored and the RTE APIs are used. When the parameter DcmDspDidRangeUsePort is false, the DCM calls the functions defined in DcmDspDidRangeIsDidAvailableFnc, DcmDspDidRangeReadDidFnc and DcmDspDidRangeWriteDidFnc.
          function name DcmDspDidRangeWriteDidFnc [0..1]: scope=ECU, multiplicity set at pre-compile, set at pre-compile  # Function name to request application to write the data range value of a DID.(WriteData-function). | Only relevant if DcmDspDidRangeUsePort is set to false. This parameter is related to the interface Xxx_WriteDidData.
          reference DcmDspDidRangeInfoRef: scope=ECU, set at link in variant link-time / pre-compile in variant post-build+pre-compile, destination=DcmDspDidInfo  # Reference to DcmDspDidInfo containing information on this DID Range.
        container DcmDspEcuReset [0..0]  # This container contains the configuration for DcmDspEcuReset service
          container DcmDspEcuResetRow [0..0]  # This container contains the configuration for each DcmDspEcuReset subservice.
            integer DcmDspEcuResetId [0..0]: 0..127, scope=ECU, multiplicity set at link in variant link-time / pre-compile in variant post-build+pre-compile, set at link in variant link-time / pre-compile in variant post-build+pre-compile  # Defines the subfunction ID
            enumeration DcmResponseToEcuReset [0..0]: {AFTER_RESET, BEFORE_RESET}, scope=ECU, set at pre-compile  # Defines the answer to EcuReset service should come: Before or after the reset.
        container DcmDspMemory [0..1]  # This container contains the configuration of the memory access.
          container DcmDspAddressAndLengthFormatIdentifier [0..0]  # This container contains the configuration of the supported AddressAndLengthFormatIdentifiers for memory access.
            integer DcmDspSupportedAddressAndLengthFormatIdentifier [0..0]: 0..255, scope=ECU, multiplicity set at link in variant link-time / pre-compile in variant post-build+pre-compile, set at link in variant link-time / pre-compile in variant post-build+pre-compile  # This parameter defines the supported AddressAndLengthFormatIdentifier of the request message.
          container DcmDspMemoryIdInfo [1..*]  # Provides the value of memory identifier used to select the desired memory device | This container contains the configuration of the memory access requested through diagnostic services : ReadMemoryByAddress, WriteMemoryByAddress, and DynamicallyDefineDataIdentifier
            integer DcmDspMemoryIdValue [0..1]: 0..255, scope=ECU, multiplicity set at link in variant link-time / pre-compile in variant post-build+pre-compile, set at link in variant link-time / pre-compile in variant post-build+pre-compile  # Value of the memory device identifier used. | Each DcmDspMemoryIdInfo should have a unique ID. The MemoryIdValue is retrieved from the request messages (RMBA,WMBA,RD,RU,DDDI) according to ISO-14229-1 with the most significant byte of the request parameter memoryAddress.
            container DcmDspReadMemoryRangeByLabelInfo [0..*]  # Provides a memory range allowed for reading via labels (lower and higher address configured as strings).
              string DcmDspReadMemoryRangeByLabelHigh: set at pre-compile  # High memory address as label (string) of a range allowed for reading.
              string DcmDspReadMemoryRangeByLabelLow: set at pre-compile  # Low memory address as label (string) of a range allowed for reading.
              function name DcmRbDspReadMemoryRangeUserModeRuleFnc [0..1]: multiplicity set at link in variant link-time+post-build / pre-compile in variant pre-compile, origin=RB:AR42.1.0.0:2017-01-31, set at pre-compile  # Function name used by the application to perform user specific checks before reading a memory range.In case the checks fails, NRC value set by the application can be returned to the tester. In case the function is not configured for memory range, the DcmAppl API DcmAppl_UserMemoryRangeModeRuleService shall be called.
              reference DcmDspReadMemoryRangeModeRuleRef [0..1]: scope=ECU, multiplicity set at link in variant link-time / pre-compile in variant post-build+pre-compile, set at link in variant link-time / pre-compile in variant post-build+pre-compile, destination=DcmModeRule  # Reference to DcmModeRule | Mode rule which controls read access on this memory address. If there is no reference, no check of the mode rule shall be done.
              reference DcmDspReadMemoryRangeSecurityLevelRef [0..*]: scope=ECU, multiplicity set at link in variant link-time / pre-compile in variant post-build+pre-compile, set at link in variant link-time / pre-compile in variant post-build+pre-compile, destination=DcmDspSecurityRow  # Link to the Security Access Levels needed for read access on this memory address. If there is no reference, no check of security level shall be done.
              reference DcmDspReadMemoryRangeSessionLevelRef [0..*]: scope=ECU, multiplicity set at link in variant link-time / pre-compile in variant post-build+pre-compile, set at link in variant link-time / pre-compile in variant post-build+pre-compile, destination=DcmDspSessionRow  # Link to the session level needed for access to this memory address range. | If there is no reference, no check of session level shall be done.
            container DcmDspReadMemoryRangeInfo [0..*]  # Provides the range of memory address allowed for reading
              integer DcmDspReadMemoryRangeHigh: 0..4294967294, scope=ECU, set at link in variant link-time / pre-compile in variant post-build+pre-compile  # High memory address of a range allowed for reading
              integer DcmDspReadMemoryRangeLow: 0..4294967294, scope=ECU, set at link in variant link-time / pre-compile in variant post-build+pre-compile  # Low memory address of a range allowed for reading
              function name DcmRbDspReadMemoryRangeUserModeRuleFnc [0..1]: multiplicity set at pre-compile, origin=RB:AR42.1.0.0:2017-01-31, set at pre-compile  # Function name used by the application to perform user specific checks before reading a memory range.In case the checks fails, NRC value set by the application can be returned to the tester. In case the function is not configured for memory range, the DcmAppl API DcmAppl_UserMemoryRangeModeRuleService shall be called.
              reference DcmDspReadMemoryRangeModeRuleRef [0..1]: scope=ECU, multiplicity set at link in variant link-time / pre-compile in variant post-build+pre-compile, set at link in variant link-time / pre-compile in variant post-build+pre-compile, destination=DcmModeRule  # Reference to DcmModeRule | Mode rule which controls read access on this memory address. If there is no reference, no check of the mode rule shall be done.
              reference DcmDspReadMemoryRangeSecurityLevelRef [0..*]: scope=ECU, multiplicity set at link in variant link-time / pre-compile in variant post-build+pre-compile, set at link in variant link-time / pre-compile in variant post-build+pre-compile, destination=DcmDspSecurityRow  # Link to the Security Access Levels needed for read access on this memory address. If there is no reference, no check of security level shall be done.
              reference DcmDspReadMemoryRangeSessionLevelRef [0..*]: scope=ECU, multiplicity set at link in variant link-time / pre-compile in variant post-build+pre-compile, set at link in variant link-time / pre-compile in variant post-build+pre-compile, destination=DcmDspSessionRow  # Link to the session level needed for access to this memory address range. | If there is no reference, no check of session level shall be done.
            container DcmDspWriteMemoryRangeByLabelInfo [0..*]  # Provides a memory range allowed for writing via labels (lower and higher address configured as strings).
              string DcmDspWriteMemoryRangeByLabelHigh: set at pre-compile  # High memory address as label (string) of a range allowed for writing.
              string DcmDspWriteMemoryRangeByLabelLow: set at pre-compile  # Low memory address as label (string) of a range allowed for writing.
              function name DcmRbDspWriteMemoryRangeUserModeRuleFnc [0..1]: multiplicity set at link in variant link-time+post-build / pre-compile in variant pre-compile, origin=RB:AR42.1.0.0:2017-01-31, set at pre-compile  # Function name used by the application to perform user specific checks before writing to a memory range.In case the checks fails, NRC value set by the application can be returned to the tester. In case the function is not configured for memory range, the DcmAppl API DcmAppl_UserMemoryRangeModeRuleService shall be called.
              reference DcmDspWriteMemoryRangeModeRuleRef [0..1]: scope=ECU, multiplicity set at link in variant link-time / pre-compile in variant post-build+pre-compile, set at link in variant link-time / pre-compile in variant post-build+pre-compile, destination=DcmModeRule  # Reference to DcmModeRule | Mode rule which controls write access on this memory address. If there is no reference, no check of the mode rule shall be done.
              reference DcmDspWriteMemoryRangeSecurityLevelRef [0..*]: scope=ECU, multiplicity set at link in variant link-time / pre-compile in variant post-build+pre-compile, set at link in variant link-time / pre-compile in variant post-build+pre-compile, destination=DcmDspSecurityRow  # Link to the Security Access Levels needed for write access on this memory address. If there is no reference, no check of security level shall be done.
              reference DcmDspWriteMemoryRangeSessionLevelRef [0..*]: scope=ECU, multiplicity set at link in variant link-time / pre-compile in variant post-build+pre-compile, set at link in variant link-time / pre-compile in variant post-build+pre-compile, destination=DcmDspSessionRow  # Link to the session level needed for access to this memory address range. | If there is no reference, no check of session level shall be done.
            container DcmDspWriteMemoryRangeInfo [0..*]  # Provides the range of memory address allowed for writting.
              integer DcmDspWriteMemoryRangeHigh: 0..4294967294, scope=ECU, set at link in variant link-time / pre-compile in variant post-build+pre-compile  # High memory address of a range allowed for writing.
              integer DcmDspWriteMemoryRangeLow: 0..4294967294, scope=ECU, set at link in variant link-time / pre-compile in variant post-build+pre-compile  # Low memory address of a range allowed for writing
              function name DcmRbDspWriteMemoryRangeUserModeRuleFnc [0..1]: multiplicity set at pre-compile, origin=RB:AR42.1.0.0:2017-01-31, set at pre-compile  # Function name used by the application to perform user specific checks before writing to a memory range.In case the checks fails, NRC value set by the application can be returned to the tester. In case the function is not configured for memory range, the DcmAppl API DcmAppl_UserMemoryRangeModeRuleService shall be called.
              reference DcmDspWriteMemoryRangeModeRuleRef [0..1]: scope=ECU, multiplicity set at link in variant link-time / pre-compile in variant post-build+pre-compile, set at link in variant link-time / pre-compile in variant post-build+pre-compile, destination=DcmModeRule  # Reference to DcmModeRule | Mode rule which controls write access on this memory address. If there is no reference, no check of the mode rule shall be done.
              reference DcmDspWriteMemoryRangeSecurityLevelRef [0..*]: scope=ECU, multiplicity set at link in variant link-time / pre-compile in variant post-build+pre-compile, set at link in variant link-time / pre-compile in variant post-build+pre-compile, destination=DcmDspSecurityRow  # Link to the Security Access Levels needed for write access on this memory address. If there is no reference, no check of security level shall be done.
              reference DcmDspWriteMemoryRangeSessionLevelRef [0..*]: scope=ECU, multiplicity set at link in variant link-time / pre-compile in variant post-build+pre-compile, set at link in variant link-time / pre-compile in variant post-build+pre-compile, destination=DcmDspSessionRow  # Link to the session level needed for access to this memory address range. | If there is no reference, no check of session level shall be done.
            container DcmRbDspDownloadMemoryRangeInfo [0..*]  # Provides the range of memory address allowed for download
              integer DcmRbDspDownloadMemoryRangeHigh: 0..4294967294, origin=RB:AR42.1.0.0:2017-01-31, set at link in variant link-time / pre-compile in variant post-build+pre-compile  # High memory address of a range allowed for download
              integer DcmRbDspDownloadMemoryRangeLow: 0..4294967294, origin=RB:AR42.1.0.0:2017-01-31, set at link in variant link-time / pre-compile in variant post-build+pre-compile  # Low memory address of a range allowed for download.
              reference DcmRbDspDownloadMemoryRangeSecurityLevelRef [0..*]: multiplicity set at link in variant link-time / pre-compile in variant post-build+pre-compile, origin=RB:AR42.1.0.0:2017-01-31, set at link in variant link-time / pre-compile in variant post-build+pre-compile, destination=DcmDspSecurityRow  # Link to the Security Access Levels needed for download access on this memory address. If there is no reference, no check of security level shall be done.
            container DcmRbDspUploadMemoryRangeInfo [0..*]  # Provides the range of memory address allowed for upload
              integer DcmRbDspUploadMemoryRangeHigh: 0..4294967294, origin=RB:AR42.1.0.0:2017-01-31, set at link in variant link-time / pre-compile in variant post-build+pre-compile  # High memory address of a range allowed for upload.
              integer DcmRbDspUploadMemoryRangeLow: 0..4294967294, origin=RB:AR42.1.0.0:2017-01-31, set at link in variant link-time / pre-compile in variant post-build+pre-compile  # Low memory address of a range allowed for upload.
              reference DcmRbDspUploadMemoryRangeSecurityLevelRef [0..*]: scope=ECU, multiplicity set at link in variant link-time+post-build / pre-compile in variant pre-compile, origin=RB:AR42.1.0.0:2017-01-31, set at link in variant link-time / pre-compile in variant post-build+pre-compile, destination=DcmDspSecurityRow  # Link to the Security Access Levels needed for upload access on this memory address. If there is no reference, no check of security level shall be done.
        container DcmDspMemoryTransfer [0..0]  # This container contains the configuration of the memory transfer.
          function name DcmDspMemoryTransferFnc [0..0]: scope=ECU, multiplicity set at pre-compile, set at pre-compile  # Function name for memory transfer services. | Only relevant if DcmDspMemoryTransferUsePort is set to false.
          boolean DcmDspMemoryTransferUsePort [0..0]: scope=ECU, set at pre-compile, default-value=false  # If this parameter is set to true, the Dcm uses a port requiring a PortInterface UploadDownload. | If the parameter is false, the DCM uses the according C-API callouts.
          container DcmDspAddressAndLengthFormatIdentifier [0..0]  # This container contains the configuration of the supported AddressAndLengthFormatIdentifiers for memory access.
            integer DcmDspSupportedAddressAndLengthFormatIdentifier [0..0]: 0..255, scope=ECU, multiplicity set at link in variant link-time / pre-compile in variant post-build+pre-compile, set at link in variant link-time / pre-compile in variant post-build+pre-compile  # This parameter defines the supported AddressAndLengthFormatIdentifier of the request message.
          container DcmDspMemoryTransferIdInfo [0..0]  # Provides the value of memory identifier used to select the desired memory device | This container contains the configuration of the memory access requested through diagnostic services : RequestDownload, RequestUpload, TransferData, RequestTransferExit
            integer DcmDspMemoryIdValue [0..0]: 0..255, scope=ECU, multiplicity set at link in variant link-time / pre-compile in variant post-build+pre-compile, set at link in variant link-time / pre-compile in variant post-build+pre-compile  # Value of the memory device identifier used. | Each DcmDspMemoryIdInfo should have a unique ID. The MemoryIdValue is retrieved from the request messages (RMBA,WMBA,RD,RU,DDDI) according to ISO-14229-1 with the most significant byte of the request parameter memoryAddress.
        container DcmDspPeriodicDidTransmission [0..1]  # This container contains the configuration for the Periodic Did transmission. | This container exists only if the UDS Service ReadDataByPeriodicIdentifier(0x2A) is configured.
          integer DcmDspMaxPeriodicDidScheduler: 1..255, set at link in variant link-time / pre-compile in variant post-build+pre-compile  # Defines the maximum number of periodicDataIdentifiers that can be scheduled concurrently.
          enumeration DcmRbDspRDPIISOVersion [0..1]: {ISO14229_01_2013_03, ISO14229_01_2006_12}, multiplicity set at link in variant link-time / pre-compile in variant post-build+pre-compile, origin=RB:AR42.1.0.0:2017-01-31, set at link in variant link-time / pre-compile in variant post-build+pre-compile, default-value=ISO14229_01_2013_03  # This parameter indicates the version of ISO the project needs, the projects can choose between ISO version ISO14229-1 2013-03 edition and older edition ISO14229_01_2006_12. This parameter is only relevant to Rdpi and is used to choose the NRC sent when the no. of PDID in a request exceeds the configured DcmDspMaxPeriodicDidToRead. If ISO14229-1 2013-03 edition is chosen NRC 0x13 will be sent, else NRC 0x31 will be sent which is according to ISO14229_01_2006_12. ISO14229_01_2013_03 is the latest released ISO version. If the parameter is left unconfigured , ISO14229_01_2013_03 shall be considered as default | This parameter indicates the version of ISO the project needs, the projects can choose between ISO version ISO14229-1 2013-03 edition and older edition ISO14229_01_2006_12. This parameter is only relevant to Rdpi and is used to choose the NRC sent when the no. of PDID in a request exceeds the configured DcmDspMaxPeriodicDidToRead. If ISO14229-1 2013-03 edition is chosen NRC 0x13 will be sent, else NRC 0x31 will be sent which is according to ISO14229_01_2006_12. ISO14229_01_2013_03 is the latest released ISO version.
          integer DcmRbDspRdpiType2FreeTxPduCount [0..1]: 1..255, multiplicity set at pre-compile, origin=RB:AR42.1.0.0:2017-01-31, set at pre-compile, default-value=10  # This parameter indicates the number of main function calls available for Dcm before releasing the TxPdu in case of no confirmation from the lower layers. For example if this value is configured as 5 and say DcmTasktime is 10ms, 50 msecs of time is available for the confirmation to be received, if no confirmation is received the TxPduID is released for later transmission. This parameter has to be configured to a value greater than the timeout value for RDPI available in the Tp Modules
        container DcmDspPeriodicTransmission [0..1]  # This container contains the configuration (parameters) for Periodic Transmission Scheduler.
          integer DcmDspMaxPeriodicDidScheduler [0..0]: 1..255, set at link in variant link-time / pre-compile in variant post-build+pre-compile  # Defines the maximum number of periodicDataIdentifiers that can be scheduled concurrently.
          float DcmDspPeriodicTransmissionFastRate [0..1]: 1E-4..0.255, multiplicity set at pre-compile, set at link in variant link-time / pre-compile in variant post-build+pre-compile  # This parameter give the transmission rate of the requested periodicDataIdentifiers to be used if the parameter transmissionMode given in the ReadDataByPeriodicID request is equal to 0x03 ("sendAtFastRate"). This parameter value in seconds have to be configured as a multiple of DcmTaskTime. | min: A negative value and zero is not allowed.
          integer DcmDspPeriodicTransmissionMaxPeriodicFastTransmissions [0..0]: 0..255, set at pre-compile  # Defines the maximum number of periodic connections used for fast transmission.
          integer DcmDspPeriodicTransmissionMaxPeriodicMediumTransmissions [0..0]: 0..255, set at pre-compile  # Defines the maximum number of periodic connections used for medium transmission.
          integer DcmDspPeriodicTransmissionMaxPeriodicSlowTransmissions [0..0]: 0..255, set at pre-compile  # Defines the maximum number of periodic connections used for slow transmission.
          float DcmDspPeriodicTransmissionMediumRate [0..1]: 1E-4..0.255, multiplicity set at pre-compile, set at link in variant link-time / pre-compile in variant post-build+pre-compile  # This parameter give the transmission rate of the requested periodicDataIdentifiers to be used if the parameter transmissionMode given in the ReadDataByPeriodicID request is equal to 0x02 ("sendAtMediumRate"). This parameter value in seconds have to be configured as a multiple of DcmTaskTime. | min: A negative value and zero is not allowed.
          enumeration DcmDspPeriodicTransmissionSchedulerType [0..0]: {SCHEDULER_TYPE1, SCHEDULER_TYPE2}, set at pre-compile, default-value=SCHEDULER_TYPE1  # Defines the used scheduler type according to ISO 14229-1:2018 for read data by periodic identifier.
          float DcmDspPeriodicTransmissionSlowRate [0..1]: 1E-4..0.255, multiplicity set at pre-compile, set at link in variant link-time / pre-compile in variant post-build+pre-compile  # This parameter give the transmission rate of the requested periodicDataIdentifiers to be used if the parameter transmissionMode given in the ReadDataByPeriodicID request is equal to 0x01 ("sendAtSlowRate"). This parameter value in seconds have to be configured as a multiple of DcmTaskTime. | min: A negative value and zero is not allowed.
        container DcmDspPid [0..*]  # This container defines the availability of a PID to the DCM.
          integer DcmDspPidIdentifier: 0..255, scope=ECU, set at link in variant link-time / pre-compile in variant post-build+pre-compile  # 1 byte Identifier of the PID | Within each DcmConfigSet all DcmDspPidIdentifier values shall be unique.
          enumeration DcmDspPidService: {DCM_SERVICE_01, DCM_SERVICE_01_02, DCM_SERVICE_02}, scope=ECU, set at link in variant link-time / pre-compile in variant post-build+pre-compile  # Indicates if a PID is used with service $01 and/or $02
          integer DcmDspPidSize: 0..255, scope=ECU, set at link in variant link-time / pre-compile in variant post-build+pre-compile  # Length of a PID in byte(s).
          boolean DcmDspPidUsed [0..0]: scope=ECU, set at link in variant link-time / post-build in variant post-build / pre-compile in variant pre-compile  # Allow to activate or deactivate the usage of a PID, for multi purpose ECUs | true = PID is available false = PID is not available
          container DcmDspPidData [1..*]  # This container defines the parameter for a Signal in the PID.
            integer DcmDspPidByteOffset [0..0]: 0..255, scope=ECU, set at link in variant link-time / pre-compile in variant post-build+pre-compile  # This is the position in bytes of the PID structure and will not start at position 0 in case a support information is available (for packeted PIDs).
            integer DcmDspPidDataByteSize [0..0]: 0..255, scope=ECU, multiplicity set at link in variant link-time / pre-compile in variant post-build+pre-compile, set at link in variant link-time / pre-compile in variant post-build+pre-compile  # Defines the array length in bytes or the the maximum array length for variable datalengths.
            integer DcmDspPidDataPos: 0..2040, scope=ECU, set at link in variant link-time / pre-compile in variant post-build+pre-compile  # This is the position in bit of the PID structure and will not start at position 0 in case a support information is availabe (for bit-mapped PIDs).
            integer DcmDspPidDataSize [0..1]: 0..2040, scope=ECU, multiplicity set at link in variant link-time / pre-compile in variant post-build+pre-compile, set at link in variant link-time / pre-compile in variant post-build+pre-compile  # Length of data associated to the PID in bit.
            container DcmDspPidDataSupportInfo [0..1]  # This container defines the supported information.
              integer DcmDspPidDataSupportInfoBit: 0..255, scope=ECU, set at link in variant link-time / pre-compile in variant post-build+pre-compile  # Referenced Bit of the SupportInfo
              reference DcmDspPidDataSupportInfoRef: scope=ECU, set at link in variant link-time / pre-compile in variant post-build+pre-compile, destination=DcmDspPidSupportInfo  # Reference to DcmDspPidSupportInfo
            container DcmDspPidService01 [0..1]  # Contains specific configuration parameter of PID for service $01. This container exists only if DcmDspPidService is set to DCM_SERVICE_01 or DCM_SERVICE_01_02.
              enumeration DcmDspPidDataEndianness [0..1]: {BIG_ENDIAN, LITTLE_ENDIAN, OPAQUE}, scope=ECU, multiplicity set at pre-compile, set at pre-compile  # Defines the endianness of the data belonging to a PID in a diagnostic response message. | If no DcmDspPidDataEndianness is defined the value of DcmDspDataDefaultEndianness is applicable.
              function name DcmDspPidDataReadFnc [0..1]: scope=ECU, multiplicity set at pre-compile, set at pre-compile  # Function name for reading PID data value. | This is only relevant if DcmDspPidDataUsePort==USE_DATA_SYNCH_FNC. This parameter is related to the interface Xxx_ReadData.
              enumeration DcmDspPidDataType: {BOOLEAN, SINT16, SINT16_N, SINT32, SINT32_N, SINT8, SINT8_N, UINT16, UINT16_N, UINT32, UINT32_N, UINT8, UINT8_N}, scope=ECU, multiplicity set at link in variant link-time / pre-compile in variant post-build+pre-compile, set at link in variant link-time / pre-compile in variant post-build+pre-compile  # Provide the implementation data type of data belonging to a PID.
              enumeration DcmDspPidDataUsePort: {USE_DATA_SENDER_RECEIVER, USE_DATA_SYNCH_CLIENT_SERVER, USE_DATA_SYNCH_FNC}, scope=ECU, set at pre-compile  # If this parameter is set to USE_DATA_SYNCH_FNC, the Dcm will use the function defined in DcmDspPidDataReadFnc to get the PID data value. | If this parameter is set to USE_DATA_SYNCH_CLIENT_SERVER, the Dcm will have an R-Port requiring the interface DataServices_{Data}. If this parameter is set to USE_DATA_SENDER_RECEIVER, the DCM will have an R-Port requiring a SenderReceiverInterface The R-Port is named DataServices_{Data} where {Data} is the name of the container DcmDspPidData.
              choice container DcmDspPidService01ExternalSRDataElementClass [0..0]  # This container defines the source of data in a provided port which shall be read respectively the target of data in a required port which shall be written. | This container shall contain either one DcmSubElementInDataElementInstance OR DcmDataElementInstance OR DcmSubElementInImplDataElementInstance reference.
                container DcmDataElementInstance [0..0]  # Instance Reference to the primitive data in a port where the data element is typed with an ApplicationPrimitveDataType or an ImplementationDataType.
                  instance reference DcmDataElementInstanceRef [0..0]: set at pre-compile, destination-context=ROOT-SW-COMPOSITION-PROTOTYPE SW-COMPONENT-PROTOTYPE PORT-PROTOTYPE, destination-type=AUTOSAR-DATA-PROTOTYPE  # Instance Reference to the primitive or array data which shall be read or written. | Supported are VariableDataPrototypes in SenderReceiverInterfaces and NvDataInterfaces and ParameterDataPrototypes in ParameterInterfaces (read only). This reference is applicable if the AutosarDataPrototype is typed with a ApplicationPrimitiveDataType of category VALUE or BOOLEAN or ApplicationArrayDataType or if the AutosarDataPrototype is typed with a ImplementationDataType of category VALUE, ARRAY or TYPE_REFERENCE that in turn boils down to VALUE or ARRAY
                container DcmSubElementInDataElementInstance [0..0]  # Instance Reference to the primitve sub-element (at any level) of composite data in a port where the data element is typed with an ApplicationCompositeDataType.
                  instance reference DcmSubElementInDataElementInstanceRef [0..0]: set at pre-compile, destination-context=ROOT-SW-COMPOSITION-PROTOTYPE SW-COMPONENT-PROTOTYPE PORT-PROTOTYPE AUTOSAR-DATA-PROTOTYPE APPLICATION-COMPOSITE-ELEMENT-DATA-PROTOTYPE*, destination-type=APPLICATION-COMPOSITE-ELEMENT-DATA-PROTOTYPE  # Instance Reference to the primitve sub-element (at any level) of composite data in a port which shall be read. | Supported are VariableDataPrototypes in SenderReceiverInterfaces and NvDataInterfaces and ParameterDataPrototypes in ParameterInterfaces (read only). This reference is applicable if the AutosarDataPrototype is typed with a ApplicationCompositeDataType. Note: One or more class attributes are too long to display. Please refer to diagram INTERNAL_DcmDspSRData for the class attributes.
                container DcmSubElementInImplDataElementInstance [0..0]  # Instance Reference to the primitve sub-element (at any level) of composite data in a port where the data element is typed with an ImplementationDataType.
                  instance reference DcmSubElementInImplDataElementInstanceRef [0..0]: set at pre-compile, destination-context=ROOT-SW-COMPOSITION-PROTOTYPE SW-COMPONENT-PROTOTYPE PORT-PROTOTYPE AUTOSAR-DATA-PROTOTYPE IMPLEMENTATION-DATA-TYPE-ELEMENT*, destination-type=IMPLEMENTATION-DATA-TYPE-ELEMENT  # Instance Reference to the primitve sub-element (at any level) of composite data in a port which shall be read. | Supported are VariableDataPrototypes in SenderReceiverInterfaces and NvDataInterfaces and ParameterDataPrototypes in ParameterInterfaces (read only). This reference is applicable if the AutosarDataPrototype is typed with a ImplementationDataType of category STRUCTURE or ARRAY. Please note that in case of ARRAY the index attribute in the target reference has to be set to select a single array element. Note: One or more class attributes are too long to display. Please refer to diagram INTERNAL_DcmDspSRData for the class attributes.
            container DcmDspPidService02 [0..1]  # Contains specific configuration parameter of PID for service $02. This container exists only if DcmDspPidService is set to DCM_SERVICE_02 or DCM_SERVICE_01_02.
              reference DcmDspPidDataDemRef [0..1]: scope=ECU, multiplicity set at link in variant link-time / pre-compile in variant post-build+pre-compile, set at link in variant link-time / pre-compile in variant post-build+pre-compile, destination=DemPidDataElement  # Reference to DemPidDataElement in DEM configuration. Allows to link the DCM PID and DEM PID configuration for Mode $02.
              reference DcmRbDspPidDemDataElementClassRef [0..1]: multiplicity set at pre-compile, origin=RB:AR42.1.0.0:2017-01-31, set at pre-compile, destination=DemExternalCSDataElementClass  # Reference to DemDataElementClass in DEM configuration.Allows to link the DCM PID and DEM PID configuration for Mode $02.
          container DcmDspPidSupportInfo [0..*]  # This container defines the support information (typically byte A) to declare the usability of the data bytes within the so-called packeted PIDs (e.g. PID$68).
            integer DcmDspPidSupportInfoLen: 0..255, scope=ECU, set at link in variant link-time / pre-compile in variant post-build+pre-compile  # Length of the support information in bytes.
            integer DcmDspPidSupportInfoPos: 0..255, scope=ECU, set at link in variant link-time / pre-compile in variant post-build+pre-compile  # Position of the support information in bytes.
        container DcmDspReadDTCInformation [0..1]  # This container contains the configuration for the UDS service ReadDTCInformation (0x19).
          boolean DcmDspReadDTCInformationSupportedObdUdsDtcSeparation [0..1]: scope=ECU, set at link in variant link-time / pre-compile in variant post-build+pre-compile, default-value=false  # If this parameter is set to true, the OBD UDS DTC separation is enabled. If this parameter is not configured or set to false, the OBD UDS DTC separation is disabled.
          container DcmDspReadDTCInformationUserDefinedFaultMemory [0..255]  # This container contains the configuration for user defined fault memories in DcmDspReadDTCInformation.
            integer DcmDspReadDTCInformationUserDefinedFaultMemoryId: 0..255, scope=ECU, set at pre-compile  # Identifier used by external tester to identify the User defined event Memory.
            integer DcmDspReadDTCInformationUserDefinedFaultMemoryRole [0..1]: 0..4294967295, scope=ECU, multiplicity set at link in variant link-time / post-build in variant post-build / pre-compile in variant pre-compile, set at link in variant link-time / post-build in variant post-build / pre-compile in variant pre-compile  # Bitfield were each bit represents one dedicated role. A user defined fault memory is granted access if the bit value is 1. If a bit value is 0, it is not allowed for that role. If this parameter is not configured and the Service 0x29 (Authentication) is configured, the DcmDspAuthenticationDeauthenticatedRole will be considered for the role verification check so that when role is not configured, the user defined memory will be allowed to be executed in all the deauthenticated states.
        container DcmDspRequestControl [0..*]  # This container contains the configuration (parameters) of the "Request control of on-board system, test or component" service (Service $08). | The DCM will request the control using an R-Port requiring a PortInteface RequestControlServices_{Tid}. The R-Port is named RequestControlServices_{Tid} where {Tid} is the name of the container DcmDspRequestControl.
          integer DcmDspRequestControlInBufferSize: 0..255, scope=ECU, set at link in variant link-time / pre-compile in variant post-build+pre-compile  # Number of bytes to be provided in the input buffer of the interface RequestControlServices_{Tid} for OBD Service $08
          integer DcmDspRequestControlInfoByte [0..0]: 0..255, scope=ECU, set at link in variant link-time / pre-compile in variant post-build+pre-compile  # Manufacturer specific value reported to the tester for the record identifiers 0xE000 to OxE1FF. (WWH-OBD use cases)
          integer DcmDspRequestControlOutBufferSize: 0..255, scope=ECU, set at link in variant link-time / pre-compile in variant post-build+pre-compile  # Number of bytes to be provided in the output buffer of the interface RequestControlServices_{Tid} for OBD Service $08
          integer DcmDspRequestControlTestId: 0..255, scope=ECU, set at link in variant link-time / pre-compile in variant post-build+pre-compile  # Test Id for Service $08
          function name DcmRbDspRequestControlFnc [0..1]: multiplicity set at pre-compile, origin=RB:AR42.1.0.0:2017-01-31, set at pre-compile  # Function name for reading value by TID (DcmDspRequestControlFnc-function). This is only relevant if DcmDspRequestControlUsePort==FALSE.
          boolean DcmRbDspRequestControlUsePort: origin=RB:AR42.1.0.0:2017-01-31, set at pre-compile  # If this is false, the DCM will use the function defined in DcmDspRequestControlFnc. If this is true, R-Port requiring the interface. The name of this port is the name of the container.
        container DcmDspRequestFileTransfer [0..0]  # This container contains the configuration for RequestFileTransfer. | This container only exists if RequestFileTransfer is configured.
          integer DcmRequestFileTransferFileSizeOrDirInfoParameterLength [0..0]: 1..4, scope=ECU, set at pre-compile, default-value=4  # Defines the length (number of bytes, i.e. the value of fileSizeOrDirInfoParameterLength) of the fileSizeUncompressedOrDirInfoLength and fileSizeCompressed in the response of RequestFileTransfer.
          integer DcmRequestFileTransferLengthFormatIdentifier [0..0]: 1..4, scope=ECU, set at pre-compile, default-value=4  # Defines the length (number of bytes) of the maxNumberOfBlockLength parameter in the response of RequestFileTransfer.
          integer DcmRequestFileTransferMaxFileAndDirName [0..0]: 1..65535, scope=ECU, set at pre-compile, default-value=1  # Defines the maximum size allowed for the FileAndDirName parameter with RTE interfaces used for RequestFileTransfer.
          boolean DcmRequestFileTransferUsePort [0..0]: scope=ECU, set at pre-compile, default-value=false  # Defines if a C/S or C function call shall be used for RequestFileTransfer processing.
        container DcmDspRoe [0..1]  # Provide the configuration of the ResponseOnEvent mechanism.
          float DcmDspRoeInterMessageTime: 0..5, set at link in variant link-time / pre-compile in variant post-build+pre-compile  # Provide the minimum time in seconds between two transmissions of ROE event. It is used for the delay between two different consecutive Roe transmissions.
          boolean DcmRbDspWindowTimeInReportEvents: origin=RB:AR42.1.0.0:2017-07-31  # If set to TRUE the Event Window Time will be the part of Roe request for event type ReportActiveEvents. If set to FALSE the Event Window Time will not be the part of Roe request for event type ReportActiveEvents;
          container DcmDspRoeEvent [1..255]  # This container contains a list of all supported Roe eventTypeRecords which are accepted by this ECU. | At most one DcmDspRoeEvent container is allowed to define a DcmDspRoeEventProperties container with the choice DcmDspRoeOnDTCStatusChange.
            integer DcmDspRoeEventId: 0..254, set at pre-compile, symbolic-name-value=true  # EventId for a global identification of this ROE event it is used within APIs Dcm_TriggerOnEvent() and the ModeDeclarationGroup. | The ratio Ids should be sequentially ordered beginning with 0 and no gaps in between.
            enumeration DcmDspRoeInitialEventStatus: {DCM_ROE_CLEARED, DCM_ROE_STOPPED}, set at link in variant link-time / pre-compile in variant post-build+pre-compile, default-value=DCM_ROE_CLEARED  # Initial Roe status of this RoeEvent
            choice container DcmDspRoeEventProperties  # This container contains the properties of Roe eventTypeRecords. | In one DcmDspRoeEventProperties container one DcmDspRoeOnDTCStatusChange or DcmDspRoeOnChangeOfDataIdentifier container shall be defined.
              container DcmDspRoeOnChangeOfDataIdentifier [0..1]  # This container contains the eventTypeRecord supported for onChangeOfDataIdentifier eventType.
                reference DcmDspRoeDidRef: set at link in variant link-time / pre-compile in variant post-build+pre-compile, destination=DcmDspDid  # Reference to a Did which is watched.
              container DcmDspRoeOnDTCStatusChange [0..1]  # This container contains the eventTypeRecord supported for onDTCStatusChange eventType.
                integer DcmDspRoeDTCStatusMask [0..0]: 0..255, set at pre-compile  # Value of the relevant DTCStatusMask
          container DcmDspRoeEventWindowTime [1..*]  # This container configures the available EventWindowTime in this Ecu. | This container contains a sub-set of EventWindowTimes supported by the Dcm, to limit the Ecu resources.
            enumeration DcmDspRoeEventWindowTime: {DCM_ROE_EVENT_WINDOW_CURRENT_AND_FOLLOWING_CYCLE, DCM_ROE_EVENT_WINDOW_CURRENT_CYCLE, DCM_ROE_EVENT_WINDOW_INFINITE}, set at pre-compile  # Value of the EventWindowTime
            boolean DcmDspRoeStorageState: set at pre-compile  # If this parameter is set to TRUE the StorageStateBit will be evaluated if this EventWindowTime is requested.
