AUTOSAR XML (schema 4-2-2)
package /AUTOSAR_Dem/EcucModuleDefs
  module definition Dem: category=VENDOR_SPECIFIC_MODULE_DEFINITION, refined-module-def=Dem  # Configuration of the Dem (Diagnostic Event Manager) module.
    container DemGeneral  # This container contains the configuration (parameters) of the BSW Dem.
      container DemGeneralOBD  # This container contains the Rb configuration (parameters) of the BSW Dem.
        container DemRbGeneralOBD  # This container contains the configuration (parameters) of the BSW Dem. Delete container if ObdBasic is not required.
          boolean DemRbEnableApiSignalEndOfOBDIgnitionCycle [0..1]: multiplicity set at pre-compile, origin=RB:2019-04-25, set at pre-compile, default-value=false  # This configuration switch enables or disables the functionality of the API "Dem_SignalEndOfOBDIgnitionCycle". This API can be used to explicitly signal the end of the ignition cycle.Basically this API controls the storing and visibility of Permanent DTCs.(see also DemRbOBDIgnitionCycleRef for an alternative method)
          boolean DemRbOBDDtcCodesConfigurable [0..1]: multiplicity set at pre-compile, origin=RB:AR40.8.0.0:2014-02-01, set at pre-compile, default-value=true  # This configuration switch defines whether the OBD Dtc codes are configuratble or not. If configurable, the DemDtcCode has to be entered in the DemDtcClass. If not configurable, the 2 higher bytes of the DemDtc is the OBD Dtc code.
          enumeration DemRbOBDFreezeFrameCapture [0..1]: {DEM_TRIGGER_CONFIRMEDDTC, DEM_TRIGGER_PENDINGDTC}, multiplicity set at pre-compile, origin=RB:AR40.5.0.0:2013-01-01, set at pre-compile, default-value=DEM_TRIGGER_PENDINGDTC  # [NON-AUTOSAR] This parameter defines the point in time, when the OBD freeze frame data collection is done for the initial event memory entry.
          enumeration DemRbOBDFreezeFrameVisibility [0..1]: {DEM_OBDFF_PENDING_AND_CONFIRMED_DTCS, DEM_OBDFF_CONFIRMED_DTCS}, multiplicity set at pre-compile, origin=RB:AR40.10.0.0:2015-04-02, set at pre-compile, default-value=DEM_OBDFF_CONFIRMED_DTCS  # [NON-AUTOSAR] This parameter defines the point of time, when the OBD freeze frame data is visible to scan tool tester.
          enumeration DemRbOBDPermanentDTCVisibilityTiming [0..1]: {END_OF_CYCLE, IMMEDIATELY}, multiplicity set at pre-compile, origin=RB:AR42.7.0.0:2019-11-06, set at pre-compile, default-value=IMMEDIATELY  # [NON-AUTOSAR] This configuration switch defines whether the permanent DTCs are visible immediately, or only after the next init of the Dem or at the end of Ignition Cycle.
          enumeration DemRbOBDProtocol [0..1]: {DEM_RB_J1979, DEM_RB_J1979_2, DEM_RB_BOTH_PROTOCOL}, multiplicity set at pre-compile, origin=RB:RT8 2022.07:2022-07-06, set at pre-compile, default-value=DEM_RB_J1979  # This parameter defines which OBD protocol shall be used for readiness computation (1) DEM_RB_J1979 (OBD Standard) (2) DEM_RB_J1979_2 (OBDonUDS) (3) DEM_BOTH_PROTOCOL(switch between OBD standard and OBD on UDS in runtime)
          function name DemRbOBDProtocolFnc [0..1]: multiplicity set at pre-compile, origin=RB:RT8 2022.07:2022-07-06, set at pre-compile  # Specifies the name of the function which returns the OBD protocol (refer to data type DemRb_ObdProtocolType for implementation) to be used for readiness computation. This parameter is optional, but becomes mandatory if demRbOBDProtocol is set to DEM_RB_BOTH_PROTOCOL.
          boolean DemRbOBDSupportBlockingPermanentDTC [0..1]: multiplicity set at pre-compile, origin=RB-AR40.13.0.0:2016-10-04, set at pre-compile, default-value=false  # This configuration switch enables the feature to block storing of OBD DTCs to Permanent memory.CAUTION: THIS FEATURE MUST USED ONLY DURING PRODUCTION.!!! OTHERWISE OBD CONFORMITY IS VIOLATED.See document description of the callback API rba_DemObdBasic_IsPermanentDTCStorageDisabled
          boolean DemRbOBDSupportObdVariantCoding [0..1]: multiplicity set at pre-compile, origin=RB-AR40.12.0.0:2016-04-12, set at pre-compile, default-value=false  # This configuration switch enables the feature to deactivate the OBD functionality. This feature could be used for variant coding to dynamically switch an OBD project to behave like a non OBD variant. This feature only controls the MIL status. Project specific implementation is necessary. Refer the interface documentation of the API rba_DemObdBasic_IsObdDeactivatedByVariant provided as a template file.
          reference DemRbOBDonUDSFreezeFrameClassRef [0..1]: multiplicity set at post-build in variant post-build / pre-compile in variant pre-compile, post-build-variant-multiplicity=true, set at pre-compile, destination=DemFreezeFrameClass  # This reference defines the link to the freeze frame for emission related diagnostics over UDS.
          reference DemRbOBDIgnitionCycleRef [0..1]: origin=RB:2019-04-25, set at pre-compile, destination=DemOperationCycle  # References the operationCycle which denotes the OBD ignition cycle. The OBD Ignition Cycle is required to control the visibility of Permanent DTCs via the API Dem_RestartOperationCycle (see also DemRbEnableApiSignalEndOfOBDIgnitionCycle for an alternative method)
          reference DemRbOBDSecondIgnitionCycleRef [0..1]: origin=RB:2022-05-11, set at pre-compile, destination=DemOperationCycle  # References the operationCycle which can be used in hybrid vehicles for the fueled engine operation ignition cycle.
