AUTOSAR XML (schema 00048)
package /AUTOSAR_EthTSyn/EcucModuleDefs
  module definition EthTSyn [0..1]: category=VENDOR_SPECIFIC_MODULE_DEFINITION, refined-module-def=EthTSyn, variants pre-compile  # Configuration of the Synchronized Time-base Manager (StbM) module with respect to global time handling on Ethernet.
    container EthTSynGeneral  # This container holds the general parameters of the Ethernet-specific Synchronized Time-base Manager
      string EthTSynDestPhyAddr: set at pre-compile, default-value=01:80:C2:00:00:0E  # Destination Physical Address (MAC-Address). | Destination Physical Hardware Address (MAC-Address) of EthTSyn-gPTP Frames. Input format has to match xx:xx:xx:xx:xx:xx, where x stands for a hex value between 0 and F.
      boolean EthTSynDevErrorDetect: set at pre-compile, default-value=false  # Switches the development error detection and notification on or off. | * true: detection and notification is enabled. * false: detection and notification is disabled.
      float EthTSynGlobalTimeRxToUplinkSwitchResidenceTime [0..1]: 0..4, multiplicity set at pre-compile, set at pre-compile, default-value=0  # This parameter is specifying the default value used for the residence time of the Ethernet Switch [Ingress to Uplink]. | This value is used by the EthTSyn if the calculation of the residence time failed. Unit: seconds
      float EthTSynGlobalTimeUplinkToTxSwitchResidenceTime [0..1]: 0..4, multiplicity set at pre-compile, set at pre-compile, default-value=0  # This parameter is specifying the default value used for the residence time of the Ethernet Switch [Uplink to Egress]. | This value is used by the EthTSyn if the calculation of the residence time failed. Unit: seconds
      boolean EthTSynHardwareTimestampSupport: set at pre-compile  # Activate/Deactivate the hardware time stamping functionality of the Ethernet hardware. | True: Timestamp is retrieved from the Ethernet hardware False: Timestamp is retrieved from the StbM
      float EthTSynMainFunctionPeriod: 0..INF, set at pre-compile  # Schedule period of the main function EthTSyn_MainFunction. | Unit: seconds.
      boolean EthTSynMasterSlaveConflictDetection: set at pre-compile, default-value=false  # Enables master / slave conflict detection and notification. | * true: detection and notification is enabled. * false: detection and notification is disabled.
      boolean EthTSynMessageCompliance: set at pre-compile  # * true: IEEE 802.1AS compliant message format will be used. | * false: IEEE 802.1AS message format with AUTOSAR extension will be used.
      boolean EthTSynPdelayErrorCounterEnable [0..1]: origin=RB:AR45.3.0.0:2022-06-30, set at pre-compile, default-value=false  # RB Specific Parameter: This parameter enables or disables error logging when Pdelay_Resp/Pdelay_Resp_Follow_Up is not received.
      integer EthTSynSwitchMgmtRxMessageBufferCount [0..1]: 1..254, multiplicity set at pre-compile, set at pre-compile, default-value=10  # This parameter is used to determine the amount of Rx message buffers available in the EthTSyn when EthTSyn is used in a Bridge configuration.
      boolean EthTSynTimeBridge [0..0]: origin=RB:AR42.4.5.0:2018-05-09, set at pre-compile, default-value=false  # RB (Vendor06) Specific Parameter: Parameter that is used to configure Time Bridge.
      boolean EthTSynTimeValidationSupport [0..0]: set at pre-compile, default-value=false  # Switches support for time validation on or off. | * true: time validation is enabled. * false: time validation is disabled.
      boolean EthTSynVersionInfoApi: set at pre-compile, default-value=false  # Activate/Deactivate the version information API (EthTSyn_GetVersionInfo). True: version information API activated False: version information API deactivated.
      reference EthTSynEthIfFrameType: set at pre-compile, destination=EthIfFrameOwnerConfig  # The chosen frame owner determines which frames (in respect to ethertype) are received.
    container EthTSynGlobalTimeDomain [1..*]  # This represents the existence of a global time domain on Ethernet. The EthTSyn module can administrate several global time domains at the same time that in itself form a hierarchy of domains and sub-domains. | If the EthTSyn exists it is assumed that at least one global time domain exists.
      integer EthTSynFramePrio [0..1]: 0..7, multiplicity set at pre-compile, post-build-variant-multiplicity=true, post-build-variant-value=true, set at pre-compile  # This optional parameter, if present, indicates the priority of outgoing EthTSyn messages, if sent via VLAN (used for the 3-bit PCP field of the VLAN tag). If this optional parameter is not present, frames are sent without a priority and VLAN field.
      float EthTSynGlobalTimeDebounceTime [0..1]: 0..4, post-build-variant-value=true, set at pre-compile  # This represents the configuration of a TX debounce time for Sync, Follow_Up, and pDelay messages compared to a message before with the same PDU. Unit: seconds
      integer EthTSynGlobalTimeDomainId: 0..31, set at pre-compile  # The global time domain ID.
      integer EthTSynGlobalTimeSecureTmacLength [0..0]: 0..16, set at pre-compile, default-value=0  # Represents the number of bytes for the used Truncated Message Authentication Code (TMAC). If 0, no message authentication will be used. Tags: atp.Status=draft
      reference EthTSynGlobalTimeEthIfRef [0..*]: set at pre-compile, requires-symbolic-name-value=true, destination=EthIfController  # This represents the reference to the Ethernet interface taken to fetch the global time information.
      reference EthTSynSynchronizedTimeBaseRef: set at pre-compile, requires-symbolic-name-value=true, destination=StbMSynchronizedTimeBase  # Mandatory reference to the required synchronized time-base.
      container EthTSynGlobalTimeFollowUpDataIDList [0..1]: multiplicity set at pre-compile, post-build-variant-multiplicity=true  # The DataIDList for Follow_Up message ensures the identification of data elements due to CRC calculation and message authentication process.
        container EthTSynGlobalTimeFollowUpDataIDListElement [16..16]  # Element of the DataIDList for Follow_Up message ensures the identification of data elements due to CRC calculation and message authentication process.
          integer EthTSynGlobalTimeFollowUpDataIDListIndex: 0..15, post-build-variant-value=true, set at pre-compile  # Index of the DataIDList for Follow_Up message ensures the identification of data elements due to CRC calculation and message authentication process.
          integer EthTSynGlobalTimeFollowUpDataIDListValue: 0..255, post-build-variant-value=true, set at pre-compile  # Value of the DataIDList for Follow_Up message ensures the identification of data elements due to CRC calculation and message authentication process.
      container EthTSynPortConfig [0..*]: multiplicity set at pre-compile, post-build-variant-multiplicity=true  # Configuration of the EthTSyn-Ports within the TimeDomain.
        boolean EthTSynEnableTimeValidation [0..0]: set at pre-compile, default-value=false  # Enables/disables time recording for time validation for a specific Time Domain.
        float EthTSynGlobalTimeMinMsgGap [0..0]: 0..INF, post-build-variant-value=true, set at pre-compile, default-value=0  # This parameter represents the configuration of a minimum message gap time for received Timesync messages compared to a message before with the same PDU. If PDUs are received more often in between than this parameter allows, they shall be ignored. Tags: atp.Status=draft | Unit: seconds
        reference EthTSynSwitchManagementEthSwitchPortRef [0..1]: multiplicity set at pre-compile, set at pre-compile, requires-symbolic-name-value=true, destination=EthSwtPort  # In an AVB-Bridge config, this reference is used to assign the EthTSyn-Port to an Ethernet Switch-Port.
        container EthTSynPdelayConfig: multiplicity set at pre-compile, post-build-variant-multiplicity=true  # Configuration of cyclic propagation delay measurement.
          boolean EthTSynGlobalTimePdelayRespEnable: post-build-variant-value=true, set at pre-compile, default-value=true  # This parameter allows disabling Pdelay_Resp / Pdelay_Resp_Follow_Up transmission, if no Pdelay_Req messages are expected. | FALSE: No Pdelay requests expected. Pdelay_Resp / Pdelay_Resp_Follow_Up transmission is disabled. TRUE: Pdelay requests expected. Pdelay_Resp / Pdelay_Resp_Follow_Up transmission is enabled.
          float EthTSynGlobalTimePropagationDelay: 0..4, post-build-variant-value=true, set at pre-compile, default-value=0  # If cyclic propagation delay measurement is enabled, this parameter represents the default value of the propagation delay until the first actually measured propagation delay is available. | If cyclic propagation delay measurement is disabled, this parameter replaces a measured propagation delay by a fixed value. Unit: seconds
          float EthTSynGlobalTimeTxPdelayReqPeriod: 0..4, post-build-variant-value=true, set at pre-compile, default-value=0  # This represents configuration of the TX period for Pdelay_Req messages. | A value of 0 disables the cyclic Pdelay measurement. Unit: seconds
          float EthTSynPdelayLatencyThreshold [0..1]: 0..INF, post-build-variant-value=true, set at pre-compile, default-value=1E-5  # Threshold for calculated Pdelay. If a measured Pdelay exceeds EthTSynPdelayLatencyThreshold, this value is discarded. | Unit: seconds
          float EthTSynPdelayRespAndRespFollowUpTimeout: 0..4, post-build-variant-value=true, set at pre-compile  # Timeout value for Pdelay_Resp and Pdelay_Resp_Follow_Up after a Pdelay_Req has been transmitted resp. a Pdelay_Resp has been received. | A value of 0 deactivates this timeout observation. Unit: seconds
      choice container EthTSynPortRole [0..1]: multiplicity set at pre-compile, post-build-variant-multiplicity=true  # Specifying the Role of the EthTSyn-Port (Master or Slave).
        container EthTSynGlobalTimeMaster [0..1]: multiplicity set at pre-compile, post-build-variant-multiplicity=true  # Configuration of a (global) time master. Each time domain is required to have exactly one global time master, but may have multiple ports acting as time (sub-) master (see Time Gateway) to relay global time from the global time master to the time slaves. The global time master may or may not exist on the configured ECU. The exact role of the port is derived implicitly.
          float EthTSynCyclicMsgResumeTime: 0..INF, post-build-variant-value=true, set at pre-compile  # Defines the time where the 1st regular cycle time based message transmission takes place, after an immediate transmission before. Unit: seconds
          enumeration EthTSynGlobalTimeTxCrcSecured: {CRC_NOT_SUPPORTED, CRC_SUPPORTED}, post-build-variant-value=true, set at pre-compile  # This represents the configuration of whether or not CRC is supported.
          float EthTSynGlobalTimeTxPeriod: 0..INF, post-build-variant-value=true, set at pre-compile  # This represents configuration of the TX period. Unit: seconds
          boolean EthTSynImmediateTimeSync: post-build-variant-value=true, set at pre-compile  # Enables/Disables the cyclic polling of StbM_GetTimeBaseUpdateCounter() within EthTSyn_MainFunction().
          boolean EthTSynTLVFollowUpOFSSubTLV: post-build-variant-value=true, set at pre-compile  # This represents the configuration of whether an AUTOSAR Follow_Up TLV OFS Sub-TLV is used or not. | * true: This represents a configuration where an AUTOSAR Follow_Up TLV OFS Sub-TLV is used. * false: This represents a configuration where an AUTOSAR Follow_Up TLV OFS Sub-TLV is not used.
          boolean EthTSynTLVFollowUpStatusSubTLV: post-build-variant-value=true, set at pre-compile  # This represents the configuration of whether an AUTOSAR Follow_Up TLV Status Sub-TLV is used or not. | * true: This represents a configuration where an AUTOSAR Follow_Up TLV Status Sub-TLV is used. * false: This represents a configuration where an AUTOSAR Follow_Up TLV Status Sub-TLV is not used.
          boolean EthTSynTLVFollowUpTimeSubTLV: post-build-variant-value=true, set at pre-compile  # This represents the configuration of whether an AUTOSAR Follow_Up TLV Time Sub-TLV is used or not. | * true: This represents a configuration where an AUTOSAR Follow_Up TLV Time Sub-TLV is used. * false: This represents a configuration where an AUTOSAR Follow_Up TLV Time Sub-TLV is not used.
          boolean EthTSynTLVFollowUpUserDataSubTLV: post-build-variant-value=true, set at pre-compile  # This represents the configuration of whether an AUTOSAR Follow_Up TLV UserData Sub-TLV is used or not. | * true: This represents a configuration where an AUTOSAR Follow_Up TLV UserData Sub-TLV is used. * false: This represents a configuration where an AUTOSAR Follow_Up TLV UserData Sub-TLV is not used.
          enumeration EthTSynTxTmacCalculated [0..0]: {TMAC_CALCULATED, TMAC_NOT_CALCULATED}, post-build-variant-value=true, set at pre-compile  # This parameter controls whether or not TMAC calculation shall be supported. Tags: atp.Status=draft
          container EthTSynCrcTimeFlagsTxSecured [0..1]: multiplicity set at pre-compile, post-build-variant-multiplicity=true  # This container collects definitions which parts of the Follow_Up message elements shall be used for CRC calculation.
            boolean EthTSynCrcCorrectionField: post-build-variant-value=true, set at pre-compile, default-value=false  # correctionField from the Follow_Up Message Header shall be included in CRC calculation.
            boolean EthTSynCrcDomainNumber: post-build-variant-value=true, set at pre-compile, default-value=false  # domainNumber from the Follow_Up Message Header shall be included in CRC calculation.
            boolean EthTSynCrcMessageLength: post-build-variant-value=true, set at pre-compile, default-value=false  # messageLength from the Follow_Up Message Header shall be included in CRC calculation.
            boolean EthTSynCrcPreciseOriginTimestamp: post-build-variant-value=true, set at pre-compile, default-value=true  # preciseOriginTimestamp from the Follow_Up Message Field shall be included in CRC calculation.
            boolean EthTSynCrcSequenceId: post-build-variant-value=true, set at pre-compile, default-value=false  # sequenceId from the Follow_Up Message Header shall be included in CRC calculation.
            boolean EthTSynCrcSourcePortIdentity: post-build-variant-value=true, set at pre-compile, default-value=false  # sourcePortIdentity from the Follow_Up Message Header shall be included in CRC calculation.
        container EthTSynGlobalTimeSlave [0..1]: multiplicity set at pre-compile, post-build-variant-multiplicity=true  # Configuration of a time slave. Each global time domain is required to have at least one time slave. The configured ECU may or may not represent a time slave.
          float EthTSynGlobalTimeFollowUpTimeout: 0..4, post-build-variant-value=true, set at pre-compile  # Timeout value of the Follow_Up message (of the subsequent Sync message). | A value of 0 deactivates this timeout observation. Unit: seconds
          integer EthTSynGlobalTimeSequenceCounterHysteresis [0..1]: 0..15, post-build-variant-value=true, set at pre-compile, default-value=0  # EthTSynGlobalTimeSequenceCounterHysteresis specifies the number of consecutive valid message pairs that are required by the Time Slave while being in Timeout state until a Time Tuple is forwarded to the StbM.
          integer EthTSynGlobalTimeSequenceCounterJumpWidth [0..1]: 0..65535, post-build-variant-value=true, set at pre-compile, default-value=0  # The SequenceCounterJumpWidth specifies the maximum allowed jump of the Sequence Counter between two consecutive Sync messages.
          enumeration EthTSynRxCrcValidated: {CRC_IGNORED, CRC_NOT_VALIDATED, CRC_OPTIONAL, CRC_VALIDATED}, post-build-variant-value=true, set at pre-compile  # Definition of whether or not validation of the CRC takes place.
          enumeration EthTSynRxTmacValidated [0..0]: {TMAC_NOT_VALIDATED, TMAC_VALIDATED}, post-build-variant-value=true, set at pre-compile  # This parameter controls whether or not TMAC validation shall be supported. Tags: atp.Status=draft
          container EthTSynCrcFlagsRxValidated [0..1]: multiplicity set at pre-compile, post-build-variant-multiplicity=true  # This container collects definitions which parts of the Follow_Up message elements shall be included in CRC validation.
            boolean EthTSynCrcCorrectionField: post-build-variant-value=true, set at pre-compile, default-value=false  # correctionField from the Follow_Up Message Header shall be included in CRC calculation.
            boolean EthTSynCrcDomainNumber: post-build-variant-value=true, set at pre-compile, default-value=false  # domainNumber from the Follow_Up Message Header shall be included in CRC calculation.
            boolean EthTSynCrcMessageLength: post-build-variant-value=true, set at pre-compile, default-value=false  # messageLength from the Follow_Up Message Header shall be included in CRC calculation.
            boolean EthTSynCrcPreciseOriginTimestamp: post-build-variant-value=true, set at pre-compile, default-value=true  # preciseOriginTimestamp from the Follow_Up Message Field shall be included in CRC calculation.
            boolean EthTSynCrcSequenceId: post-build-variant-value=true, set at pre-compile, default-value=false  # sequenceId from the Follow_Up Message Header shall be included in CRC calculation.
            boolean EthTSynCrcSourcePortIdentity: post-build-variant-value=true, set at pre-compile, default-value=false  # sourcePortIdentity from the Follow_Up Message Header shall be included in CRC calculation.
