AUTOSAR XML (schema 00048)
package /AUTOSAR_DoIP/EcucModuleDefs
  module definition DoIP [0..1]: category=VENDOR_SPECIFIC_MODULE_DEFINITION, post-build-variant-support=true, refined-module-def=DoIP, variants link-time/post-build/pre-compile  # Configuration of the DoIP (Diagnostic over IP) module.
    container DoIPConfigSet  # This container contains the configuration parameters and sub containers of the AUTOSAR DoIP module.
      integer DoIPEid [0..1]: 0..281474976710655, multiplicity set at link in variant link-time / post-build in variant post-build / pre-compile in variant pre-compile, post-build-variant-multiplicity=true, post-build-variant-value=true, set at link in variant link-time / post-build in variant post-build / pre-compile in variant pre-compile  # Configured EID (Entity ID of) for vehicle identification/vehicle announcement. Only necessary if DoIPUseMacAddressForIdentification is set to FALSE.
      integer DoIPGid [0..1]: 0..281474976710655, multiplicity set at link in variant link-time / post-build in variant post-build / pre-compile in variant pre-compile, post-build-variant-multiplicity=true, post-build-variant-value=true, set at link in variant link-time / post-build in variant post-build / pre-compile in variant pre-compile  # Configured GID (Group ID of) for vehicle identification/vehicle announcement.
      integer DoIPLogicalAddress: 0..65535, post-build-variant-value=true, set at link in variant link-time / post-build in variant post-build / pre-compile in variant pre-compile  # Describes the logical address of the DoIP entity, i.e. the LA that will route diagnostic requests to the Dcm of the DoIP entity.
      container DoIPInterface [1..255]  # This container defines a logical IP interface and collects properties to configure this interface. Tags: atp.Status=draft
        float DoIPAliveCheckResponseTimeout: 0..INF, set at pre-compile  # Timeout in [s] for waiting for a response to an Alive Check request before the connection is considered to be disconnected. Represents parameter T_TCP_Alive_Check of ISO 13400-2:2019.
        float DoIPGeneralInactivityTime: 0..INF, set at pre-compile  # Timeout in [s] for maximum inactivity of a TCP socket connection before the DoIP module will close the according socket connection. Represents parameter T_TCP_General_Inactivity of ISO 13400-2:2019
        float DoIPInitialInactivityTime: 0..INF, set at pre-compile  # Timeout in [s] used for initial inactivity of a connected TCP socket connection directly after socket connection. Represents parameter T_TCP_Initial_Inactivity of ISO 13400-2:2019
        float DoIPInitialVehicleAnnouncementTime: 0..INF, set at pre-compile  # Time to wait in [s] for sending first vehicle anouncement message after IP address assignment. Represents parameter A_DoIP_Announce_Wait of ISO 13400-2:2019
        boolean DoIPInterfaceActLineCtrl: set at pre-compile  # This attribute defines whether the network interface Tags: atp.Status=draft | - is started "on-demand" when an activation line is sensed (TRUE) or - is always available (FALSE).
        enumeration DoIPInterfaceAnnouncementStart: set at pre-compile, default-value=DOIP_AUTOMATIC_ANNOUNCE  # This attribute defines, when vehicle announcement is started on a DoIPInterface Tags: atp.Status=draft | * Automatic: As soon as the underlying UDP vehicle announcement connection switches to SOAD_SOCON_ONLINE * OnTrigger: As soon as the API DoIP_TriggerVehicleAnnouncement is called for the given DoIPInterface instance
          DOIP_AUTOMATIC_ANNOUNCE  # Tags: atp.Status=draft
          DOIP_ONTRIGGER_ANNOUNCE  # Tags: atp.Status=draft
        integer DoIPInterfaceId: 0..255, set at pre-compile, symbolic-name-value=true  # This parameter is an identifier of the DoIPInterface. The value of this parameter will be assigned to the symbolic name derived from the container short name. Tags: atp.Status=draft
        integer DoIPMaxTesterConnections: 1..255, set at pre-compile  # Maximum amount of tester connections that shall be maintained at one time before alive check is performed.
        boolean DoIPUseMacAddressForIdentification: set at pre-compile  # Provided the information if a configured EID at vehicle identification response/vehicle announment is used or the MAC address. | TRUE: Use MAC Address instead of EID for Vehicle identification/announcement. FALSE: Use configured EID for vehicle identification/announcement. Dependencies: DoIPEID
        boolean DoIPUseVehicleIdentificationSyncStatus: set at pre-compile  # Defines if the optional VIN/GID synchronization status is used additionally in the vehicle identification/announcement.
        integer DoIPVehicleAnnouncementCount [0..1]: 1..255, set at pre-compile  # Number of vehicle announcement messages on IP address assignment. Represents parameter A_DoIP_Announce_Num of ISO 13400-2:2019.
        float DoIPVehicleAnnouncementInterval [0..1]: 0..INF, set at pre-compile  # Time to wait in [s] for sending subsequent vehicle anouncement messages. Represents parameter A_DoIP_Announce_Interval of ISO 13400-2:2019
        container DoIPChannel [1..65536]  # Configuration of one DoIPChannel.
          reference DoIPChannelSARef: destination=DoIPTester  # Reference to the DoIPTester.
          reference DoIPChannelTARef: destination=DoIPTargetAddress  # Reference to the target address.
          container DoIPPduRRxPdu [0..1]  # This container contains the Rx Pdus to connect with the Rx Pdus of the PduR.
            integer DoIPPduRRxPduId: 0..65535, scope=ECU, set at pre-compile, symbolic-name-value=true  # The DoIPPduRRxPduId is required by the API call DoIP_TpCancelReceive.
            reference DoIPPduRRxPduRef: post-build-variant-value=true, set at link in variant link-time / post-build in variant post-build / pre-compile in variant pre-compile, destination=Pdu  # Reference to the "global" Pdu structure to allow harmonization of handle IDs in the COM-Stack.
          container DoIPPduRTxPdu [0..1]  # This container contains the Tx Pdus to connect with the Tx Pdus of the PduR. If the parameter is not configured the channel is for functional addressing.
            integer DoIPPduRTxPduId: 0..65535, scope=ECU, set at pre-compile, symbolic-name-value=true  # The DoIPPduRTxPduId is required by DoIP_TpTransmit or DoIP_IfTransmit and DoIP_TpCancelTransmit.
            enumeration DoIPPduType [0..1]: {DOIP_IFPDU, DOIP_TPPDU}, multiplicity set at link in variant link-time / post-build in variant post-build / pre-compile in variant pre-compile, post-build-variant-multiplicity=true, post-build-variant-value=true, set at link in variant link-time / post-build in variant post-build / pre-compile in variant pre-compile, default-value=DOIP_TPPDU  # API Type to use for communication with PduR. DOIP_IFPDU for UUDT messages, DOIP_TPPDU for all other diagnostic messages. | The functionality associated with this parameter is not supported yet. The PDU type is assumed to be DOIP_TPPDU by default.
            reference DoIPPduRTxPduRef: post-build-variant-value=true, set at link in variant link-time / post-build in variant post-build / pre-compile in variant pre-compile, destination=Pdu  # Reference to the "global" Pdu structure to allow harmonization of handle IDs in the COM-Stack.
        container DoIPConnections  # Container contains all lower layer connection specific information, i.e. the single Pdu References and Handle IDs to the SoAd.
          container DoIPTargetAddress [1..65535]  # This container describes a possible TargetAddress that is supported by DoIP.
            integer DoIPTargetAddressValue: 0..65535, post-build-variant-value=true, set at link in variant link-time / post-build in variant post-build / pre-compile in variant pre-compile  # Valid Target Address of a DoIP target address.
          container DoIPTcpConnection [2..255]  # This container describes a TCP connection to the lower layer SoAd module.
            boolean DoIPRequestAddressAssignment: set at pre-compile, default-value=true  # The DoIP module shall request IP address assignment by calling SoAd_RequestIpAddrAssignment() for the TcpIpLocalAddr related to this DoIpConnection.
            boolean DoIPTcpConnectionSecurityRequired [0..1]: default-value=false  # Indicates if the associated TCP socket uses a secure connection (e.g. TLS)
            container DoIPSoAdTcpRxPdu  # This container describes a Rx PDU received via SoAd over TCP
              integer DoIPSoAdTcpRxPduId: 0..65535, scope=ECU, set at pre-compile, symbolic-name-value=true  # The DoIPSoAdTcpRxPduId is required by the API call DoIP_SoAdTpRxIndication to receive I-PDUs from the SoAd.
              reference DoIPSoAdTcpRxPduRef: post-build-variant-value=true, set at link in variant link-time / post-build in variant post-build / pre-compile in variant pre-compile, destination=Pdu  # Reference to the "global" Pdu structure to allow harmonization of handle IDs in the COM-Stack.
            container DoIPSoAdTcpTxPdu  # This container describes a Tx PDU sent via SoAd over TCP
              integer DoIPSoAdTcpTxPduId: 0..65535, scope=ECU, set at pre-compile, symbolic-name-value=true  # The DoIPSoAdTcpTxPduId is required by the API call DoIP_SoAdTpTxConfirmation that is called by the SoAd to confirm that the IPdu has been transmitted successfully.
              reference DoIPSoAdTcpTxPduRef: post-build-variant-value=true, set at link in variant link-time / post-build in variant post-build / pre-compile in variant pre-compile, destination=Pdu  # Reference to the "global" Pdu structure to allow harmonization of handle IDs in the COM-Stack.
          container DoIPUdpConnection [1..255]  # This Container describes a Udp connection to the lower layer SoAd module.
            boolean DoIPRequestAddressAssignment: set at pre-compile, default-value=true  # The DoIP module shall request IP address assignment by calling SoAd_RequestIpAddrAssignment() for the TcpIpLocalAddr related to this DoIpConnection.
            container DoIPSoAdUdpRxPdu  # This container describes a Rx PDU received via SoAd over UDP.
              integer DoIPSoAdUdpRxPduId: 0..65535, scope=ECU, set at pre-compile, symbolic-name-value=true  # The DoIPSoAdUdpRxPduId is required by the API call DoIP_SoAdIfRxIndication to receive I-PDUs from the SoAd.
              reference DoIPSoAdUdpRxPduRef: post-build-variant-value=true, set at link in variant link-time / post-build in variant post-build / pre-compile in variant pre-compile, destination=Pdu  # Reference to the "global" Pdu structure to allow harmonization of handle IDs in the COM-Stack.
            container DoIPSoAdUdpTxPdu  # This container describes a Tx PDU sent via SoAd over UDP. | If this DoIPUdpConnection is mapped to an IPv6 multicast connection in the lower layer, then the PDU referenced in this container is not used for Tx. Instead, the response to a request received over such a multicast connection will be sent via a unicast UDP connection (Hint: Only vehicle identification requests are supported over muticast).
              integer DoIPSoAdUdpTxPduId: 0..65535, scope=ECU, set at pre-compile, symbolic-name-value=true  # The DoIPSoAdUdpTxPduId is required by the API call DoIP_SoAdIfTxConfirmation that is called by the SoAd to confirm that the IPdu has been transmitted successfully.
              reference DoIPSoAdUdpTxPduRef: post-build-variant-value=true, set at link in variant link-time / post-build in variant post-build / pre-compile in variant pre-compile, destination=Pdu  # Reference to the "global" Pdu structure to allow harmonization of handle IDs in the COM-Stack.
          container DoIPUdpVehicleAnnouncementConnection [0..255]  # This container describes the UDP multicast connections to the lower layer SoAd module.
            boolean DoIPRequestAddressAssignment: set at pre-compile, default-value=true  # The DoIP module shall request IP address assignment by calling SoAd_RequestIpAddrAssignment() for the TcpIpLocalAddr related to this DoIpConnection.
            container DoIPSoAdUdpVehicleAnnouncementTxPdu  # This container describes the vehicle announcement TxPdu sent via the SoAd.
              integer DoIPSoAdUdpVehicleAnnouncementTxPduId: 0..4294967295, scope=ECU, set at pre-compile, symbolic-name-value=true  # The DoIPSoAdUdpVehicleAnnouncementTxPduId is required by the API call DoIP_SoAdIfTxConfirmation() that is called by the SoAd to confirm that the IPdu has been transmitted successfully.
              reference DoIPSoAdUdpVehicleAnnouncementTxPduRef: post-build-variant-value=true, set at link in variant link-time / post-build in variant post-build / pre-compile in variant pre-compile, destination=Pdu  # Reference to the "global" PDU structure to allow harmonization of handle IDs in the COM-Stack.
        container DoIPFurtherActionByteCallback [0..1]  # This container describes the Callbackfunction to get the Further Action byte. This container shall always be present. If the DoIPFurtherActionByteDirect parameter is not present, the DoIP module will use an RPort of ServiceInterface CallbackGetFurtherActionByte with the name "CBGetFurtherActionByte_<shortname of enclosing DoIPInterface container>".
          function name DoIPFurtherActionByteDirect [0..1]: set at link in variant link-time+post-build / pre-compile in variant pre-compile  # Direct C Callback function to get the OEM specific Further Action Byte for the DoIP vehicle identification response/vehicle announcement. If the DoIPFurtherActionByteDirect parameter is present, the DoIP module will not use an RPort of ServiceInterface "CBGetFurtherActionByte" but will call the configured function.
        container DoIPRoutingActivation [0..255]  # This container describes the routing activation possibilities by representing for each container a possible routing activation request message to the DoIP entity and the according references to the activated diagnostic messages.
          integer DoIPRoutingActivationNumber: 0..255, post-build-variant-value=true, set at link in variant link-time / post-build in variant post-build / pre-compile in variant pre-compile  # Identifies the Routing activation Number which is received for a DoIP routing activation request message.
          boolean DoIPRoutingActivationSecurityRequired [0..1]: default-value=false  # Indicates if a routing activation requires a secure TCP connection
          reference DoIPTargetAddressRef [1..65535]: multiplicity set at link in variant link-time / post-build in variant post-build / pre-compile in variant pre-compile, post-build-variant-multiplicity=true, post-build-variant-value=true, set at link in variant link-time / post-build in variant post-build / pre-compile in variant pre-compile, destination=DoIPTargetAddress  # Reference to all DoIPTargetAddress which are activated on this Routing activation.
          container DoIPRoutingActivationAuthenticationCallback [0..1]  # Container describes the Callbackfunction to call on a Routing Activation Request for Authentication. If this container is configured but the DoIPRoutingActivationAuthenticationFunc parameter is not present, the DoIP module will use an RPort of ServiceInterface <RoutingActivation>_RoutingActivation with the name "CB<RoutingActivation>RoutingActivation". <RoutingActivation> is the ShortName of the DoIPRoutingActiviation container.
            function name DoIPRoutingActivationAuthenticationFunc [0..1]: multiplicity set at link in variant link-time+post-build / pre-compile in variant pre-compile, set at link in variant link-time+post-build / pre-compile in variant pre-compile  # Direct C Callback function to trigger the authentication function for routing activation. If the DoIPRoutingActivationAuthenticationFunc parameter is present, the DoIP module will not use an RPort of ServiceInterface <RoutingActivation>_RoutingActivation but call the configured function.
            integer DoIPRoutingActivationAuthenticationReqLength: 0..4, set at link in variant link-time+post-build / pre-compile in variant pre-compile  # Describes the amount of bytes used to handle to the authentication function on routing activation. If 0 is configured as length the parameter AuthenticationReqData will not be handled to the API.
            integer DoIPRoutingActivationAuthenticationResLength: 0..4, set at link in variant link-time+post-build / pre-compile in variant pre-compile  # Describes the amount of bytes used to read by the authentication function on routing activation. If 0 is configured as length the parameter AuthenticationResData will not be fetched via the API.
          container DoIPRoutingActivationConfirmationCallback [0..1]  # Container describes the Callbackfunction to call on a Routing Activation Request for Confirmation. If this container is configured but the DoIPRoutingActivationConfirmationFunc parameter is not present the DoIP module will use an RPort of ServiceInterface <RoutingActivation>_RoutingActivation with the name "CB<RoutingActivation>RoutingActivation". <RoutingActivation> is the ShortName of the DoIPRoutingActiviation container.
            function name DoIPRoutingActivationConfirmationFunc [0..1]: multiplicity set at link in variant link-time+post-build / pre-compile in variant pre-compile, set at link in variant link-time+post-build / pre-compile in variant pre-compile  # Direct C Callback function to trigger the confirmation function for routing activation. If the DoIPRoutingActivationConfirmationFunc parameter is present the DoIP module will not use an RPort of ServiceInterface <RoutingActivation>_RoutingActivation but call the configured function.
            integer DoIPRoutingActivationConfirmationReqLength: 0..4, set at link in variant link-time+post-build / pre-compile in variant pre-compile  # Describes the amount of bytes used to handle to the confirmation function on routing activation. If 0 is configured as length the parameter ConfirmedReqData will not be handled to the API.
            integer DoIPRoutingActivationConfirmationResLength: 0..4, set at link in variant link-time+post-build / pre-compile in variant pre-compile  # Describes the amount of bytes used to read by the confirmation function on routing activation. If 0 is configured as length the parameter ConfirmedResData will not be fetched via the API.
        container DoIPTester [1..255]  # This container describes the properties of the possible connectable Tester for the DoIP entity.
          integer DoIPNumByteDiagAckNack: 0..4294967295, set at pre-compile  # Specifies the number of original Diagnostic request bytes the DoIP entity responses on a NACK of a diagnostic response message to the Tester.
          integer DoIPTesterSA: 0..65535, post-build-variant-value=true, set at link in variant link-time / post-build in variant post-build / pre-compile in variant pre-compile  # Source Address of the Tester sent via routing activation or diagnostic message.
          reference DoIPRoutingActivationRef [1..255]: multiplicity set at link in variant link-time / post-build in variant post-build / pre-compile in variant pre-compile, post-build-variant-multiplicity=true, post-build-variant-value=true, set at link in variant link-time / post-build in variant post-build / pre-compile in variant pre-compile, destination=DoIPRoutingActivation  # Reference to a DoIPRoutingActivation describing the possible routing activations of the DoIPTester
    container DoIPGeneral  # This container specifies the general configuration parameters of the DoIP module.
      boolean DoIPDevelopmentErrorDetect: set at pre-compile  # Switches the development error detection and notification on or off. | * true: detection and notification is enabled. * false: detection and notification is disabled.
      boolean DoIPDhcpOptionVinUse: set at pre-compile  # If DoIPDhcpOptionVinUse is set to true the DoIP module will add the VIN to the Dhcp host name if no valid Dhcp host name is already set.
      boolean DoIPEntityStatusMaxByteFieldUse: set at pre-compile  # This parameter is used to distinguish the optional support of the Max data size element of a diagnostic entity status response.
      integer DoIPGIDInvalidityPattern: 0..255, set at pre-compile  # Specifies the Byte pattern that is used for response messages if no valid GID could be retrieved. | Only the value '0' or '255' is allowed".
      integer DoIPHostNameSizeMax: 5..255, set at pre-compile  # Maximum Size of the DHCP HostName in ASCII. This parameter is necessary to reserve the correct amount of bytes for working with the DHCP HostName option. Minimum range is 5 because Dhcp Host Name should be at least "DoIP-" on any configuration.
      float DoIPMainFunctionPeriod: 0..INF, set at pre-compile  # Determines the frequency at which the DoIP_MainFunction() is called in [s].
      integer DoIPMaxRequestBytes: 1..4294967295, set at pre-compile  # Specifies the maximum allowed bytes of a DoIP message request without the DoIP header. This value shall not exceed (Max. size allowed for a PDU, which depends on the configuration PduLengthTypeEnum) - (DoIP Header size, which is 8 bytes).
      integer DoIPMaxUDPRequestPerConnection: 1..255, set at pre-compile  # This parameter captures the maximum amount of UDP Requests which can be handled parallel within a single UDP connection. (These requests will be received in separate UDP messages. In one UDP message, only one request will be accepted)
      enumeration DoIPNodeType: {DOIP_GATEWAY, DOIP_NODE}, set at pre-compile  # Describes the Type of the DoIP node.
      boolean DoIPUseEIDasGID: set at pre-compile  # Specifies if the DoIP entity shall use its EID if it is the Master for vehicle identification gid on the vehicle identification/vehicle announcement.
      boolean DoIPVersionInfoApi: set at pre-compile, default-value=false  # Activates the DoIP_GetVersionInfo() API. | TRUE: Enables the DoIP_GetVersionInfo() API. FALSE: DoIP_GetVersionInfo() API is not included.
      boolean DoIPVinGidMaster: set at pre-compile  # Specifies if the DoIP entity is the Vehicle identification Master for the GID (Group ID).
      integer DoIPVinInvalidityPattern: 0..255, set at pre-compile  # Specifies the Byte pattern that is used for response messages if no valid VIN could be retrieved. | Only the value '0' or '255' is allowed".
      container DoIPGetGidCallback [0..1]  # This container describes the usage of a callback function to get the GID. (If this container is not present no callback function shall be used by DoIP module to retrive the GID.)
        function name DoIPGetGidDirect [0..1]: multiplicity set at link in variant link-time+post-build / pre-compile in variant pre-compile, set at link in variant link-time+post-build / pre-compile in variant pre-compile  # If the DoIPGetGidDirect parameter exist the DoIP module shall call the configured callback function (<User>_DoIPGetGID) direct. (It is not needed to specify a service port to the DoIP service component.) | If the DoIPGetGidDirect parameter does NOT exist the DoIP module shall use a RPort with a CallbackGetGID type of client-server port interface to retrive the GID.
      container DoIPPowerModeCallback  # This container describes the usage of a callback function to retrieve the current power mode. This container shall always be present.
        function name DoIPPowerModeDirect [0..1]: multiplicity set at link in variant link-time+post-build / pre-compile in variant pre-compile, set at link in variant link-time+post-build / pre-compile in variant pre-compile  # If the DoIPPowerModeDirect parameter exist the DoIP module shall call the configured callback function (<User>_DoIPGetPowerModeCallback) direct. (It is not needed to specify a service port to the DoIP service component.) | If the DoIPPowerModeDirect parameter does NOT present the DoIP module shall use a RPort with a CallbackGetPowerMode type of client-server port interface to retrive the current power mode.
      container DoIPRbGeneral  # This container contains RB specific configuration parameters.
        boolean DoIPRbEnablePrototype [0..1]: origin=RB:AR45.3.3.0:2022-09-15, set at pre-compile  # Switch to enable(true)/disable(false) the following prototype features: 1. Support for Vehicle Identification requests received over IPv6 multicast local address 2. Usage of metadata to prevent binding of a wildcard socket to a remote address For series projects, this configuration must not be set to true.
        boolean DoIPRbFurtherActionByteIndependentFromRA: origin=RB:AR45.0.0:2021-07-30, set at pre-compile  # This parameter determines the value of further action byte of vehicle announcement / identification message: TRUE Further action byte in the vehicle announcement message will be set to 0x10, if routing activation with central security(0xE0) is configured. FALSE If routing activation with central security(0xE0) is configured, further action byte in the vehicle announcement message will be set to: 0x00, if routing activation with central security(0xE0) is referred by any of the doip testers and this routing activation is successful for at least one tester. Otherwise it will be set to 0x10. 0x10, if routing activation with central security(0xE0) is configured and the corresponding routing activation is not successful for any of the testers. If routing activation with central security(0xE0) is not configured, further action byte will always be set to 0x00 in vehicle announcement message
      container DoIPTriggerGidSyncCallback [0..1]  # This container describes the usage of a callback function to trigger the GID synchronization. (If this container does not exist no callback function shall be used by DoIP module to trigger the GID synchronization.)
        function name DoIPTriggerGidSyncDirect [0..1]: multiplicity set at link in variant link-time+post-build / pre-compile in variant pre-compile, set at link in variant link-time+post-build / pre-compile in variant pre-compile  # If the DoIPTriggerGidSyncDirect parameter exist the DoIP module shall call the configured callback function (<User>_DoIPTriggerGidSyncCallback) direct. (It is not needed to specify a service port to the DoIP service component.) | If the DoIPTriggerGidSyncDirect parameter does NOT present the DoIP module shall use a RPort with a CallbackTriggerGIDSynchnonization type of client-server port interface to trigger the GID synchronization.
