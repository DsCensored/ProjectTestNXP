AUTOSAR XML (schema 00048)
package /AUTOSAR_UdpNm/EcucModuleDefs
  module definition UdpNm [0..1]: category=VENDOR_SPECIFIC_MODULE_DEFINITION, post-build-variant-support=true, refined-module-def=UdpNm, variants link-time/pre-compile  # UDP Network Management
    container UdpNmGlobalConfig  # This container contains all global configuration parameters of UDP NM configured from the CanTrcv Module perspective.
      boolean UdpNmBusSynchronizationEnabled: set at pre-compile  # Pre-processor switch for enabling bus synchronization support. | This feature is required for gateway nodes only. It must not be defined if UdpNmPassiveModeEnabled==true. This parameter shall be derived from NmBusSynchronizationEnabled.
      boolean UdpNmComControlEnabled: set at pre-compile  # Pre-processor switch for enabling the Communication Control support. | dependency: calculationFormula = If (UdpNmPassiveModeEnabled == False) then Equal(NmComControlEnabled) else Equal(False)
      boolean UdpNmComUserDataSupport: set at pre-compile  # Enable/disable the user data support. | dependency: If UdpNmPassiveModeEnabled == True then UdpNmComUserDataSupport = False
      boolean UdpNmCoordinatorSyncSupport: set at pre-compile  # Enables/disables the coordinator synchronization support. | dependency: UdpNmCoordinatorSyncSupport has to be set to FALSE if UdpNmPassiveModeEnabled is set to TRUE.
      boolean UdpNmDevErrorDetect: set at pre-compile, default-value=false  # Switches the development error detection and notification on or off. | * true: detection and notification is enabled. * false: detection and notification is disabled.
      boolean UdpNmImmediateRestartEnabled: set at pre-compile  # Pre-processor switch for enabling the immediate transmission of a NM PACKET upon bus-communication request in Prepare-Bus-Sleep mode. | Must not be defined if UdpNmPassiveModeEnabled== true.
      integer UdpNmNumberOfChannels: 1..255, set at pre-compile  # Number of NM channels allowed within one ECU.
      boolean UdpNmPassiveModeEnabled: set at pre-compile  # Pre-processor switch for enabling support of the Passive Mode.
      boolean UdpNmPduRxIndicationEnabled: set at pre-compile  # Pre-processor switch for enabling the PDU Rx Indication. | This parameter shall be derived from NmPduRxIndicationEnabled.
      boolean UdpNmPnEiraCalcEnabled [0..1]: multiplicity set at link in variant link-time / pre-compile in variant pre-compile, set at link in variant link-time / pre-compile in variant pre-compile, default-value=false  # Specifies if UdpNm calculates the PN request information for internal and external requests. (EIRA) true: PN request are calculated | false: PN request are not calculated dependency: only available if UdpNmPnEnabled == true for at least one UdpNm Channel
      float UdpNmPnResetTime [0..1]: 0.001..65.535, multiplicity set at link in variant link-time / pre-compile in variant pre-compile, set at link in variant link-time / pre-compile in variant pre-compile  # Specifies the runtime of the reset timer in seconds. This reset time is valid for the reset of PN requests in the EIRA and in the ERA. The value shall be the same for every channel. Thus it is a global config parameter.
      boolean UdpNmPnSyncShutdownErrorReactionEnabled: origin=RB:45.1.4.0:2021-10-15, set at pre-compile  # Pre-processor switch for enabling reaction, if a top-level PNC coordinator received a PN shutdown message on a NM-channel which refer to a ComM channel that is actively coordinated by a PNC gateway..
      boolean UdpNmRemoteSleepIndEnabled: set at pre-compile  # Pre-processor switch for enabling remote sleep indication support. | This feature is required for gateway nodes only. It must not be defined if UdpNmPassiveModeEnabled==true. This parameter shall be derived from NmRemoteSleepIndEnabled.
      boolean UdpNmStateChangeIndEnabled: set at pre-compile  # Pre-processor switch for enabling the UDP NM state change notification. | This parameter shall be derived from NmStateChangeIndEnabled.
      boolean UdpNmUserDataEnabled: set at pre-compile  # Pre-processor switch for enabling user data support. | This parameter shall be derived from NmUserDataEnabled.
      boolean UdpNmVersionInfoApi: set at pre-compile, default-value=false  # Pre-processor switch for enabling version info API support.
      symbolic name reference UdpNmPnEiraRxNSduRef [0..1]: multiplicity set at link in variant link-time / pre-compile in variant pre-compile, post-build-variant-value=true, set at link in variant link-time / pre-compile in variant pre-compile, destination=Pdu  # Reference to a Pdu in the COM-Stack. Only one SduRef is required for UdpNm because the EIRA is the aggregation over all Ethernet Channels.
      container UdpNmChannelConfig [1..*]: multiplicity set at pre-compile, post-build-variant-multiplicity=true  # This container contains the channel-specific configuration parameters of the UdpNm.
        boolean UdpNmActiveWakeupBitEnabled [0..1]: multiplicity set at link in variant link-time / pre-compile in variant pre-compile, set at link in variant link-time / pre-compile in variant pre-compile, default-value=false  # Enables/Disables the handling of the Active Wakeup Bit in the UdpNm module. | dependency: This parameter is only valid if UdpNmPassiveModeEnabled is False.
        boolean UdpNmAllNmMessagesKeepAwake [0..1]: multiplicity set at link in variant link-time / pre-compile in variant pre-compile, set at link in variant link-time / pre-compile in variant pre-compile, default-value=false  # Specifies if UdpNm drops irrelevant NM PDUs. | false: Only NM PDUs with a PNI bit = true and containing a PN request for this ECU triggers the standard RX indication handling true: Every NM PDU triggers the standard RX indication handling
        integer UdpNmCarWakeUpBitPosition [0..1]: 0..7, multiplicity set at link in variant link-time / pre-compile in variant pre-compile, set at link in variant link-time / pre-compile in variant pre-compile, default-value=false  # Specifies the Bit position of the CWU within the NM PDU.
        integer UdpNmCarWakeUpBytePosition [0..1]: 0..7, multiplicity set at link in variant link-time / pre-compile in variant pre-compile, set at link in variant link-time / pre-compile in variant pre-compile, default-value=false  # Specifies the Byte position of the CWU within the NM PDU.
        boolean UdpNmCarWakeUpFilterEnabled [0..1]: multiplicity set at link in variant link-time / pre-compile in variant pre-compile, set at link in variant link-time / pre-compile in variant pre-compile, default-value=false  # If CWU filtering is supported, only the CWU bit within the NM PDU with source node identifier UdpNmCarWakeUpFilterNodeId is considered as CWU request. | FALSE - CWU filtering is not supported TRUE - CWU filtering is supported.
        integer UdpNmCarWakeUpFilterNodeId [0..1]: 0..255, multiplicity set at link in variant link-time / pre-compile in variant pre-compile, set at link in variant link-time / pre-compile in variant pre-compile, default-value=false  # Source node identifier for CWU filtering. If CWU filtering is supported, only the CWU bit within the NM PDU with source node identifier UdpNmCarWakeUpFilterNodeId is considered as CWU request. | dependency: only available if UdpNmCarWakeUpFilterEnabled == TRUE
        boolean UdpNmCarWakeUpRxEnabled: scope=ECU, set at link in variant link-time / pre-compile in variant pre-compile, default-value=false  # Enables or disables support of CarWakeUp bit evaluation in received NM PDUs. | FALSE - CarWakeUp not supported. TRUE - CarWakeUp supported.
        float UdpNmImmediateNmCycleTime [0..1]: 0.001..65.535, multiplicity set at link in variant link-time / pre-compile in variant pre-compile, set at link in variant link-time / pre-compile in variant pre-compile  # Defines the immediate NM PDU cycle time in seconds which is used for UdpNmImmediateNmTransmissions NM PDU transmissions. | dependency: This parameter is only valid if UdpNmImmediateNmTransmissions is greater one.
        integer UdpNmImmediateNmTransmissions: 0..255, set at link in variant link-time / pre-compile in variant pre-compile  # Defines the number of immediate NM PDUs which shall be transmitted. If the value is zero no immediate NM PDUs are transmitted. The cycle time of immeditate NM PDUs is defined by UdpNmImmediateNmCycleTime. | dependency: If UdpNmImmediateRestartEnabled = true then UdpNmImmediateNmTransmissions = 0 If UdpNmPnHandleMultipleNetworkRequests == True then UdpNmImmediateNmTransmissions
        float UdpNmMainFunctionPeriod: 0..INF, set at link in variant link-time / pre-compile in variant pre-compile  # Call cycle of UdpNm_MainFunction_x for the respective instance in [s].
        float UdpNmMsgCycleOffset: 0..65.535, post-build-variant-value=true, set at link in variant link-time / pre-compile in variant pre-compile  # Time offset in the periodic transmission node. It determines the start delay of the transmission. | less than UDPNM_MSG_CYCLE_TIME This parameter is only valid if UdpNmPassiveModeEnabled is disabled.
        float UdpNmMsgCycleTime: 0.001..65.535, set at link in variant link-time / pre-compile in variant pre-compile  # Period of a NM-message. It determines the periodic rate and is the basis for transmit scheduling. | NmTimeoutTime = n * UdpNmMsgCycleTime This parameter is only valid if UdpNmPassiveModeEnabled is disabled.
        float UdpNmMsgTimeoutTime: 0.001..65.535, origin=RB:AR45.0.1.0:2020-05-22, set at link in variant link-time / pre-compile in variant pre-compile  # RB (Vendor06) Transmission Timout of NM-message. If there is no transmission confirmation by the UDP Interface within this timeout, the UDPNM module shall give an error notification. | This parameter is only valid if UDPNM_PASSIVE_MODE_ENABLED is disabled. UDPNM_MSG_TIMEOUT_TIME should be a multiple of UDPNM_MSG_CYCLE_TIME.
        boolean UdpNmNodeDetectionEnabled: set at link in variant link-time / pre-compile in variant pre-compile  # Pre-processor switch for enabling the node detection support. | This parameter shall be derived from NmNodeDetectionEnabled. This parameter shall only be enabled if UdpNmNodeIdEnabled == true. If(UdpNmPduCbvPosition != UDPNM_PDU_OFF) then Equal(NmNodeDetectionEnabled) else Equal(False). dependency: Not available if UdpNmPassiveModeEnabled
        integer UdpNmNodeId [0..1]: 0..255, multiplicity set at link in variant link-time / post-build in variant post-build / pre-compile in variant pre-compile, origin=RB:45.2.0.0:2021-12-15, set at link in variant link-time / pre-compile in variant pre-compile  # Node identifier of local node. | RB (Vendor06) This parameter is only valid if UdpNmPassiveModeEnabled is set to OFF and UdpNmNodeDetectionEnabled is set to ON.
        boolean UdpNmNodeIdEnabled: set at link in variant link-time / pre-compile in variant pre-compile  # Pre-processor switch for enabling the source node identifier. | This parameter shall be derived from NmNodeIdEnabled.
        enumeration UdpNmPduCbvPosition: {UDPNM_PDU_BYTE_0, UDPNM_PDU_BYTE_1, UDPNM_PDU_OFF}, set at link in variant link-time / pre-compile in variant pre-compile  # Defines the position of the control bit vector within the NM PACKET. | The value of the parameter represents the location of the control bit vector in the NM PACKET (UDPNM_PDU_BYTE_0 means byte 0, UDPNM_PDU_BYTE_1 means byte 1, UDPNM_PDU_OFF means the control bit vector is not part of the NM PACKET) See also UdpNmPduNidPosition if (UdpNmPduCbvPosition != UDPNM_PDU_OFF && UdpNmPduNidPosition != UDPNM_PDU_OFF) then UdpNmPduCbvPosition != UdpNmPduNidPosition if (UdpNmPduCbvPosition != UDPNM_PDU_OFF && UdpNmPduNidPosition == UDPNM_PDU_OFF) then UdpNmPduCbvPosition = UDPNM_PDU_BYTE0
        enumeration UdpNmPduNidPosition: {UDPNM_PDU_BYTE_0, UDPNM_PDU_BYTE_1, UDPNM_PDU_OFF}, set at link in variant link-time / pre-compile in variant pre-compile  # Defines the position of the source node identifier within the NM PACKET. | ImplementationType: UdpNm_PduPositionType The value of the parameter represents the location of the source node identifier in the NM PACKET (UDPNM_PDU_BYTE_0 means byte 0, UDPNM_PDU_BYTE_1 means byte 1, UDPNM_PDU_OFF means source node identifier is not part of the NM PACKET) See also UdpNmPduCbvPosition if (UDPNM_PDU_NID_POSITION != UDPNM_PDU_OFF && UDPNM_PDU_CBV_POSITION != UDPNM_PDU_OFF) then UDPNM_PDU_NID_POSITION != UDPNM_PDU_CBV_POSITION if (UDPNM_PDU_NID_POSITION != UDPNM_PDU_OFF && UDPNM_PDU_CBV_POSITION == UDPNM_PDU_OFF) then UDPNM_PDU_IND_POSITION = UDPNM_PDU_BYTE0
        boolean UdpNmPnEnabled [0..1]: multiplicity set at link in variant link-time / pre-compile in variant pre-compile, set at link in variant link-time / pre-compile in variant pre-compile, default-value=false  # Enables or disables support of partial networking. | false: Partial networking Range not supported true: Partial networking supported dependency: only available if UdpNmPnEnabled == true
        boolean UdpNmPnEraCalcEnabled [0..1]: multiplicity set at link in variant link-time / pre-compile in variant pre-compile, set at link in variant link-time / pre-compile in variant pre-compile, default-value=false  # Specifies if UdpNm calculates the PN request information for external requests. (ERA) | false: PN request are not calculated true: PN request are calculated. dependency: only available if UdpNmPnEnabled == true
        boolean UdpNmPnHandleMultipleNetworkRequests [0..1]: multiplicity set at link in variant link-time / pre-compile in variant pre-compile, set at link in variant link-time / pre-compile in variant pre-compile, default-value=false  # false: UdpNm_NetworkRequest is ignored in NO. | true: UdpNm_NetworkRequest triggers a change from NO to RM. dependency: only available if UdpNmPnEnabled == true
        float UdpNmRemoteSleepIndTime: 0.001..65.535, set at link in variant link-time / pre-compile in variant pre-compile  # Timeout for Remote Sleep Indication. | It defines the time in [s] how long it shall take to recognize that all other nodes are ready to sleep. Typically it should be equal to: n * UdpNmMsgCycleTime, where n denotes the number of NM packets that are normally sent before Remote Sleep Indication is detected. The value of n decremented by one determines the amount of lost NM packets that can be tolerated by the Remote Sleep Indication procedure.
        float UdpNmRepeatMessageTime: 0..65.535, set at link in variant link-time / pre-compile in variant pre-compile  # Timeout for Repeat Message State. It defines the time in seconds how long the NM shall stay in the Repeat Message State. | dependency: UdpNmRepeatMessageTime = n * UdpNmMsgCycleTime; UdpNmRepeatMessageTime > UdpNmImmediateNmTransmissions * UdpNmImmediateNmCycleTime Typically it should be equal to: n * UdpNmMsgCycleTime, where n denotes the number of NM PDUs that are normally sent in the Repeat Message State. The value of n decremented by one determines the amount of lost NM PDUs that can be tolerated by the node detection procedure. The value 0 denotes that no Repeat Message State is configured. It means that Repeat Message State is transient what implicates that it is left immediately after entrance and in result no start-up stability is guaranteed and no node detection procedure is possible.
        boolean UdpNmRepeatMsgIndEnabled: set at link in variant link-time / pre-compile in variant pre-compile  # Enable/disable the notification that a RepeatMessageRequest bit has been received. | dependency: calculationFormula = If (UdpNmPassiveModeEnabled == False) then Equal(NmRepeatMsgIndEnabled) else Equal(False)
        boolean UdpNmRetryFirstMessageRequest [0..1]: multiplicity set at link in variant link-time / pre-compile in variant pre-compile, set at link in variant link-time / pre-compile in variant pre-compile  # Specifies if first message request in UdpNm is repeated until accepted by SoAd. | dependency: UdpNmRetryFirstMessageRequest = false if UdpNmPassiveModeEnabled == true
        boolean UdpNmStayInPbsEnabled: set at link in variant link-time / pre-compile in variant pre-compile, default-value=false  # If this parameter is disabled Prepare Bus-Sleep Mode is left after UdpNmWaitBusSleepTime. If this parameter is enabled Prepare Bus-Sleep Mode can only be left if ECU is powered off or any restart reason applies.
        boolean UdpNmSynchronizedPncShutdownEnabled [0..1]: multiplicity set at link in variant link-time / post-build in variant post-build / pre-compile in variant pre-compile, origin=RB:45.1.4.0:2021-10-15, set at link in variant link-time / pre-compile in variant pre-compile  # RB (Vendor06) Specifies if UdpNm handle PN shutdown messages to support a synchronized PNC shutdown across a PN topology. This is only used for ECUs in the role of a top-level PNC coordinator or intermediate PNC coordinator. Thus, the PNC gateway functionality is enabled and therefore ERA calculation is used. false: synchronized PNC shutdown is disabled true: synchronized PNC shutdown is enabled. .
        float UdpNmTimeoutTime: 0.002..65.535, set at link in variant link-time / pre-compile in variant pre-compile  # Network Timeout for NM packets. | It denotes the time in [s] how long the NM shall stay in the Network Mode before transition into Prepare Bus-Sleep Mode shall take place. It shall be equal for all nodes in the cluster. It shall be greater than UdpNmMsgCycleTime. Typically, it should be equal to: x * UdpNmMsgCycleTime, where n denotes the number of NM PACKET cycle times in the Ready Sleep State before transition into the Bus-Sleep Mode is initiated. The value of n decremented by one determines the amount of lost NM packets that can be tolerated by the coordination algorithm.
        float UdpNmWaitBusSleepTime [0..1]: 0.001..65.535, multiplicity set at link in variant link-time / post-build in variant post-build / pre-compile in variant pre-compile, set at link in variant link-time / pre-compile in variant pre-compile  # Timeout for bus calm down phase. | It denotes the time in [s] how long the NM shall stay in the Prepare Bus-Sleep Mode before transition into Bus-Sleep Mode shall take place. It shall be equal for all nodes in the cluster. It shall be long enough to empty all Tx-buffer empty.
        symbolic name reference UdpNmComMNetworkHandleRef: scope=ECU, post-build-variant-value=true, set at link in variant link-time / pre-compile in variant pre-compile, requires-symbolic-name-value=true, destination=ComMChannel  # This reference points to the unique channel defined by the ComMChannel and provides access to the unique channel index value in ComMChannelId.
        symbolic name reference UdpNmPnEraRxNSduRef [0..1]: multiplicity set at link in variant link-time / pre-compile in variant pre-compile, post-build-variant-value=true, set at link in variant link-time / pre-compile in variant pre-compile, destination=Pdu  # Reference to a Pdu in the COM-Stack. The SduRef is required for every UdpNm Channel, because ERA is reported per channel.
        container UdpNmRxPdu [1..*]: multiplicity set at pre-compile  # This container describes the UdpNm RX PDU's.
          integer UdpNmRxPduId: 0..4294967295, post-build-variant-multiplicity=true, post-build-variant-value=true, set at pre-compile, symbolic-name-value=true, with-auto=true  # ID of the RxPdu that will be used by a RxIndication of the lower layer.
          symbolic name reference UdpNmRxPduRef: set at link in variant link-time / pre-compile in variant pre-compile, destination=Pdu  # The reference to a PDU in the global PDU structure described in the AUTOSAR ECU Configuration Specification. This reference will be used by the UdpNm module to derive the PDU Id.
        container UdpNmTxPdu [0..1]: multiplicity set at pre-compile  # This container describes the UdpNm TX PDU's.
          integer UdpNmTxConfirmationPduId: 0..4294967295, post-build-variant-value=true, set at pre-compile, symbolic-name-value=true, with-auto=true  # Id of the TxPdu that will be used by a TxConfirmation from the lower layer.
          symbolic name reference UdpNmTxPduRef: multiplicity set at link in variant link-time / post-build in variant post-build / pre-compile in variant pre-compile, post-build-variant-value=true, set at link in variant link-time / pre-compile in variant pre-compile, destination=Pdu  # The reference to a PDU in the global PDU structure described in the AUTOSAR ECU Configuration Specification. This reference will be used by the UdpNm module to derive the PDU Id.
        container UdpNmUserDataTxPdu [0..1]: multiplicity set at pre-compile  # Preprocessor switch for enabling the Tx path of Com User Data. | Use case: Setting of NMUserData via SWC.
          integer UdpNmTxUserDataPduId: 0..65535, set at pre-compile, symbolic-name-value=true, with-auto=true  # This parameter defines the Handle ID of the NM User Data I-PDU.
          symbolic name reference UdpNmTxUserDataPduRef: set at link in variant link-time / pre-compile in variant pre-compile, destination=Pdu  # Reference to the NM User Data I-PDU in the global PDU collection.
      container UdpNmPnInfo [0..1]: multiplicity set at link in variant link-time / post-build in variant post-build / pre-compile in variant pre-compile  # PN information configuration
        integer UdpNmPnInfoLength: 1..7, set at link in variant link-time / pre-compile in variant pre-compile, default-value=1  # Specifies the length of the PN request information in the NM message.
        integer UdpNmPnInfoOffset: 1..7, set at link in variant link-time / pre-compile in variant pre-compile, default-value=1  # Specifies the offset of the PN request information in the NM message.
        container UdpNmPnFilterMaskByte [0..7]: multiplicity set at pre-compile  # PN information configuration
          integer UdpNmPnFilterMaskByteIndex: 0..6, post-build-variant-value=true, set at link in variant link-time / pre-compile in variant pre-compile  # Index of the filter mask byte. Specifies the position within the filter mask byte array.
          integer UdpNmPnFilterMaskByteValue: 0..255, set at link in variant link-time / pre-compile in variant pre-compile, default-value=0  # Parameter to configure the filter mask byte.
