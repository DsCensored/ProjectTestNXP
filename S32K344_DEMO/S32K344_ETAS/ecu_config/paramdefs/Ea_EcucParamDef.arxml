AUTOSAR XML (schema 4-2-2)
package /AUTOSAR_Ea/EcucModuleDefs
  module definition Ea [0..1]: category=VENDOR_SPECIFIC_MODULE_DEFINITION, refined-module-def=Ea, variants pre-compile  # Memory: EEPROM Abstraction | Configuration of the Ea (EEPROM Abstraction) module.
    container EaBlockConfiguration [1..65535]: multiplicity set at pre-compile  # Configuration of block specific parameters for the EEPROM Abstraction module.
      integer EaBlockNumber [0..1]: 1..65534, multiplicity set at pre-compile, set at pre-compile, symbolic-name-value=true  # Block identifier (handle). | 0x0000 and 0xFFFF shall not be used for block numbers (see EA006). Range: min = 2^NVM_DATASET_SELECTION_BITS max = 0xFFFF - 2^NVM_DATASET_SELECTION_BITS Note: Depending on the number of bits set aside for dataset selection several other block numbers shall also be left out to ease implementation.
      integer EaBlockSize: 1..65535, multiplicity set at pre-compile, set at pre-compile  # Size of a logical block in bytes.
      boolean EaImmediateData: multiplicity set at pre-compile, set at pre-compile  # Marker for high priority data. | true: Block contains immediate data. false: Block does not contain immediate data.
      integer EaNumberOfWriteCycles [0..1]: 0..4294967295, multiplicity set at pre-compile, set at pre-compile  # Number of write cycles required for this block.
      integer EaRbBlockPersistentId: 1..65534, multiplicity set at pre-compile, set at pre-compile, symbolic-name-value=true  # BlockIndex of corresponding NvM-Block, Link between NvM-Block and Ea-Block: min: 1 max: 65534
      string EaRbCallbackEnd [0..1]: multiplicity set at link in variant link-time / pre-compile in variant pre-compile, origin=RB:1.0.0:2011-09-09, set at link in variant link-time / pre-compile in variant pre-compile  # Name of callback function which is called after successful finished order. | Possible values are: Name of the CallBack-Function or EA_NULL if no CallBack-Function is available
      string EaRbCallbackError [0..1]: multiplicity set at link in variant link-time / pre-compile in variant pre-compile, origin=RB:1.0.0:2011-09-09, set at link in variant link-time / pre-compile in variant pre-compile  # Name of callback function which is called if order couldn't be finished successful. | Possible values are: Name of the CallBack-Function or EA_NULL if no CallBack-Function is available
      string EaRbCallbackStart [0..1]: multiplicity set at link in variant link-time / pre-compile in variant pre-compile, origin=RB:1.0.0:2011-09-09, set at link in variant link-time / pre-compile in variant pre-compile  # Name of callback function which is called before job is started. | Possible values are: Name of the CallBack-Function or EA_NULL if no CallBack-Function is available
      integer EaRbDeviceIndex [0..1]: 1..254, multiplicity set at pre-compile, set at pre-compile, symbolic-name-value=true  # Rb special device index for different EEPROM devices. | Range: 1...254 for Ea.
      boolean EaRbFirstReadDataMigration [0..1]: multiplicity set at pre-compile, origin=RB:9.0.0:2016-11-04, set at pre-compile  # First Read Data Migration | This tag activates or deactivates the First Read Data Migration feature. | False: First Read Data Migration is disabled (default).True: First Read Data Migration is enabled.
      enumeration EaRbOrigin [0..1]: multiplicity set at pre-compile, origin=RB:1.0.0:2011-09-09, set at pre-compile  # Responsible module for this configuration. | Only NVM supported
        NVM  # NvM block type
      integer EaRbSecLevel: 1..2, set at pre-compile, symbolic-name-value=true  # Security Level | Range: 1 = Block has one copy in Eeprom; 2 = Block has two identical copies in Eeprom for security
      boolean EaRbSurvival [0..1]: multiplicity set at pre-compile, origin=RB:1.0.0:2011-09-09, set at pre-compile  # Block survival attribute. | This tag changes the migration behaviour for this block in case it is not within the layout. | true: Migration will not delete this block, even if it is not part of the layout. false: Migration will delete this block if it is not part of the layout.
      symbolic name reference EaDeviceIndex [0..0]: multiplicity set at pre-compile, set at pre-compile, destination=EepGeneral  # Device index (handle). | Not used.
    container EaGeneral: multiplicity set at pre-compile  # Container for general parameters. These parameters are not specific to a block.
      integer EaBufferAlignmentValueRef [0..0]: multiplicity set at pre-compile, set at pre-compile  # Buffer Alignment | Parameter determines the alignment of the start address that Ea buffers need to have.Value shall be inherited from MemAccBufferAlignmentValue. This parameter is not supported by the Ea. Instead the MemMap section EA_START_SEC_VAR_SECURED_CACHED_RAM_ALIGNED_CLEARED_UNSPECIFIED can be used to specifically align Ea buffers containing data which is forward to lower layers.
      boolean EaDevErrorDetect: multiplicity set at pre-compile, set at pre-compile  # Pre-processor switch to enable and disable development error detection. | true: Development error detection enabled. false: Development error detection disabled.
      integer EaIndex: 0..254, multiplicity set at pre-compile, set at pre-compile  # Specifies the InstanceId of this module instance. If only one instance is present it shall have the Id 0.
      float EaMainFunctionPeriod: 0..1, multiplicity set at pre-compile, origin=RB:18.1.0:2021-08-30, set at pre-compile  # Call cycle time of the EEPROM Abstraction layer's main function. Unit: [s]
      integer EaMinimumReadPageSize [0..0]: multiplicity set at pre-compile, set at pre-compile  # Minimum Read Page Size | Minimum Page size will be a multiple of the minimum page size. Ea shall align read requests to this size. This features is not supported. The Ea assumes the lower layer can handle read requests in any granularity.
      function name EaNvmJobEndNotification [0..1]: multiplicity set at pre-compile, set at pre-compile  # Mapped to the job end notification routine provided by the upper layer module (NvM_JobEndNotification).
      function name EaNvmJobErrorNotification [0..1]: multiplicity set at pre-compile, set at pre-compile  # Mapped to the job error notification routine provided by the upper layer module (NvM_JobErrorNotification).
      boolean EaPollingMode: multiplicity set at pre-compile, set at pre-compile  # Pre-processor switch to enable and disable the polling mode for this module. | true: Polling mode enabled, callback functions (provided to Eep module) disabled. false: Polling mode disabled, callback functions (provided to Eep module) enabled.
      integer EaPushedEepSize [0..1]: 0..4294967295, multiplicity set at pre-compile, set at pre-compile  # The EEPROM size in bytes which is pushed from EEPROM driver. In case of Ea integrated with Eep this parameter value will be pushed from Eep to Ea automatically.In case of Ea integrated with 3rd party Eep driver then this value should be configured manually.This parameter correspond to the Eep driver Autosar Configuration parameter "EepSize"
      boolean EaRbActSurvivalEval [0..1]: multiplicity set at pre-compile, origin=RB:1.0.0:2011-09-09, set at pre-compile  # Activation of the "partial afterburner". | Pre-processor switch to enable or disable an additional block specific migration for unknown blocks with an active survival setting ("EaRbSurvival") in the medium. | true: Feature enabled ("block specific afterburner" on for blocks with active survival setting). false: Feature disabled ("block specific afterburner" off for blocks with active survival setting). default: true Hint: If activated, this block will be overtaken independent from the "EaRbActUnknownBlockMig" setting ("general afterburner"). To delete all unknown survival blocks, it should be deactivated.
      boolean EaRbActUnknownBlockMig [0..1]: multiplicity set at pre-compile, origin=RB:1.0.0:2011-09-09, set at pre-compile  # Activation of the "global afterburner". | Pre-processor switch to enable or disable an additional migration for any unknown block in the medium. Only the CB (Customer Block) is allowed to enable this feature, because this is because this is affecting the thresholds of migration start. It must be deactivated (default) for the ASW! | true: Feature enabled ("general afterburner" on for all unknown blocks). false: Feature disabled ("general afterburner" off for all unknown blocks). default: false. Hints: If activated, all unknown blocks will be overtaken independent from the "RbSurvival" setting ("block specific afterburner"). Only the CB (Customer Block) is allowed to enable this feature, because this is affecting the thresholds of migration start. It must be deactivated (default) for the ASW!
      boolean EaRbDevRuntimeErrorDetect [0..1]: multiplicity set at pre-compile, set at pre-compile  # Pre-processor switch to enable and disable development runtime error detection. In case the parameter is not configured, it shall be enabled | true: Development runtime error detection enabled. false: Development runtime error detection disabled.
      boolean EaRbEnterStopModeApi [0..1]: multiplicity set at pre-compile, origin=RB:1.0.0:2011-09-09, set at pre-compile  # Activation of EnterStopMode API | Pre-processor switch to enable or disable Stop Mode ("Stop Mode", "Write address based", "Read address based"). | true: Add-ons for CC-AS enabled. false: Add-ons for CC-AS disabled. default: false.
      function name EaRbErrorHandlingCallback [0..1]: multiplicity set at pre-compile, set at pre-compile, default-value=NULL_PTR  # Error handling callback in Ea module | Name of the module-specific callback routine which shall be invoked if critical error in Ea occurs, for example migration not successful or not possible, so that some block cann't been written any more.
      boolean EaRbFastModeCCPS [0..1]: multiplicity set at pre-compile, origin=RB:1.0.0:2011-09-09, set at pre-compile  # Activation of CC-PS specific Fast Mode | Pre-processor switch to Enable or Disable CC-PS Specific Fast Mode feature for writing Crash Data. It must be activated only for CC-PS productline. Eep_Mode should be Set to required MemIf_ModeType by calling Ea_SetMode function. | True : CC-PS Fast mode enabled. False: CC-PS Fast mode disabled. default:False.
      enumeration EaRbFsSelection [0..1]: multiplicity set at pre-compile, origin=RB:11.0.0:2017-10-25, set at pre-compile  # Selection of Filesystem | Specifies the actual layout of the data on EEPROM | If left unconfigured the component will not be activated.
        EaFs1  # Ea 1.0 Layout - Block Data and Header info are kept together
        EaFs2  # Ea 2.0 Layout - Block Data and Header info are kept separate
      enumeration EaRbMainFunctionScheduling [0..1]: multiplicity set at pre-compile, origin=RB:18.1.0:2021-08-30, set at pre-compile, default-value=EA_RB_MAINFUNC_SCHEDULING_RTE_TIMED  # MainFuntion Scheduling Type | Selection on type of scheduling required for the abstraction layer
        EA_RB_MAINFUNC_SCHEDULING_RTE_BACKGROUND  # RTE Background task
        EA_RB_MAINFUNC_SCHEDULING_RTE_TIMED  # RTE Timed task
        EA_RB_MAINFUNC_SCHEDULING_MANUAL  # Manual Scheduling
      integer EaRbMigEraseBufferSize [0..1]: 1..65535, multiplicity set at pre-compile, origin=RB:1.0.0:2017-03-10, set at pre-compile, default-value=50  # This parameter defines the size of an internal array (of uint32) used during migration. The array holds the address of the blocks to be removed from the Eeprom. This array is introduced to reduce the Initialization time during migration. Larger the size of the array, faster is the initialization time. For optimal performance the size of this array must be equal to or more than the number of blocks that are removed from old layout to new layout.
      boolean EaSetModeSupported: multiplicity set at pre-compile, set at pre-compile  # Compiler switch to enable/disable the 'SetMode' functionality of the EA module. | TRUE: SetMode functionality supported / code present, FALSE: SetMode functionality not supported / code not present. Note: This configuration setting has to be consistent with that of all underlying EEPROM device drivers.
      boolean EaVersionInfoApi: multiplicity set at pre-compile, set at pre-compile  # Pre-processor switch to enable / disable the API to read out the modules version information. | true: Version info API enabled. false: Version info API disabled.
      integer EaVirtualPageSize: 0..65535, multiplicity set at pre-compile, set at pre-compile  # The size in bytes to which logical blocks shall be aligned.
    container EaPublishedInformation: multiplicity set at pre-compile  # Additional published parameters not covered by CommonPublishedInformation container. | Note that these parameters do not have any configuration class setting, since they are published information.
      integer EaBlockOverhead: 0..65535, multiplicity set at pre-compile, set at published-information  # Management overhead per logical block in bytes. | Note: If the management overhead depends on the block size or block location a formula has to be provided that allows the configurator to calculate the management overhead correctly.
      float EaMaximumBlockingTime: 0..Inf, multiplicity set at pre-compile, set at published-information  # The maximum time the EA module API routines shall be blocked (delayed) by internal operations. | Note: Internal operations in that case means operations that are not explicitly invoked from the upper layer module but need to be handled for proper operation of this module or the underlying memory driver.
      integer EaPageOverhead: 0..65535, multiplicity set at pre-compile, set at published-information  # Management overhead per page in bytes. | Note: If the management overhead depends on the block size or block location a formula has to be provided that allows the configurator to calculate the management overhead correctly.
