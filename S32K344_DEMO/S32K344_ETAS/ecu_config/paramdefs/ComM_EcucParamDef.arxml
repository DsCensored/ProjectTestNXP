AUTOSAR XML (schema 00048)
package /AUTOSAR_ComM/EcucModuleDefs
  module definition ComM [0..1]: category=VENDOR_SPECIFIC_MODULE_DEFINITION, refined-module-def=ComM, variants pre-compile  # Configuration of the ComM (Communications Manager) module.
    container ComMConfigSet  # This container contains the configuration parameters and sub containers of the AUTOSAR ComM module.
      boolean ComMPncEnabled [0..1]: scope=ECU, multiplicity set at post-build in variant post-build / pre-compile in variant pre-compile, set at post-build in variant post-build / pre-compile in variant pre-compile, default-value=false  # Defines whether in this configuration set the partial networking is enabled. | true: Enabled false: Disabled
      container ComMChannel [1..256]: multiplicity set at pre-compile  # This container contains the configuration (parameters) of the bus channel(s). The channel parameters shall be harmonized within the whole communication stack.
        enumeration ComMBusType: {COMM_BUS_TYPE_CAN, COMM_BUS_TYPE_CDD, COMM_BUS_TYPE_ETH, COMM_BUS_TYPE_FR, COMM_BUS_TYPE_INTERNAL, COMM_BUS_TYPE_LIN}, scope=ECU, set at pre-compile  # Identifies the bus type of the channel.
        string ComMCDDBusPrefix [0..1]: multiplicity set at pre-compile, set at pre-compile  # Prefix to be used for API calls to CDD.
        integer ComMChannelId: 0..255, scope=ECU, set at pre-compile, symbolic-name-value=true, with-auto=true  # Channel identification number of the corresponding channel.
        boolean ComMFullCommRequestNotificationEnabled: set at pre-compile, default-value=false  # Defines if the optional SenderReceiver Port of Interface ComM_CurrentChannelRequest will be provided for this channel. | True means enabled. False means disabled
        float ComMMainFunctionPeriod: 0..INF, scope=ECU, set at pre-compile, default-value=0.02  # Specifies the period in seconds that the MainFunction has to be triggered with. | Comment: ComM scheduling shall be at least as fast as the communication stack and a schedule longer than 100ms makes no sense for communication.
        boolean ComMNoCom: set at pre-compile, default-value=false  # Not allowed to change state of ComM channel to COMM_SILENT_COMMUNICATION or COMM_FULL_COMMUNICATION. | true: Enabled - Not allowed to switch to Communication Modes above. false: Disabled - Allowed to switch Communication Modes above. Shall be possible to change parameter during runtime with ComM API's. ECU/All channels: ComM_LimitECUToNoComMode(). Separate channels: ComM_LimitChannelToNoComMode().
        boolean ComMNoWakeUpInhibitionNvmStorage: set at pre-compile  # If this parameter is set to "true", the NoWakeUp inhibition state of the channel shall be stored (in some implementation specific way) in the block pointed to by ComMGlobalNvmBlockDescriptor.
        boolean ComMNoWakeup: set at pre-compile, default-value=false  # Defines if an ECU is not allowed to wake-up the channel. | true: Enabled (not allowed to wake-up)) false: Disabled This is the default/init value of a runtime variable that can be changed during runtime using ComM_PreventWakeUp().
        enumeration ComMPncGatewayType [0..1]: {COMM_GATEWAY_TYPE_ACTIVE, COMM_GATEWAY_TYPE_PASSIVE}, scope=ECU, multiplicity set at pre-compile, set at pre-compile  # Identifies the Partial Network Gateway behaviour of a ComMChannel.
        float ComMTMinFullComModeDuration [0..1]: 0.001..65, origin=RB:18-01-2021, set at pre-compile  # Minimum time duration in seconds, spent in the COMM_FULL_COMMUNICATION sub-state COMM_FULL_COM_NETWORK_REQUESTED. This parameter per channel context is optional. If configured, this parameter value overrules the ComMTMinFullComModeDuration parameter in general ComM config for the corresponding ComMChannel. If not configured, the ComMTMinFullComModeDuration value per channel is considered from the parameter ComMTMinFullComModeDuration in general ComM config.
        boolean ComMWakeupSleepRequestEnabled [0..1]: multiplicity set at pre-compile, set at pre-compile, default-value=false  # Used for communication channels where the corresponding hardware support wake-up and/or sleep request capability on the network, e.g. OA TC10 compatible PHYs for Ethernet. | Dependency: Only applicable if ComMBusType equals COMM_BUS_TYPE_ETH and the used Ethernet hardware (e.g. PHY, Ethernet switch) is compatible with the OA TC10 specification.
        reference ComMChannelPartitionRef [0..0]: multiplicity set at pre-compile, set at pre-compile, destination=EcucPartition  # Reference to EcucPartition, where the according ComMChannel is assigned to. Tags: atp.Status=draft
        reference ComMManageReference [0..1]: multiplicity set at pre-compile, set at pre-compile, destination=ComMChannel  # Represenst the reference between a ComMChannel with role managing channel and a ComMChannel with role managed channel.
        container ComMNetworkManagement  # This container contains the configuration parameters of the networkmanagement.
          float ComMNmLightTimeout [0..1]: 0..255, multiplicity set at pre-compile, set at pre-compile, default-value=10  # Defines the timeout (in seconds) after COMM_FULL_COMMUNICATION sub-state COMM_FULL_COM_READY_SLEEP is left. | The range shall be greater than 0.0 and less or equal to 255.0.
          enumeration ComMNmVariant: {FULL, LIGHT, SLAVE_ACTIVE, SLAVE_PASSIVE, NONE, PASSIVE}, set at pre-compile, default-value=FULL  # Defines the functionality of the networkmanagement. | Shall be harmonized with NM configuration. Dependency: ComMNmVariant shall be NONE if ComMBusType = COMM_BUS_TYPE_INTERNAL. ComMNmVariant shall be LIGHT for managed channels. ComMNmVariant shall be FULL for managing channels.
          boolean ComMPncNmRequest: set at pre-compile, default-value=false  # If this parameter equals true then every time a FULL Communication is requested due to a change in the PNC state machine to COMM_PNC_REQUESTED Nm shall be called using the API Nm_NetworkRequest.
        container ComMUserPerChannel [0..255]: multiplicity set at pre-compile  # This container contains a list of identifiers that are needed to refer to a user in the system which is linked to a channel.
          reference ComMUserChannel: set at pre-compile, destination=ComMUser  # Reference to the ComMUser that corresponds to this channel user. | ImplementationType: COMM_UserHandleType
      container ComMPnc [0..56]: multiplicity set at pre-compile  # This container contains the configuration of the partial network cluster (PNC).
        integer ComMPncId: 8..63, scope=ECU, set at pre-compile, symbolic-name-value=true  # Partial network cluster identification number.
        float ComMPncMainFunctionPeriod: 0..INF, scope=ECU, origin=RB:2015-04-10, set at pre-compile  # Specifies the period in seconds that the Partial network MainFunction has to be triggered with.
        boolean ComMPncWakeupSleepRequestEnabled [0..1]: multiplicity set at pre-compile, set at pre-compile, default-value=false  # Used for PNCs where a requested PNC shall report an active communication request towards the BswM. The BswM forward the active communication request to the lower layer communication channels where the used hardware support wake-up and/or sleep request capability on the network, e.g. OA TC10 compatible PHYs for Ethernet. This is used e.g. for Ethernet Switch port group switching.
        reference ComMChannelPerPnc [1..256]: multiplicity set at post-build in variant post-build / pre-compile in variant pre-compile, set at post-build in variant post-build / pre-compile in variant pre-compile, destination=ComMChannel  # Reference to the ComMChannel that is required for this PNC. | ImplementationType: NetworkHandleType
        reference ComMPncEthIfSwitchPortGroupRef [0..255]: scope=ECU, multiplicity set at link in variant post-build / pre-compile in variant pre-compile, set at link in variant post-build / pre-compile in variant pre-compile, requires-symbolic-name-value=true, destination=EthIfSwitchPortGroup  # Reference to the PortGroups that correspond to this PNC. Note: This is only for documentation.
        reference ComMUserPerPnc [0..255]: multiplicity set at post-build in variant post-build / pre-compile in variant pre-compile, set at post-build in variant post-build / pre-compile in variant pre-compile, destination=ComMUser  # Reference to the ComMUsers that correspond to this PNC. | ImplementationType: COMM_UserHandleType
        container ComMPncComSignal [0..*]: multiplicity set at pre-compile  # Represents the PncComSignals which are used to communicate the EIRA and ERA status of this PNC.
          enumeration ComMPncComSignalDirection: {RX, TX}, set at pre-compile  # Indicates the communication direction of this PncComSignal.
          enumeration ComMPncComSignalKind [0..1]: {EIRA, ERA}, multiplicity set at pre-compile, set at pre-compile  # Indicates whether this PncComSignal represents EIRA or ERA PNC information. | This parameter ComMPncComSignalKind is optional and shall be ignored when ComMPncComSignalDirection equals TX.
          reference ComMPncComSignalChannelRef [0..1]: multiplicity set at pre-compile, set at pre-compile, destination=ComMChannel  # Reference to the ComMChannel which is used to determine whether this PncComSignal shall participate in the active or passive role (via the parameter ComMPncGatewayType of the ComMChannel).
          reference ComMPncComSignalRef: scope=ECU, set at pre-compile, requires-symbolic-name-value=true, destination=ComSignal  # Reference to the ComSignal which is used to transport the partial network channel request information.
      container ComMUser [0..255]: multiplicity set at pre-compile  # This container contains a list of identifiers that are needed to refer to a user in the system which is designated to request Communication modes.
        boolean ComMUserDisableRtePort [0..1]: scope=ECU, multiplicity set at pre-compile, origin=RB:8.4.0:2020-03-16, set at pre-compile, default-value=false  # This parameter disables the generation of p-ports to the application. True : ComM disables the generation of p-ports.False : ComM enables the generation of p-ports.
        integer ComMUserIdentifier: 0..254, set at pre-compile, symbolic-name-value=true  # An identifier that is needed to refer to a user in the system which is designated to request Communication Modes. | ImplementationType: ComM_UserHandleType
        reference ComMUserEcucPartitionRef [0..0]: scope=ECU, multiplicity set at pre-compile, set at pre-compile, destination=EcucPartition  # Denotes in which "EcucPartition" the requester is executed. When the partition is stopped, the communication request shall be cancelled in the ComM | to avoid a stay-awake situation of the bus due to a stopped partition.
    container ComMGeneral  # General configuration parameters of the Communication Manager.
      boolean ComM0PncVectorAvoidance [0..1]: multiplicity set at pre-compile, set at pre-compile, default-value=false  # This parameter avoids sending of 0-PNC-Vectors in case ComMPncGatewayEnabled is enabled.
      boolean ComMDevErrorDetect: set at pre-compile, default-value=false  # Switches the development error detection and notification on or off. | * true: detection and notification is enabled. * false: detection and notification is disabled.
      boolean ComMDirectUserMapping [0..0]: multiplicity set at pre-compile, set at pre-compile, default-value=false  # If this parameter is set to true the configuration tool shall automatically create a ComMUser per ComMPnc and a ComMUser per ComMChannel. | The shortName of the generated ComMUsers shall follow the following naming convention: PNCUser_ComMPncId, e.g. PNCUser_13 ChannelUser_ComMChannelId, e.g. ChannelUser_25 Restriction: ComMUser, which are created due to this configuration parameter, shall not be used by SWCs (only available for BswM).
      integer ComMEcuGroupClassification: 0..255, set at pre-compile, default-value=3  # Defines whether a mode inhibition affects the ECU or not. | Examples: 000: No mode inhibition can be activated 001: Wake up inhibition can be enabled
      boolean ComMModeLimitationEnabled: set at pre-compile, default-value=false  # true if mode limitation functionality shall be enabled. | true: Enabled false: Disabled
      boolean ComMPncGatewayEnabled [0..1]: multiplicity set at pre-compile, set at pre-compile, default-value=false  # Enables or disables support of Partial Network Gateway. | False: Partial Networking Gateway is disabled True: Partial Networking Gateway is enabled
      float ComMPncPrepareSleepTimer [0..1]: 0..63, multiplicity set at pre-compile, set at pre-compile  # Time in seconds the PNC state machine shall wait in COMM_PNC_PREPARE_SLEEP.
      boolean ComMPncSupport: set at pre-compile, default-value=false  # Enables or disables support of partial networking. | False: Partial Networking is disabled True: Partial Networking is enabled
      boolean ComMResetAfterForcingNoComm: set at pre-compile, default-value=false  # ComM shall perform a reset after entering "No Communication" mode because of an active mode limitation to "No Communication" mode. | true: Enabled false: Disabled
      boolean ComMRteEnabled: origin=RB:2015-04-10, set at pre-compile, default-value=false  # Enables or disables support of RTE.False: RTE is disabled.True: RTE is enabled.
      boolean ComMSynchronizedPncShutdownEnabled [0..1]: multiplicity set at pre-compile, set at pre-compile, default-value=false  # Enables or disables support of synchronized PNC shutdown. | False: synchronized PNC shutdown is disabled True: synchronized PNC shutdown is enabled NOTE: This is only possible for ECU that has the role of an top-level PNC coordinator or intermediate PNC within the PNC network
      boolean ComMSynchronousWakeUp: set at pre-compile, default-value=true  # Wake up of one channel shall lead to a wake up of all channels if true. | true: Enabled false: Disabled
      float ComMTMinFullComModeDuration: 0.001..65, set at pre-compile, default-value=5  # Minimum time duration in seconds, spent in the COMM_FULL_COMMUNICATION sub-state COMM_FULL_COM_NETWORK_REQUESTED.
      boolean ComMVersionInfoApi: set at pre-compile, default-value=false  # Switches the possibility to read the published information with the service ComM_GetPublishedInformation(). | true: Enabled false: Disabled
      boolean ComMWakeupInhibitionEnabled: set at pre-compile, default-value=false  # true if wake up inhibition functionality enabled. | true: Enabled false: Disabled
      reference ComMGlobalNvMBlockDescriptor [0..1]: scope=ECU, multiplicity set at pre-compile, set at pre-compile, requires-symbolic-name-value=true, destination=NvMBlockDescriptor  # Reference to NVRAM block containing the none volatile data. If this parameter is not configured it means that no NVRam is used at all.
