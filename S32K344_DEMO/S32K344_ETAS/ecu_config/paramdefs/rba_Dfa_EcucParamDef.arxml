AUTOSAR XML (schema 00048)
package /RB/RBA/rba_Dfa/EcucModuleDefs
  module definition rba_Dfa [0..1]: category=VENDOR_SPECIFIC_MODULE_DEFINITION, post-build-variant-support=true, variants pre-compile  # MCAL DFA Modelling Unit | Configuration of the MCAL module for the DFA (data flow architecture) modelling unit.
    container rba_DfaConfigSet [0..1]: multiplicity set at pre-compile  # Configuration data set | This is the base container that contains the post-build selectable configuration parameters
      container rba_DfaFFTCalculations [0..*]: multiplicity set at pre-compile, post-build-variant-multiplicity=true  # FFT Calculation | This is the container for the FFT algorithm specific parameters.
        enumeration rba_DfaFFTCalculationMode: multiplicity set at pre-compile, origin=RB, post-build-variant-multiplicity=true, post-build-variant-value=true, set at pre-compile  # Calculation Mode | Select in which mode this Model is to be calculated: A: Synchronous B: Asynchronous
          RBA_DFA_CALCULATION_MODE_FFT_SYNC  # Synchronous
          RBA_DFA_CALCULATION_MODE_FFT_ASYNC  # Asynchronous
        integer rba_DfaFFTDimension: 7..11, multiplicity set at pre-compile, origin=RB, post-build-variant-multiplicity=true, post-build-variant-value=true, set at pre-compile  # Dimension | Size of the Vector (log2).
        enumeration rba_DfaFFTInputType: multiplicity set at pre-compile, origin=RB, post-build-variant-multiplicity=true, post-build-variant-value=true, set at pre-compile  # InputType | This parameter specifies the Input Type: Real: Only a Real Input Vector should be provided. Complex: Real and Imag. Vectors should be provided.
          RBA_DFA_INPUT_TYPE_COMPLEX_E  # Complex
          RBA_DFA_INPUT_TYPE_REAL_E  # Real
        enumeration rba_DfaFFTNumberType: multiplicity set at pre-compile, origin=RB, post-build-variant-multiplicity=true, post-build-variant-value=true, set at pre-compile  # NumberType | This parameter specifies the Data Type of the Numbers. Currently only float32 is supported.
          RBA_DFA_INPUT_DATA_TYPE_FLOAT32_E  # float32
          RBA_DFA_INPUT_DATA_TYPE_INTEGER_E  # Integer
        enumeration rba_DfaFFTOutputType: multiplicity set at pre-compile, origin=RB, post-build-variant-multiplicity=true, post-build-variant-value=true, set at pre-compile  # OutputType | This parameter specifies the length of the resulting spectrum and whether the spectrum should be normalized.
          RBA_DFA_SPECTRUM_NORM_FULL_E  # Full Normalised
          RBA_DFA_SPECTRUM_NORM_HALF_E  # Half Normalised
          RBA_DFA_SPECTRUM_NATIVE_FULL_E  # Full Native
          RBA_DFA_SPECTRUM_NATIVE_HALF_E  # Half Native
      container rba_DfaMultilayerPerceptron [0..*]: multiplicity set at pre-compile, post-build-variant-multiplicity=true  # MultilayerPerceptron | This is the container for the Gaussian RBF model specific parameters.
        enumeration rba_DfaMultilayerPerceptronCalculationMode: multiplicity set at pre-compile, origin=RB, post-build-variant-multiplicity=true, post-build-variant-value=true, set at pre-compile  # Calculation Mode | Select in which mode this MultilayerPerceptron is to be calculated: A: Synchronous B: Asynchronous
          RBA_DFA_CALCULATION_MODE_MULTILAYERPERCEPTRON_SYNC  # Synchronous
          RBA_DFA_CALCULATION_MODE_MULTILAYERPERCEPTRON_ASYNC  # Asynchronous
        string rba_DfaMultilayerPerceptronName: multiplicity set at pre-compile, origin=RB:0.7.0:2013-05-14, post-build-variant-multiplicity=true, post-build-variant-value=true, set at pre-compile, max-length=30, min-length=1  # MultilayerPerceptron name | Name of the model data to be used.
      container rba_Dfa_GaussModels [0..*]: multiplicity set at pre-compile, post-build-variant-multiplicity=true  # Gaussian Model | This is the container for the Gaussian RBF model specific parameters.
        enumeration rba_DfaModelCalculationMode: multiplicity set at pre-compile, origin=RB, post-build-variant-multiplicity=true, post-build-variant-value=true, set at pre-compile  # Calculation Mode | Select in which mode this Model is to be calculated: A: Synchronous B: Asynchronous
          RBA_DFA_CALCULATION_MODE_GAUSSIAN_RBF_SYNC  # Synchronous
          RBA_DFA_CALCULATION_MODE_GAUSSIAN_RBF_ASYNC  # Asynchronous
        integer rba_DfaModelDataDimension: 1..32, multiplicity set at pre-compile, origin=RB:0.7.0:2013-05-14, post-build-variant-multiplicity=true, post-build-variant-value=true, set at pre-compile  # Model Dimension | Dimension of the AMU Model
        string rba_DfaModelDataName: multiplicity set at pre-compile, origin=RB:0.7.0:2013-05-14, post-build-variant-multiplicity=true, post-build-variant-value=true, set at pre-compile, max-length=30, min-length=1  # Model data name | Name of the model data to be used.
    container rba_DfaGeneral: multiplicity set at pre-compile  # General settings | Container with general configuration (parameters) of the Dfa Driver software module.
      boolean rba_DfaDevErrorDetect: origin=RB, set at pre-compile  # Development error detection | Enables/disables the detection and notification of development errors. If this parameter is enabled, then extended error checking is performed during runtime; any errors detected by these checks are reported to the Det module. This feature should be switched off in series software.
      integer rba_DfaMonLvl [0..1]: 0..1, multiplicity set at pre-compile, origin=RB, set at pre-compile, default-value=0  # Monitoring level | Selection of the monitoring level for the calculation time: 0: Monitoring is disabled (default) 1: Common monitoring
