AUTOSAR XML (schema 00048)
package /AUTOSAR_EthTrcv/EcucModuleDefs
  module definition EthTrcv [0..*]: category=VENDOR_SPECIFIC_MODULE_DEFINITION, refined-module-def=EthTrcv, variants link-time/post-build/pre-compile  # Configuration of Ethernet Transceiver Driver module
    container EthTrcvConfigSet  # This container contains the configuration parameters and sub containers of the AUTOSAR EthTrcv module.
      container EthTrcvConfig [1..*]: multiplicity set at link in variant link-time+post-build / pre-compile in variant pre-compile  # Configuration of the individual transceiver
        enumeration EthTrcvConnNeg: {TRCV_CONN_NEG_AUTO, TRCV_CONN_NEG_MASTER, TRCV_CONN_NEG_SLAVE}, set at link in variant link-time / post-build in variant post-build / pre-compile in variant pre-compile  # Specifies the connection negotiation of the Ethernet transceiver link.
        enumeration EthTrcvDuplexMode: {ETHTRCV_DUPLEX_MODE_FULL, ETHTRCV_DUPLEX_MODE_HALF}, set at link in variant link-time / post-build in variant post-build / pre-compile in variant pre-compile  # Specifies the duplex mode of the Ethernet transceiver link if Auto-Negotiation is disabled. This parameter is ignored if Auto-Negotiation is enabled (EthTrcvConnNeg=TRCV_CONN_NEG_AUTO).
        integer EthTrcvIdx: 0..255, scope=ECU, set at pre-compile, symbolic-name-value=true  # Specifies the instance ID of the configured transceiver.
        enumeration EthTrcvMacLayerSpeed [0..1]: {ETH_MAC_LAYER_SPEED_100M, ETH_MAC_LAYER_SPEED_10G, ETH_MAC_LAYER_SPEED_10M, ETH_MAC_LAYER_SPEED_1G, ETH_MAC_LAYER_SPEED_2500M}, scope=ECU, multiplicity set at link in variant link-time+post-build / pre-compile in variant pre-compile, set at link in variant link-time+post-build / pre-compile in variant pre-compile  # Defines the baud rate of the MAC layer.
        enumeration EthTrcvMacLayerSubType [0..0]: {LIGHT, REDUCED, REVERSED, SERIAL, STANDARD, UNIVERSAL_SERIAL}, scope=ECU, multiplicity set at link in variant link-time+post-build / pre-compile in variant pre-compile, set at link in variant link-time+post-build / pre-compile in variant pre-compile  # Defines the MAC layer subtype of a switch port
        enumeration EthTrcvMacLayerType [0..0]: {TRCV_MAC_LAYER_TYPE_XGMII, TRCV_MAC_LAYER_TYPE_XMII, TRCV_MAC_LAYER_TYPE_XXGMII}, scope=ECU, multiplicity set at link in variant link-time / post-build in variant post-build / pre-compile in variant pre-compile, set at link in variant link-time / post-build in variant post-build / pre-compile in variant pre-compile  # Defines the MAC layer type of the ethernet transceiver.
        enumeration EthTrcvPhysLayerType [0..0]: {TRCV_PHYS_LAYER_TYPE_1000BASE_T, TRCV_PHYS_LAYER_TYPE_1000BASE_T1, TRCV_PHYS_LAYER_TYPE_100BASE_T1, TRCV_PHYS_LAYER_TYPE_100BASE_TX}, multiplicity set at link in variant link-time / post-build in variant post-build / pre-compile in variant pre-compile, set at link in variant link-time / post-build in variant post-build / pre-compile in variant pre-compile  # Specifies the physical layer type of the Ethernet transceiver link.
        boolean EthTrcvRbAutoNegotiationEnabled: origin=RB:0.2.0:2020-07-28, set at link in variant link-time / post-build in variant post-build / pre-compile in variant pre-compile  # Specifies if Auto-Negotiation is enabled (TRUE) or disabled (FALSE) for determination of the Ethernet transceiver speed and the duplexmode type like half or full duplex.
        enumeration EthTrcvRbDriverMiiApi: {ETHTRCV_DRIVER_SUPPORT_ASYNC_MIICOMMUNICATION, ETHTRCV_DRIVER_SUPPORT_NO_ASYNC_MIICOMMUNICATION, ETHTRCV_DRIVER_SUPPORT_OAWAPI_TO_PROVIDE_MII_FUNCTIONALITY}, origin=RB:0.2.0:2020-07-28, set at link in variant link-time / post-build in variant post-build / pre-compile in variant pre-compile  # The communication from EthTrcv to Phy-hardware is managed by Mac (controller) hardware and SW. The SW-API is defined by Autosar by Eth_ReadMii and Eth_WriteMii. To avoidblocking of micro-controller during Mii-(MDio)-communication this API is defined to be asynchron. But some controllers does not support interrupts (by Mac- hardware)when a Mii(Mdio) word is written/received. These SW-controllers-drivers may not support asynchron communication. With this (EthTrcvDriverMiiAPI)configuration parameter it is possible to define the capability of Eth-Driver:ETHTRCV_DRIVER_SUPPORT_OAWAPI_TO_PROVIDE_MII_FUNCTIONALITY is the default configuraion parameter. It is defined at RB that each Eth-controller-driver shall provides its capabilityto communicate async or sync by OAW-API: String Eth_Aspect_MiiBehaviour(). EthTrcv uses this OAW-API so configurator does not need to know the features of the EthDriver. If there is an error at validationin EthTrcv, Eth-driver is not RB conform and then configurator needs to know the capability of Eth-driver and should configure other parameters here (EthTrcvDriverMiiApi).ETHTRCV_DRIVER_SUPPORT_ASYNC_MIICOMMUNICATION: Driver supports async communication and calls EthTrcv_ReadMiiIndication or EthTrcv WriteMiiIndication function after each Eth_ReadMii and Eth_WriteMii.ETHTRCV_DRIVER_SUPPORT_NO_ASYNC_MIICOMMUNICATION: Driver does not support async communication and is not allowed to call EthTrcv_ReadMiiIndication nor EthTrcv WriteMiiIndication.
        enumeration EthTrcvRbIoPowerSelection [0..1]: {EXTERNAL_3_3V, INTERNAL_LDO_2_5V, EXTERNAL_2_5V, INTERNAL_LDO_1_8V, EXTERNAL_1_8V}, multiplicity set at link in variant link-time / post-build in variant post-build / pre-compile in variant pre-compile, origin=RB:0.2.0:2020-07-28, set at link in variant link-time / post-build in variant post-build / pre-compile in variant pre-compile  # The RTL9000AA/RTL9000AN supports 3.3V/2.5V/1.8V I/O voltage of the MII interface.When using 3.3V as the power source,it must be provided be an external power source.The RTL9000AA/AN also supports an internal LDO for 1.8V/2.5V I/O voltage with some changes ofsettings.This 1.8V/2.5V power source could also be provided by an external power source.
        enumeration EthTrcvRbPortMacLayerType [0..1]: {TRCV_MAC_LAYER_TYPE_MII, TRCV_MAC_LAYER_TYPE_RMII, TRCV_MAC_LAYER_TYPE_RevMII, TRCV_MAC_LAYER_TYPE_GMII, TRCV_MAC_LAYER_TYPE_RGMII, TRCV_MAC_LAYER_TYPE_RGMII_DELAY, TRCV_MAC_LAYER_TYPE_SGMII}, multiplicity set at link in variant link-time / post-build in variant post-build / pre-compile in variant pre-compile, origin=RB:0.2.0:2020-07-28, set at link in variant link-time / post-build in variant post-build / pre-compile in variant pre-compile  # Defines the MAC layer type of the ethernet transceiver.
        boolean EthTrcvRbSplitInitIntoBlocks [0..1]: multiplicity set at link in variant link-time / post-build in variant post-build / pre-compile in variant pre-compile, origin=RB:0.2.0:2020-07-28, set at link in variant link-time / post-build in variant post-build / pre-compile in variant pre-compile  # This parameter is valid only for RTL9000AA/AN and mdio communication is async.When this parameter is true the Init commands are split into blocks.The first block isexecuted from trcv init api and remaining blocks are executed from main functionand hence takes more time.When this parameter is false the init commands are executed frominit api.The default value of parameter is false.
        enumeration EthTrcvRbWakeUpDuration [0..1]: {TRCV_WUD_20_US, TRCV_WUD_10_MS}, multiplicity set at link in variant link-time / post-build in variant post-build / pre-compile in variant pre-compile, origin=RB:0.2.0:2020-07-28, set at link in variant link-time / post-build in variant post-build / pre-compile in variant pre-compile  # Specifies the Wakeup High or Low Duration time configurable at HW. This parameter is supported only for RTL9010AA.
        enumeration EthTrcvRbWakeUpEdgeDetection [0..1]: {TRCV_WUD_EDGE_HIGH, TRCV_WUD_EDGE_LOW}, multiplicity set at link in variant link-time / post-build in variant post-build / pre-compile in variant pre-compile, origin=RB:0.2.0:2020-07-28, set at link in variant link-time / post-build in variant post-build / pre-compile in variant pre-compile  # Specifies the Wakeup High or Low edge detection configurable at HW. This parameter is supported only for RTL9010AA.
        enumeration EthTrcvSpeed: {TRCV_SPEED_10, TRCV_SPEED_100, TRCV_SPEED_1000}, set at link in variant link-time / post-build in variant post-build / pre-compile in variant pre-compile  # Specifies the speed of the Ethernet transceiver link in [MBit/s]. If AutoNegotiation is enabled (EthTrcvConnNeg=TRCV_CONN_NEG_AUTO) this is the maximum speed advertised for Auto-Negotiation.
        function name EthTrcvWakeUpCallout [0..0]: multiplicity set at pre-compile, set at pre-compile  # Configuration of the call-out name.
        reference EthTrcvConfigEcucPartitionRef [0..0]: scope=ECU, multiplicity set at pre-compile, set at pre-compile, destination=EcucPartition  # Maps the Ethernet transceiver configuration to zero or one ECUC partitions. The ECUC partition referenced is a subset of the ECUC partitions where the Ethernet transceiver driver is mapped to.
        reference EthTrcvIcuChannelRef [0..1]: multiplicity set at pre-compile, set at pre-compile, requires-symbolic-name-value=true, destination=IcuChannel  # Reference to the IcuChannel to enable/disable the interrupts for wakeups.
        container EthTrcvDemEventParameterRefs [0..1]: multiplicity set at pre-compile  # Container for the references to DemEventParameter elements which shall be invoked using the API Dem_SetEventStatus in case the corresponding error occurs. The EventId is taken from the referenced DemEventParameter's DemEventId symbolic value. The standardized errors are provided in this container and can be extended by vendor-specific error references.
          enumeration EthTrcvRbDynCreate_ETHTRCV_E_ACCESS [0..1]: {Disabled, Standard}, multiplicity set at link in variant link-time / post-build in variant post-build / pre-compile in variant pre-compile, origin=RB:0.2.0:2020-07-28, set at link in variant link-time / post-build in variant post-build / pre-compile in variant pre-compile  # Selects the way how the example DemEvent is created. If not set or set to Disabled, no such DemEvent is automatically created. If the dynamic creation of this DemEvent is enabled, the reference to this DemEvent (in parameter rba_Example_DemEventRef) is also automatically created and shall therefore not be set manually.
          reference ETHTRCV_E_ACCESS [0..1]: multiplicity set at link in variant link-time / post-build in variant post-build / pre-compile in variant pre-compile, set at link in variant link-time / post-build in variant post-build / pre-compile in variant pre-compile, requires-symbolic-name-value=true, destination=DemEventParameter  # Reference to the DemEventParameter which shall be issued when the error "Transceiver access failed" has occurred.
        choice container EthTrcvMgmtInterface [0..1]: multiplicity set at pre-compile  # The choice container allow to configure either the EthTrcv is accessed by a MII interface or Switch interface.
          container EthTrcvMiiInterface [0..1]: multiplicity set at pre-compile  # This container includes the MII interface configuration between an Ethernet Controller and the Ethernet Transceiver. If this container is configured the EthTrcv shall call Eth_WriteMii / Eth_ReadMii API to access the hardware ethernet tranceiver.
            integer EthTrcvCtrlIdx: 0..255, set at link in variant link-time / post-build in variant post-build / pre-compile in variant pre-compile  # Specifies the controller used for MII access to the transceiver
            integer EthTrcvMiiIdx: 0..255, set at pre-compile  # Specifies the transceiver index used for MII access to the transceiver.
          container EthTrcvSwitchInterface [0..0]: multiplicity set at pre-compile  # This container includes the Switch interface configuration between an Ethernet Switch and an Ethernet Transceiver. If this container is configured the EthTrcv shall call EthSwt_WriteTrcvRegister / EthSwt_WriteTrcvRegister API to access the hardware ethernet transceiver.
            reference EthTrcvSwitchPortRef [0..0]: set at pre-compile, requires-symbolic-name-value=true, destination=EthSwtPort  # Reference to a switch port.
            reference EthTrcvSwitchRef: set at pre-compile, requires-symbolic-name-value=true, destination=EthSwtConfig  # Reference to a switch configuration container.
        container EthTrcvRbAccess [0..1]: multiplicity set at pre-compile  # Container gives EthTrcv Driver information about access to a single Eth transceiver.
          container EthTrcvRbDioAccess  # Container gives Eth transceiver driver information about accessing ports and port pins. In addition relation between Eth transceiver hardware pin names and Dio port access information is given. If a Eth transceiver hardware has no Dio interface, there is no instance of this container.
            container EthTrcvRbDioChannelAccess [1..3]: multiplicity set at pre-compile  # Container gives DIO channel access by single Eth transceiver channel.
              enumeration EthTrcvRbDioHardwareInterfaceType: {Reset, Enable, Wake}, origin=RB:0.2.0:2020-07-28, set at link in variant link-time / post-build in variant post-build / pre-compile in variant pre-compile  # Container gives DIO channel access by single Eth transceiver channel.
              reference EthTrcvRbDioSymNameRef: origin=RB:0.2.0:2020-07-28, set at pre-compile, requires-symbolic-name-value=true, destination=DioChannel  # Container gives DIO channel access by single Eth transceiver channel.
        container EthTrcvRbTrcvSpecificParam [0..1]: multiplicity set at pre-compile  # Transceiver specific parameters.
          container EthTrcvRbTJA1100 [0..1]: multiplicity set at pre-compile  # Special Container for TJA1100 configuration. This can be configured for enabling some of the features of the TJA1100. But this has to be done in accordance with the hardware configuration.
            enumeration EthTrcvRbAUTO_PWD [0..1]: {ETHTRCV_AUTO_PWD_DISABLED, ETHTRCV_AUTO_PWD_ENABLED}, multiplicity set at pre-compile, origin=RB:0.2.0:2020-07-28, set at pre-compile, default-value=ETHTRCV_AUTO_PWD_DISABLED  # RB (Vendor06) specific parameter: If autonomous power-down is enabled via Configuration register 1 (AUTO_PWD = 1), the TJA1100 goes to Sleep Request mode automatically if no Ethernet frames have been received at the MDI and MII for the time-out time, tto(pd)autn. Currently, it is not supported
            enumeration EthTrcvRbCONFIG_INH [0..1]: {ETHTRCV_CONFIG_INH_OFF_IN_DIS_MODE, ETHTRCV_CONFIG_INH_ON_IN_DIS_MODE}, multiplicity set at pre-compile, origin=RB:0.2.0:2020-07-28, set at pre-compile, default-value=ETHTRCV_CONFIG_INH_ON_IN_DIS_MODE  # RB (Vendor06) specific parameter: Reg17 Bit1, 0 = INH switched off in Disable mode; 1 = INH switched on in Disable mode.This control signal is used to activate the supply to the ECU's microcontroller.
            enumeration EthTrcvRbJUMBO_ENABLE [0..1]: {ETHTRCV_4KB_SUPPORT, ETHTRCV_16KB_SUPPORT}, multiplicity set at pre-compile, origin=RB:0.2.0:2020-07-28, set at pre-compile, default-value=ETHTRCV_16KB_SUPPORT  # RB (Vendor06) specific parameter: It enables/disables the jumbo packet support. Reg 19 Bit2: 0 = packets up to 4 kB supported; 1 = packets up to 16 kB supported
            enumeration EthTrcvRbLED_ENABLE [0..1]: {ETHTRCV_LED_OUTPUT_DISABLED, ETHTRCV_LED_OUTPUT_ENABLED}, multiplicity set at pre-compile, origin=RB:0.2.0:2020-07-28, set at pre-compile, default-value=ETHTRCV_LED_OUTPUT_DISABLED  # RB (Vendor06) specific parameter: It enables/disables the LED output and Wake input. This shall be configured according to the hardware configuration. Reg 18 Bit3: 0 = LED output disabled, WAKE input enabled; 1 = LED output enabled, WAKE input disabled.
            enumeration EthTrcvRbLED_MODE [0..1]: {ETHTRCV_LED_MODE_LINK_UP, ETHTRCV_LED_MODE_FRAME_RECEPTION, ETHTRCV_LED_MODE_SYMBOL_ERROR, ETHTRCV_LED_MODE_CRS_SIGNAL}, multiplicity set at pre-compile, origin=RB:0.2.0:2020-07-28, set at pre-compile, default-value=ETHTRCV_LED_MODE_LINK_UP  # RB (Vendor06) specific parameter: This configuration is valid only if the EthTrcvRbLED_ENABLE configuration is enabled.The LED can be configured to indicate link status,frame reception,symbol error or CRS signal.
            integer EthTrcvRbLinkUpDelay [0..1]: 2000..5000, multiplicity set at pre-compile, origin=RB:0.2.0:2020-07-28, set at pre-compile, default-value=2000  # Specifies the delay in microseconds between mode active and enabling link control.
            enumeration EthTrcvRbMII_DRIVER [0..1]: {ETHTRCV_MII_DRIVER_STANDARD, ETHTRCV_MII_DRIVER_REDUCED}, multiplicity set at pre-compile, origin=RB:0.2.0:2020-07-28, set at pre-compile, default-value=ETHTRCV_MII_DRIVER_STANDARD  # RB (Vendor06) specific parameter: This configures the driver strength for the MII lines.
            enumeration EthTrcvRbOperationMode: {ETHTRCV_AUTO_OP_MANAGED, ETHTRCV_AUTO_OP_AUTONOMOUS}, multiplicity set at pre-compile, origin=RB:0.2.0:2020-07-28, set at pre-compile  # RB (Vendor06) specific parameter:In managed operation,once the mode of the transceiver is active, the LINK_CONTROL bit needs to be set to 'ENABLE',the PHY configured as master initiates the training sequence by transmitting idle pulses.The link is established when bit LINK_UP in the communication status register is set.In Autonomous operation, the link is activated by the transceiver once the transceivers mode is active.
            enumeration EthTrcvRbTX_AMPLITUDE [0..1]: {ETHTRCV_TX_AMPLITUDE_500MV, ETHTRCV_TX_AMPLITUDE_750MV, ETHTRCV_TX_AMPLITUDE_1000MV, ETHTRCV_TX_AMPLITUDE_1250MV}, multiplicity set at pre-compile, origin=RB:0.2.0:2020-07-28, set at pre-compile, default-value=ETHTRCV_TX_AMPLITUDE_1000MV  # RB (Vendor06) specific parameter:The default value of 1000 mV can support a link of up to 15 m, while the lower values of 500 mV and 750 mV may be sufficient for shorter links of up to 2m.For links longer than 15 m and those exposed to strong electromagnetic interference,1250 mV is recommended to cope with the interference.
        container EthTrcvWakeupMap [0..7]: multiplicity set at pre-compile  # Container for the mapping of wake up reasons to wake up sources. At least one container is needed if EthTrcvWakeUpSupport is not ETHTRCV_WAKEUP_NOT_SUPPORTED.
          enumeration EthTrcvRbWakeupReason: {ETHTRCV_WUR_BUS, ETHTRCV_WUR_GENERAL, ETHTRCV_WUR_INTERNAL, ETHTRCV_WUR_PIN, ETHTRCV_WUR_POWER_ON, ETHTRCV_WUR_RESET, ETHTRCV_WUR_SYSERR}, set at link in variant link-time / post-build in variant post-build / pre-compile in variant pre-compile  # This parameter defines the transceiver wake up reasons.
          reference EthTrcvRbWakeupSourceRef: set at pre-compile, requires-symbolic-name-value=true, destination=EcuMWakeupSource  # Configures the wake-up source defined in EcuM.
    container EthTrcvGeneral  # General configuration of Ethernet Transceiver Driver module
      boolean EthTrcvDevErrorDetect: set at pre-compile, default-value=false  # Switches the development error detection and notification on or off. | * true: detection and notification is enabled. * false: detection and notification is disabled.
      boolean EthTrcvEnableCableDiagnosticApi: set at pre-compile  # Enable/disable the APIs for cable diagnostic: EthTrcv_RunCableDiagnostic, EthTrcv_GetCableDiagnosticsResult
      boolean EthTrcvGetBaudRateApi: set at pre-compile  # Enables / Disables EthTrcv_GetBaudRate API
      boolean EthTrcvGetCableDiagnosticsResultApi: set at pre-compile  # Enables / Disables EthTrcv_GetCableDiagnosticsResult API.
      boolean EthTrcvGetDuplexModeApi: set at pre-compile  # Enables / Disables EthTrcv_GetDuplexMode API
      boolean EthTrcvGetLinkStateApi: set at pre-compile  # Enables / Disables EthTrcv_GetLinkState API
      boolean EthTrcvGetPhyIdentifierApi: multiplicity set at pre-compile, set at pre-compile  # Enables / Disables EthTrcv_GetPhyIdentifier API.
      boolean EthTrcvGetPhySignalQualityApi: multiplicity set at pre-compile, set at pre-compile  # Enables / Disables EthTrcv_GetPhySignalQuality API.
      boolean EthTrcvGetTransceiverWakeupModeApi [0..1]: multiplicity set at pre-compile, set at pre-compile  # Enables / Disables EthTrcv_GetTransceiverWakeupMode API
      integer EthTrcvIndex: 0..255, set at pre-compile  # Specifies the InstanceId of this module instance. If only one instance is present it shall have the Id 0.
      float EthTrcvMainFunctionPeriod [0..1]: 0..INF, multiplicity set at pre-compile, set at pre-compile  # Specifies the period of main function EthTrcv_MainFunction in seconds.
      integer EthTrcvMaxTrcvsSupported: 0..255, set at pre-compile, default-value=1
      string EthTrcvRbCallBackHeaderFile [0..1]: multiplicity set at pre-compile, origin=RB:0.2.0:2020-07-28, set at pre-compile  # Specifies the header file, where the call back API(Configured via parameter - EthTrcvRbCableDiagCallout) is declared. Needs to be configured if the Transceiver selected is RTL9000AA
      string EthTrcvRbDriverPrefixHeaderFile [0..1]: multiplicity set at pre-compile, origin=RB:0.2.0:2020-07-28, set at pre-compile  # Specifies the header file, where Eth_ReadMii and Eth_WriteMii APIs are available when there is no ethIfEthDriverPrefix available in the EthIf. Mandatory configuration in this case.
      boolean EthTrcvRbGetConnNegConfigApi [0..1]: multiplicity set at pre-compile, origin=RB:0.2.0:2020-07-28, set at pre-compile, default-value=false  # Enables / Disables EthTrcvRbGetConnNegConfig API.
      boolean EthTrcvRbGetLinkStatisticsApi [0..1]: multiplicity set at pre-compile, origin=RB:0.2.0:2020-07-28, set at pre-compile, default-value=false  # Enables / Disables EthTrcvRbGetLinkStatistics API.
      boolean EthTrcvRbGetLinkTrainingDurationApi [0..1]: multiplicity set at pre-compile, origin=RB:0.2.0:2020-07-28, set at pre-compile, default-value=false  # Enables / Disables EthTrcvRbGetLinkTrainingDuration API.
      enumeration EthTrcvRbHardwareType: {DP83822, RTL9010AA, TJA1100, RTL9000AA, RTL9000AN, MARVELL_88Q2112}, origin=RB:0.2.0:2020-07-28, set at pre-compile  # RB (Vendor06) specific parameter: Type of the used Hardware
      string EthTrcvRbLinkTrainingCallout [0..1]: multiplicity set at pre-compile, origin=RB:0.2.0:2020-07-28, set at pre-compile  # Specifies the callback that needs to be called on completion of Link training. Only requireed for TJA1100 Syntax: void <CallBackName> (uint8 TrcvIdx, uint32 LinkTrainingDuration TrcvIdx - Id of the Transceiver LinkTrainingDuration - Link training duration in milli seconds
      boolean EthTrcvRbPolarityCorrectionDisable [0..1]: multiplicity set at pre-compile, origin=RB:11.0.0:2021-05-31, set at pre-compile, default-value=FALSE  # This enables or disables polarity correction. Polarity correction supported only for RTL9000AA and RTL9000AN.
      boolean EthTrcvRbSetConnNegConfigApi [0..1]: multiplicity set at pre-compile, origin=RB:0.2.0:2020-07-28, set at pre-compile, default-value=false  # Enables / Disables EthTrcvRbSetConnNegConfig API.
      boolean EthTrcvRbSetPhyLoopbackModeApi [0..1]: multiplicity set at pre-compile, origin=RB:0.2.0:2020-07-28, set at pre-compile, default-value=false  # This api configures the Phy to requested loopback(internal, external or remote) mode. This api is available for TJA1100, RTL9000AA and RTL9010AA EthTrcv. Enables / Disables EthTrcvRbSetPhyLoopbackMode API.
      boolean EthTrcvSetPhyTestModeApi [0..1]: multiplicity set at pre-compile, set at pre-compile, default-value=false  # This api is used to configure the Phy to requested test mode. This api is available for TJA1100 and RTL9000AA EthTrcv.
      boolean EthTrcvSetPhyTxModeApi: multiplicity set at pre-compile, set at pre-compile  # Enables / Disables EthTrcv_SetPhyTxMode API.
      boolean EthTrcvStartAutoNegotiationApi: set at pre-compile  # Enables / Disables EthTrcv_StartAutoNegotiation API
      boolean EthTrcvVersionInfoApi: set at pre-compile, default-value=false  # Enables / Disables version info API
      boolean EthTrcvVersionInfoApiMacro: set at pre-compile, default-value=false  # Enables / Disables version info API macro implementation
      enumeration EthTrcvWakeUpSupport: {ETHTRCV_WAKEUP_BY_INTERRUPT, ETHTRCV_WAKEUP_BY_POLLING, ETHTRCV_WAKEUP_NOT_SUPPORTED}, set at pre-compile  # Configures wake-up to polling or interrupt or to not used/not supported. In case no wake up is supported by the hardware, the BSWMD pre-configuration shall be set to ETHTRCV_WAKEUP_NOT_SUPPORTED.
      boolean EthTrcvRbRwakeDis [0..1]: origin=RB:3.0.0:2022-06-08, set at link in variant link-time / post-build in variant post-build / pre-compile in variant pre-compile, default-value=FALSE  # Enables or disables remote wake up pulse to link partner. Configure this parameter to true if Link partner does not support TC10 to disable default remote wake pulse upon local wake up to RTL9000AA/AN. This parameter is supported only for RTL9000AA/AN.
      reference EthTrcvEcucPartitionRef [0..*]: scope=ECU, multiplicity set at pre-compile, set at pre-compile, destination=EcucPartition  # Maps the Ethernet transceiver driver to zero or multiple ECUC partitions to make the modules API available in this partition. The Ethernet transceiver driver will operate as an independent instance in each of the partitions.
