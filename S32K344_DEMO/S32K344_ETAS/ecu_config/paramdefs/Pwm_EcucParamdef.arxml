AUTOSAR XML (schema 00048)
package /AUTOSAR_Pwm/EcucModuleDefs
  module definition Pwm [0..1]: category=VENDOR_SPECIFIC_MODULE_DEFINITION, post-build-variant-support=true, refined-module-def=Pwm, variants pre-compile  # MCAL PwmDriver | Configuration of the MCAL module Pulse Width Modulation outputs
    container PwmChannelConfigSet  # Channel configuration data set | Defines one data set of post-build configuration. Which of these data sets is actually active is controlled by EcuM. Data sets can only be switched at initialization time.
      container PwmChannel [1..1000]: multiplicity set at pre-compile, post-build-variant-multiplicity=true  # Channel | Configuration of a single PWM output signal. The short name of the signal encodes the logic IO signal to which this PwmSignal belongs (e.g. 'FuelPump').
        string Pwm0RbCustSpecName [0..1]: multiplicity set at pre-compile, origin=RB:0.6.0:2013-02-20, post-build-variant-multiplicity=true, post-build-variant-value=true, set at pre-compile, max-length=60, min-length=1  # Customer-specific name (opt.) | Customer-specific name of this signal. If present, this name is given in the report file additionally
        enumeration PwmChannelClass: post-build-variant-value=true, set at pre-compile  # Channel class | Defines whether the period can be changed in addition to the duty cycle. Class "shifted" is used for special (synchronized) slave channels together with a master channel (trigger signal, BLDC motor control), period and duty can be changed. Additionally configure container "Shift channel parameters" for class "shifted". PWM_VARIABLE_PERIOD: Api xxx_SetPeriodAndDuty() and xxx_SetDuty() is allowed. PWM_FIXED_PERIOD: Api xxx_SetDuty() is allowed, ATTENTION as deviation from Autosar xxx_SetPeriodAndDuty() is also allowed. PWM_FIXED_PERIOD_SHIFTED: this channel follows a master channel waveform, just shifted with an offset. You need to fill out configuration container "Shift channel parameters". ATTENTION as deviation from Autosar a variable period is also allowed.
          PWM_VARIABLE_PERIOD  # Variable Period
          PWM_FIXED_PERIOD  # Fixed Period
          PWM_FIXED_PERIOD_SHIFTED  # Fixed Period Shifted
        integer PwmDutycycleDefault: 0..32768, post-build-variant-value=true, set at pre-compile  # Init duty cycle [100%=0x8000] | Duty cycle of this signal after initialization (0x0000 = 0% ... 0x8000 = 100%). This duty stays until the driving software requires a different one by function call. The duty cycle is always the length of the start pulse, by parameter "Polarity" you can give the direction of this pulse (high-pulse or low-pulse).
        enumeration PwmIdleState: post-build-variant-value=true, set at pre-compile  # Idle state | Defines the output state of the PWM channel for function call Pwm_SetOutputToIdle() ONLY ! PWM_HIGH means the channel output is set to high level. PWM_LOW means the channel output is set to low level. This parameter may have no effect for external devices (power stages) as a call of xxx_SwitchOff() will switch off the power stage directly ignoring any Pwm setting. Attention: This parameter does not define the meaning of duty 0%, look at main parameter "Polarity". Unfortunatelly in Autosar the second parameter "Idle State" exists, be sure it is set accordingly to Polarity: Polarity = High -- Idle State = Low Polarity = Low -- Idle State = High
          PWM_LOW  # Low Level
          PWM_HIGH  # High Level
        function name PwmNotification [0..1]: multiplicity set at pre-compile, post-build-variant-multiplicity=true, post-build-variant-value=true, set at pre-compile, default-value=NULL_PTR  # Edge notification (opt.) | Defines the name of the optional callback function for this channel. Callback can be enabled/disabled for rising, falling, both edges by related Pwm notification functions but need an additional full OS ISR configuration for the related GTM cell. Use with care as ISR for fast signals means runtime load. NULL_PTR is allowed as dummy placeholder.
        float PwmPeriodDefault: 0.., post-build-variant-value=true, set at pre-compile  # Init period [s] or [0.1 CrS] | Period of this signal after initialization. Timebase PWM_TIME: (seconds in float format like 1 or 0.1234 or 2.5E-6) This period stays until the driving software requires a different one by function call. A value of 0 makes no sense and will break the Build. If parameter MaxPeriod is not given for timing signals, Init period is used to calculate clockbase and timer range: ATOM (24bit) Period < 0.3355s Clock0 [20ns] 2.98Hz - 4000Hz Period > 0.3355s Clock2 [400ns] 0.15Hz - 4000Hz Period > 6.71s not possible TOM (16bit) Period < 0.00131s FX_Clock0 [20ns] 763Hz - 4000Hz Period > 0.00131s FX_Clock1 [320ns] 47.6Hz - 4000Hz Period > 0.02097s FX_Clock2 [5120ns] 2.98Hz - 1000Hz Period > 0.33553s FX_Clock3 [81920ns] 0.186Hz - 100Hz Period > 5.368s FX_Clock4 [1310720ns] 0.009Hz - 10Hz Period > 85.9s not possible
        enumeration PwmPolarity: post-build-variant-value=true, set at pre-compile, default-value=PWM_LOW  # Polarity | Defines the equidistant period starting edge of each PWM channel. PWM_HIGH means the channel output starts with high pulse at the beginning of the cycle, duty 0% means low level. PWM_LOW means the channel output starts with low pulse at the beginning of the cycle, duty 0% means high level. The given duty cycle is the length of the start pulse. Unfortunatelly in Autosar the second parameter "Idle State" exists, be sure it is set accordingly to Polarity: Polarity = High -- Idle State = Low Polarity = Low -- Idle State = High
          PWM_LOW  # Low Level
          PWM_HIGH  # High Level
        float PwmRbMaxPeriod [0..1]: 0.., multiplicity set at pre-compile, origin=RB:0.1.0:2012-01-18, post-build-variant-multiplicity=true, post-build-variant-value=true, set at pre-compile  # Max period [s] (opt.) | Maximum period (lowest frequency) the signal output shall be capable of, if class VARIABLE_PERIOD is set. If not given then MaxPeriod = InitPeriod is used for Clockbase selection. Timebase PWM_TIME: (seconds in float format like 1 or 0.1234 or 2.5E-6). ATOM (24bit) Period < 0.3355s Clock0 [20ns] 2.98Hz - 4000Hz Period > 0.3355s Clock2 [400ns] 0.15Hz - 4000Hz Period > 6.71s not possible TOM (16bit) Period < 0.00131s FX_Clock0 [20ns] 763Hz - 4000Hz Period > 0.00131s FX_Clock1 [320ns] 47.6Hz - 4000Hz Period > 0.02097s FX_Clock2 [5120ns] 2.98Hz - 1000Hz Period > 0.33553s FX_Clock3 [81920ns] 0.186Hz - 100Hz Period > 5.368s FX_Clock4 [1310720ns] 0.009Hz - 10Hz Period > 85.9s not possible Timebase PWM_ANGLE: parameter will be ignored, do not configure.
        float PwmRbMinPeriod [0..1]: 0.., multiplicity set at pre-compile, origin=RB:0.1.0:2012-01-18, post-build-variant-multiplicity=true, post-build-variant-value=true, set at pre-compile  # Min period [s] (opt.) | Minimum period of this signal (seconds) if class VARIABLE_PERIOD is set. Parameter NOT USED at all.
        integer PwmRbStartOffset [0..1]: 0..65535, multiplicity set at pre-compile, origin=RB:3.0.0:2014-07-21, post-build-variant-multiplicity=true, post-build-variant-value=true, set at pre-compile  # Start Offset Sequence (opt.) | To enable feature StartOffset for this signal give a sequence number here (0,1, 2, ..., MAX_OFFSET_NUMBER), double values or value gaps are allowed. Values shall be given by HW-port assignment list. Formula : PeriodStartValue = PwmRbStartOffset * Fastest_Period / (MAX_OFFSET_NUMBER + 1) StartOffset=0 means no offset, period starts immediately after (A)TOM enable in Pwm_Init(), but nevertheless there is a short delay of 200ns between two consecutive channels even with StartOffset=0 because of an Ini-loop used to start channels.
        enumeration PwmRbTimebase [0..1]: multiplicity set at pre-compile, origin=RB:1.22.0:2015-07-24, post-build-variant-multiplicity=true, post-build-variant-value=true, set at pre-compile, default-value=PWM_TIME  # Timebase (opt.) | Defines the clock source for Pwm channel: PWM_TIME means the channel output clock source is a time base clock. PWM_ANGLE not supported anymore. If parameter is not given then PWM_TIME is used.
          PWM_TIME  # Time Clock
          PWM_TIME  # Time Clock
        integer PwmRbTimerAngleDelay [0..0]: 0..7199, multiplicity set at pre-compile, origin=RB:1.24.0:2016-01-29, post-build-variant-multiplicity=true, post-build-variant-value=true, set at pre-compile  # Angle signal phase delay [0.1] (opt.) | Not supported anymore
        enumeration PwmRbTimerUnit: {GTM_ATOM, GTM_TOM, GTM_XTOM_UNUSED}, origin=RB:0.1.0:2012-01-18, post-build-variant-value=true, set at pre-compile, default-value=GTM_XTOM_UNUSED  # Timer Unit | Defines the timer unit for Pwm channel: GTM_ATOM (internal 24bit calculations) GTM_TOM (internal 16bit calculations) GTM_XTOM_UNUSED for dummy signals without Gtm ressources
        function name PwmRbVirtFunc [0..1]: multiplicity set at pre-compile, origin=RB, post-build-variant-multiplicity=true, post-build-variant-value=true, set at pre-compile  # Virtualization function
        container PwmRbShiftContainer [0..1]: multiplicity set at pre-compile, post-build-variant-multiplicity=true  # Shift channel parameters | This container contains the configuration (parameters) in case the channel class is "PWM_FIXED_PERIOD_SHIFTED" and is synchronized by a master channel
          boolean PwmRbShiftIndependentApi [0..1]: multiplicity set at pre-compile, origin=RB:3.0.0:2014-07-21, post-build-variant-multiplicity=true, post-build-variant-value=true, set at pre-compile  # Independent value setting (opt.) | TRUE: use only new function calls with explicit value setting for Shift channel ( SetShiftedXXX() or SetGroupXXX() ) FALSE: use Master channel function calls only, Shift channel follows master and uses same period and duty values Mandatory set to TRUE for SetGroupXXX() signals. For SetShiftedXXX() signals you have the choice but set to TRUE if you want to avoid normal Pwm_Set(Master, value) API affect Slave channel value output. If parameter is not given then FALSE is used.
          boolean PwmRbShiftManualStart [0..1]: multiplicity set at pre-compile, origin=RB:3.0.0:2014-07-21, post-build-variant-multiplicity=true, post-build-variant-value=true, set at pre-compile  # Start Manually (opt.) | Only for SetShiftXxx() API, not supported for SetGrpXxx() because that uses synchronized slave group output started in Ini without master output. TRUE: single Shift channel must be started by function call StartShiftedChannel() FALSE: Shift channel will be started in Ini where all channels are started Default Pwm behavior is always FALSE, so ignore Parameter in this case.
          string PwmRbShiftMasterChannel [0..1]: multiplicity set at pre-compile, origin=RB:3.0.0:2014-07-21, post-build-variant-multiplicity=true, post-build-variant-value=true, set at pre-compile, max-length=60, min-length=1  # Master Channel (mandatory) | ShortName of the master channel (PwmChannel__KEY)
          integer PwmRbShiftOffset [0..1]: 0..4294967295, multiplicity set at pre-compile, origin=RB:3.0.0:2014-07-21, post-build-variant-multiplicity=true, post-build-variant-value=true, set at pre-compile  # Offset [us] | Start delay after Master channel period edge in [us], mandatory for PWM_LEFT_ALIGNED signals ( SetGrp_Xxx() or SetShiftXxx() API ), but not supported for Signal Alignment PWM_CENTER_ALIGNED. ATTENTION: slave duty cycle is limited when using offset > 0, because offset value plus pulse time (duty) of the slave signal must be within the master period value. Otherwise the pulse end edge will be limited to the period boundary (HW implementation limit)
          enumeration PwmRbShiftSigGroupAlignment [0..1]: {PWM_LEFT_ALIGNED, PWM_CENTER_ALIGNED}, multiplicity set at pre-compile, origin=RB:v1.22.0:2015-07-24, post-build-variant-multiplicity=true, post-build-variant-value=true, set at pre-compile  # Signal Alignment for SetGroupXxx() API (opt.) | Only for SetGrpXxx() API, not supported for SetShiftXxx() because that kind of signals follow always after a left aligned master. Defines the signal alignment of grouped Slave channels. PWM_LEFT_ALIGNED means the Slave channel start edge (pulse) is at the beginning of the period cycle. By parameter "Offset" you can additionally shift the start edge away from the cycle begin. PWM_CENTER_ALIGNED means the Slave channel start pulse is aligned to the middle of the period cycle. Parameter "Offset" has no effect. Default Pwm behavior is always PWM_LEFT_ALIGNED, so ignore Parameter in this case.
    container PwmGeneral  # General settings | Configuration of general aspects of the Pwm module.
      boolean PwmDevErrorDetect: set at pre-compile  # Enable development error detection | Enables/disables the detection and notification of development errors. If this parameter is enabled, then extended error checking is performed during runtime; any errors detected by these checks are reported to the DET module by Det_ReportError(). This feature should be switched off in series software.
      boolean PwmDutycycleUpdatedEndperiod: set at pre-compile  # Dutycycle update only at period boundary | Enables/disables the update of the duty cycle parameter at the end of the current period for all Pwm signals. default = TRUE, do not change.
      boolean PwmNotificationSupported: set at pre-compile  # Enable notifications | Enables/disables the support of the notification mechanism
      boolean PwmPeriodUpdatedEndperiod: set at pre-compile  # Period update only at period boundary | Enables/disables the update of the period parameter at the end of the current period for all Pwm signals. default = TRUE, do not change. If you need to change a period immediately then use RB function calls SetxxxImmediate() (abort current output and re-start)
      boolean PwmUniqueChannelMemMap [0..1]: set at pre-compile, default-value=false  # Unique MemMap sections for runtime structures | Enables/disables the generation of unique MemMap sections for the channel specific runtime structures
    container PwmOptionalApi  # Optional API services | Configuration of API aspects of the Pwm module.
      boolean PwmDeInitApi [0..1]: set at pre-compile, default-value=false  # Enable de-initialisation API | Enables/disables Pwm_DeInit() function. A de-initialisation of the Pwm driver is NOT supported.
      boolean PwmGetOutputStateApi: set at pre-compile  # Enable get output state API | Enables/disables Pwm_GetOutputState() function
      boolean PwmRbMedc17LegacyApi [0..1]: multiplicity set at pre-compile, origin=RB:0.4.0:2012-07-06, set at pre-compile, default-value=false  # Enable MEDC17 legacy API | Enables/disables DGS legacy API of MEDC17 Pwmout and Pwmin by include of adapter header files
      boolean PwmSetDutyCycleApi: set at pre-compile  # Enable set duty cycle API | Enables/disables Pwm_SetDutyCycle() function
      boolean PwmSetOutputToIdleApi: set at pre-compile  # Enable set output to idle API | Enables/disables Pwm_SetOutputToIdle() function
      boolean PwmSetPeriodAndDutyApi: set at pre-compile  # Enable set period and duty API | Enables/disablesPwm_SetPeriodAndDuty() function
