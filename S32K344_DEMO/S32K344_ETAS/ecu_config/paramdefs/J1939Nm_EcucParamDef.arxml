AUTOSAR XML (schema 4-2-2)
package /AUTOSAR_J1939Nm/EcucModuleDefs
  module definition J1939Nm [0..1]: category=VENDOR_SPECIFIC_MODULE_DEFINITION, post-build-variant-support=true, refined-module-def=J1939Nm, variants pre-compile/post-build  # Configuration of the J1939 Network Management module.
    container J1939NmConfigSet  # This container contains the configuration parameters and sub containers of the AUTOSAR J1939Nm module.
      container J1939NmChannel [1..*]: multiplicity set at link in variant link-time / post-build in variant post-build / pre-compile in variant pre-compile, post-build-variant-multiplicity=true  # Physical CAN channel handled by J1939Nm.
        boolean J1939NmChannelUsesAddressArbitration: post-build-variant-value=true, set at link in variant link-time / post-build in variant post-build / pre-compile in variant pre-compile, default-value=true  # Defines whether the nodes attached to this channel use an initial address claim, and whether they react to contending address claims of other nodes. | True: The initial address claim is sent, and the node reacts to address claims of other nodes. False: The node only sends an address claim upon request, and does not react to other address claims.
        integer J1939NmNumOfNodes [0..253]: 0..253, multiplicity set at pre-compile, origin=RB:8.0.0:2019-10-16, set at link in variant link-time / post-build in variant post-build / pre-compile in variant pre-compile, default-value=1  # Number of nodes connected to the network to this J1939Nm channel. This value would help in deciding the number of address claim messages in "AC re-claim" state during arbitrary address claim.
        symbolic name reference J1939NmComMNetworkHandleRef: set at link in variant link-time+post-build / pre-compile in variant pre-compile, destination=ComMChannel  # Reference to the channel defined by the ComMChannel providing access to the unique channel index ComMChannelId.
        container J1939NmNodeSpecificDemEventParameterRefs [0..*]: multiplicity set at link in variant link-time / post-build in variant post-build / pre-compile in variant pre-compile, post-build-variant-multiplicity=true  # Container for the references to DemEventParameter elements related to one J1939NmNode which shall be invoked using the API Dem_SetEventStatus in case the corresponding error occurs. The EventId is taken from the referenced DemEventParameter's DemEventId symbolic value. The standardized errors are provided in this container and can be extended by vendor-specific error references.
          enumeration J1939NmRbDynCreate_J1939NM_E_ADDRESS_LOST [0..1]: {Disabled, Standard}, multiplicity set at pre-compile, origin=RB:1.0.0:2017-05-23, set at pre-compile, default-value=Disabled  # Dynamically create J1939NM_E_ADDRESS_LOST event | Selects the way how the J1939Nm DemEvents are created in Dem and referenced in J1939Nm module. If not set or set to "Disabled", no such DemEvent is automatically/dynamically created in Dem. If the dynamic creation of this DemEvent is standard, then this DemEvent (in parameter J1939NM_E_ADDRESS_LOST) is dynamically created in Dem and referenced in J1939Nm module and hence shall not be set manually.
          symbolic name reference J1939NM_E_ADDRESS_LOST: set at pre-compile, destination=DemEventParameter  # Reference to the DemEventParameter which shall be issued when the ECU failed to claim one of its addresses.
          reference J1939NmNodeRef: post-build-variant-value=true, set at link in variant link-time / post-build in variant post-build / pre-compile in variant pre-compile, destination=J1939NmNode  # Reference to J1939NmNode.
        container J1939NmRxPdu  # Contains the configuration of the PDU used to receive the AddressClaimed PG. This PDU consumes a meta data item of type CAN_ID_32.
          integer J1939NmRxPduId: 0..65535, scope=ECU, set at pre-compile, symbolic-name-value=true  # The PDU identifier used for RxIndication from CanIf.
          reference J1939NmRxPduRef: set at link in variant link-time+post-build / pre-compile in variant pre-compile, destination=Pdu  # Reference to the Pdu object representing the PDU.
        container J1939NmTxPdu  # Contains the configuration of the PDU used to transmit the AddressClaimed PG. This PDU produces a meta data item of type CAN_ID_32.
          integer J1939NmTxPduId: 0..65535, scope=ECU, set at pre-compile, symbolic-name-value=true  # The PDU identifier used for TxConfirmation from CanIf.
          reference J1939NmTxPduRef: set at link in variant link-time+post-build / pre-compile in variant pre-compile, destination=Pdu  # Reference to the Pdu object representing the PDU.
      container J1939NmExternalNode [0..0]: multiplicity set at pre-compile  # Logical node implemented in another ECU. Configures potential communication partners. If this container is connected to more than one channel, the external ECU is linked to the local ECU by each of these channels.
        integer J1939NmExternalNodeId [0..0]: 0..65535, scope=ECU, set at pre-compile, symbolic-name-value=true  # Unique identifier of this external node.
        boolean J1939NmExternalNodeNameArbitraryAddressCapable [0..0]: post-build-variant-value=true, set at link in variant link-time / post-build in variant post-build / pre-compile in variant pre-compile  # Arbitrary Address Capable field of the NAME of this external node.
        integer J1939NmExternalNodeNameECUInstance [0..0]: 0..7, post-build-variant-value=true, set at link in variant link-time / post-build in variant post-build / pre-compile in variant pre-compile  # ECU Instance field of the NAME of this external node.
        integer J1939NmExternalNodeNameFunction [0..0]: 0..255, post-build-variant-value=true, set at link in variant link-time / post-build in variant post-build / pre-compile in variant pre-compile  # Function field of the NAME of this external node.
        integer J1939NmExternalNodeNameFunctionInstance [0..0]: 0..31, post-build-variant-value=true, set at link in variant link-time / post-build in variant post-build / pre-compile in variant pre-compile  # Function Instance field of the NAME of this external node.
        integer J1939NmExternalNodeNameIdentityNumber [0..0]: 0..2097151, post-build-variant-value=true, set at link in variant link-time / post-build in variant post-build / pre-compile in variant pre-compile  # Identity Number field of the NAME of this external node.
        integer J1939NmExternalNodeNameIndustryGroup [0..0]: 0..7, post-build-variant-value=true, set at link in variant link-time / post-build in variant post-build / pre-compile in variant pre-compile  # Industry Group field of the NAME of this external node.
        integer J1939NmExternalNodeNameManufacturerCode [0..0]: 0..2047, post-build-variant-value=true, set at link in variant link-time / post-build in variant post-build / pre-compile in variant pre-compile  # Manufacturer Code field of the NAME of this external node.
        integer J1939NmExternalNodeNameVehicleSystem [0..0]: 0..127, post-build-variant-value=true, set at link in variant link-time / post-build in variant post-build / pre-compile in variant pre-compile  # Vehicle System field of the NAME of this external node.
        integer J1939NmExternalNodeNameVehicleSystemInstance [0..0]: 0..15, post-build-variant-value=true, set at link in variant link-time / post-build in variant post-build / pre-compile in variant pre-compile  # Vehicle System Instance field of the NAME of this external node.
        integer J1939NmExternalNodePreferredAddress [0..0]: 0..253, scope=ECU, post-build-variant-value=true, set at link in variant link-time / post-build in variant post-build / pre-compile in variant pre-compile  # Source address of this external node.
        reference J1939NmExternalNodeChannelRef [0..0]: multiplicity set at link in variant link-time / post-build in variant post-build / pre-compile in variant pre-compile, post-build-variant-multiplicity=true, post-build-variant-value=true, set at link in variant link-time / post-build in variant post-build / pre-compile in variant pre-compile, destination=J1939NmChannel  # Reference to the channels of the local ECU this external node has access to.
        reference J1939NmExternalNodeGatewayedChannelRef [0..0]: multiplicity set at link in variant link-time / post-build in variant post-build / pre-compile in variant pre-compile, post-build-variant-multiplicity=true, post-build-variant-value=true, set at link in variant link-time / post-build in variant post-build / pre-compile in variant pre-compile, destination=J1939NmChannel  # Reference to the channels on which messages to/from this external node shall be gatewayed. The address claim from the external node will be replicated on these channels.
      container J1939NmNode [1..*]: multiplicity set at link in variant link-time / post-build in variant post-build / pre-compile in variant pre-compile, post-build-variant-multiplicity=true  # Logical node representing one function handled by J1939Nm.
        integer J1939NmNodeId: 0..255, scope=ECU, set at pre-compile, symbolic-name-value=true  # Unique identifier of this node.
        boolean J1939NmNodeNameArbitraryAddressCapable: set at pre-compile  # Arbitrary Address Capable field of the NAME of this node.
        integer J1939NmNodeNameECUInstance: 0..7, post-build-variant-value=true, set at link in variant link-time / post-build in variant post-build / pre-compile in variant pre-compile  # ECU Instance field of the NAME of this node.
        integer J1939NmNodeNameFunction: 0..255, post-build-variant-value=true, set at link in variant link-time / post-build in variant post-build / pre-compile in variant pre-compile  # Function field of the NAME of this node.
        integer J1939NmNodeNameFunctionInstance: 0..31, post-build-variant-value=true, set at link in variant link-time / post-build in variant post-build / pre-compile in variant pre-compile  # Function Instance field of the NAME of this node.
        integer J1939NmNodeNameIdentityNumber: 0..2097151, post-build-variant-value=true, set at link in variant link-time / post-build in variant post-build / pre-compile in variant pre-compile  # Identity Number field of the NAME of this node.
        integer J1939NmNodeNameIndustryGroup: 0..7, post-build-variant-value=true, set at link in variant link-time / post-build in variant post-build / pre-compile in variant pre-compile  # Industry Group field of the NAME of this node.
        integer J1939NmNodeNameManufacturerCode: 0..2047, post-build-variant-value=true, set at link in variant link-time / post-build in variant post-build / pre-compile in variant pre-compile  # Manufacturer Code field of the NAME of this node.
        integer J1939NmNodeNameVehicleSystem: 0..127, post-build-variant-value=true, set at link in variant link-time / post-build in variant post-build / pre-compile in variant pre-compile  # Vehicle System field of the NAME of this node.
        integer J1939NmNodeNameVehicleSystemInstance: 0..15, post-build-variant-value=true, set at link in variant link-time / post-build in variant post-build / pre-compile in variant pre-compile  # Vehicle System Instance field of the NAME of this node.
        integer J1939NmNodePreferredAddress: 0..253, scope=ECU, post-build-variant-value=true, set at link in variant link-time / post-build in variant post-build / pre-compile in variant pre-compile  # Source address of this node used for address claiming.
        boolean J1939NmNodeStartUpDelay: set at pre-compile, default-value=true  # If enabled, the node will start communication after a delay of 250ms after transmission of the initial AddressClaimed, depending on the configured J1939NmNodePreferredAddress. If disabled, the node will start communication immediately at network start-up. | Please note: According to J1939/81, the 250ms delay is not required for single address CAs with desired source addresses in the ranges 0..127 or 248..253.
        reference J1939NmNodeChannelRef [1..*]: multiplicity set at link in variant link-time+post-build / pre-compile in variant pre-compile, set at link in variant link-time+post-build / pre-compile in variant pre-compile, destination=J1939NmChannel  # Reference to the channels this node has access to.
      container J1939NmSharedAddressSpace [0..0]: multiplicity set at link in variant link-time / post-build in variant post-build / pre-compile in variant pre-compile, post-build-variant-multiplicity=true  # Set of J1939NmChannels that share a common address space. Address claims will be routed between these channels.
        reference J1939NmSharedChannelRef [0..0]: multiplicity set at link in variant link-time / post-build in variant post-build / pre-compile in variant pre-compile, post-build-variant-multiplicity=true, post-build-variant-value=true, set at link in variant link-time / post-build in variant post-build / pre-compile in variant pre-compile, destination=J1939NmChannel  # Reference to a channel that belongs to the shared address space.
    container J1939NmGeneral  # Contains the general configuration parameters of the module.
      boolean J1939NmBswmSupport: origin=RB:1.0.0:2016-03-31, set at link in variant link-time+post-build / pre-compile in variant pre-compile, default-value=true  # Switches the notifications to BSWM ON or OFF. | * true: enabled (ON). * false: disabled (OFF).
      float J1939NmBusOffDelayTickPeriod [0..1]: 0..INF, multiplicity set at link in variant link-time+post-build / pre-compile in variant pre-compile, set at link in variant link-time+post-build / pre-compile in variant pre-compile, default-value=0.02  # Duration of ticks that are used to time BusOff delays after conflicting address claims. This parameter must be synchronized with the main function period of the CAN State Manager.
      boolean J1939NmCalibrationSupportEnabled [0..1]: multiplicity set at pre-compile, origin=RB:1.0.0:2016-09-10, set at pre-compile, default-value=false  # Pre-processor switch for enabling the Calibration Support for J1939Nm. True : Calibration support is enabled False: Calibration support is disabled
      boolean J1939NmCanIfStateCheck [0..1]: multiplicity set at pre-compile, origin=RB:9.0.0:2020-06-15, set at pre-compile, default-value=false  # Pre-processor switch for enabling the CanIf startup behavior check. True : CanIfstartup check Support is enabled therefore CanIf PduMode and ControllerMode are checked before calling CanIf_Transmit False: CanIfstartup check Support is disabled and CanIf PduMode and ControllerMode are not checked before calling CanIf_Transmit
      boolean J1939NmDSMReInitEnabled [0..1]: multiplicity set at pre-compile, origin=RB:1.0.0:2017-02-27, set at pre-compile, default-value=false  # Enables or disables the reporting of DEM events to DSM after the Re-initialisation of DSM has occured.
      boolean J1939NmDevErrorDetect: set at pre-compile, default-value=false  # Switches the development error detection and notification on or off. | * true: detection and notification is enabled. * false: detection and notification is disabled.
      boolean J1939NmGatewaySupport [0..0]: set at pre-compile  # Enables/disables support for claiming the addresses of routed messages.
      float J1939NmMainFunctionPeriod: 0..INF, scope=ECU, set at link in variant link-time+post-build / pre-compile in variant pre-compile, default-value=0.01  # Call cycle in seconds of J1939Nm_MainFunction.
      integer J1939NmMaximumNumberOfRetryEntries [0..1]: 0..10, multiplicity set at pre-compile, origin=RB:1.0.0:2016-03-31, set at link in variant link-time+post-build / pre-compile in variant pre-compile, symbolic-name-value=true  # This parameter is the maximum number of times J1939Nm retries sending out a Tx Pdu to canIf
      float J1939NmTxConfirmationTimeout: 0..65.535, origin=RB:1.0.0:2020-05-20, set at link in variant link-time+post-build / pre-compile in variant pre-compile, default-value=1.5  # Time in seconds to wait for a confirmation after transmission of a message. The behaviour when the time elapses depends on the transmitted message.
      function name J1939NmUserCallout [0..1]: multiplicity set at pre-compile, set at pre-compile  # Pre-processor switch for enabling the <User_AddressClaimedIndication> and defining the name of the callout function.
      string J1939NmUserCalloutHeaderFile [0..1]: multiplicity set at pre-compile, origin=RB:1.0.0:2020-05-20, set at pre-compile  # Header file which is included by J1939Nm when J1939NmUserCallout is enabled. This header file must provide the prototype of the &lt;User_AddressClaimedIndication&gt; defined in J1939NmUserCallout.
      boolean J1939NmVersionInfoApi: set at pre-compile, default-value=false  # Pre-processor switch for enabling version info API support.
