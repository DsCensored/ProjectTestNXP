AUTOSAR XML (schema 00048)
package /AUTOSAR_J1939Dcm/EcucModuleDefs
  module definition J1939Dcm [0..1]: category=VENDOR_SPECIFIC_MODULE_DEFINITION, refined-module-def=J1939Dcm, variants link-time/post-build/pre-compile  # J1939 Diagnostic Communication Manager | Configuration of J1939Dcm (J1939 Diagnostic Communications Manager) module.
    container J1939DcmConfigSet  # This container contains the configuration parameters and sub containers of the AUTOSAR J1939Dcm module.
      container J1939DcmChannel [1..*]  # Contains the J1939DcmChannel parameters.
        enumeration J1939DcmBusType: {J1939DCM_ISO9141, J1939DCM_J1587, J1939DCM_J1850, J1939DCM_J1922, J1939DCM_J1939_NETWORK_1, J1939DCM_J1939_NETWORK_2, J1939DCM_J1939_NETWORK_3, J1939DCM_J1939_NETWORK_4, J1939DCM_OTHER, J1939DCM_PROPRIETARY_NETWORK_1, J1939DCM_PROPRIETARY_NETWORK_2}, set at pre-compile  # Identifies the communication port
        reference J1939DcmComMChannelRef: scope=ECU, set at link in variant link-time / post-build in variant post-build / pre-compile in variant pre-compile, destination=ComMChannel  # Reference to the ComMChannel.
      choice container J1939DcmDspExternalSRDataElementClass [0..0]  # This container defines the source of data in a provided port which shall be read respectively the target of data in a required port which shall be written. | This container shall contain either one J1939DcmSubElementInDataElementInstance OR J1939DcmDataElementInstance OR J1939DcmSubElementInImplDataElementInstance reference.
        container J1939DcmDataElementInstance [0..1]  # Instance Reference to the primitive data in a port where the data element is typed with an ApplicationPrimitveDataType or an ImplementationDataType.
          instance reference J1939DcmDataElementInstanceRef: set at pre-compile, destination-context=ROOT-SW-COMPOSITION-PROTOTYPE SW-COMPONENT-PROTOTYPE PORT-PROTOTYPE, destination-type=AUTOSAR-DATA-PROTOTYPE  # Instance Reference to the primitive data which shall be read or written. | Supported are VariableDataPrototypes in SenderReceiverInterfaces and NvDataInterfaces and ParameterDataPrototypes in ParameterInterfaces (read only). This reference is applicable if the AutosarDataPrototype is typed with a ApplicationPrimitiveDataType of category VALUE or BOOLEAN or if the AutosarDataPrototype is typed with a ImplementationDataType of category VALUE or TYPE_REFERENCE that in turn boils down to VALUE
        container J1939DcmSubElementInDataElementInstance [0..1]  # Instance Reference to the primitve sub-element (at any level) of composite data in a port where the data element is typed with an ApplicationCompositeDataType.
          instance reference J1939DcmSubElementInDataElementInstanceRef: set at pre-compile, destination-context=ROOT-SW-COMPOSITION-PROTOTYPE SW-COMPONENT-PROTOTYPE PORT-PROTOTYPE AUTOSAR-DATA-PROTOTYPE APPLICATION-COMPOSITE-ELEMENT-DATA-PROTOTYPE*, destination-type=APPLICATION-COMPOSITE-ELEMENT-DATA-PROTOTYPE  # Instance Reference to the primitve sub-element (at any level) of composite data in a port which shall be read. | Supported are VariableDataPrototypes in SenderReceiverInterfaces and NvDataInterfaces and ParameterDataPrototypes in ParameterInterfaces (read only). This reference is applicable if the AutosarDataPrototype is typed with a ApplicationCompositeDataType.
        container J1939DcmSubElementInImplDataElementInstance [0..1]  # Instance Reference to the primitve sub-element (at any level) of composite data in a port where the data element is typed with an ImplementationDataType.
          instance reference J1939DcmSubElementInImplDataElementInstanceRef: set at pre-compile, destination-context=ROOT-SW-COMPOSITION-PROTOTYPE SW-COMPONENT-PROTOTYPE PORT-PROTOTYPE AUTOSAR-DATA-PROTOTYPE IMPLEMENTATION-DATA-TYPE-ELEMENT*, destination-type=IMPLEMENTATION-DATA-TYPE-ELEMENT  # Instance Reference to the primitve sub-element (at any level) of composite data in a port which shall be read. | Supported are VariableDataPrototypes in SenderReceiverInterfaces and NvDataInterfaces and ParameterDataPrototypes in ParameterInterfaces (read only). This reference is applicable if the AutosarDataPrototype is typed with a ImplementationDataType of category STRUCTURE or ARRAY. Please note that in case of ARRAY the index attribute in the target reference has to be set to select a single array element.
      container J1939DcmNode [1..*]  # Contains the parameters for the support of a logical J1939 node.
        function name J1939DcmGenericDMxCopyRxDataFunction [0..0]: multiplicity set at pre-compile, set at pre-compile  # Provides part of the data of an unsupported DMx message. Required if J1939DcmGenericDMxSupport is enabled.
        function name J1939DcmGenericDMxCopyTxDataFunction [0..0]: multiplicity set at pre-compile, set at pre-compile  # Requests to provide part of the data of an unsupported DMx message, following a call to J1939Dcm_GenericDMxTransmit. Required if J1939DcmGenericDMxSupport is enabled.
        function name J1939DcmGenericDMxRequestFunction [0..0]: multiplicity set at pre-compile, set at pre-compile  # Indicates the reception of a request for an unsupported DMx message. Required if J1939DcmGenericDMxSupport is enabled.
        function name J1939DcmGenericDMxRxIndicationFunction [0..0]: multiplicity set at pre-compile, set at pre-compile  # Confirms complete reception of an unsupported DMx message. Required if J1939DcmGenericDMxSupport is enabled.
        function name J1939DcmGenericDMxStartOfReceptionFunction [0..0]: multiplicity set at pre-compile, set at pre-compile  # Indicates reception of an unsupported DMx message. Required if J1939DcmGenericDMxSupport is enabled.
        function name J1939DcmGenericDMxTxConfirmationFunction [0..0]: multiplicity set at pre-compile, set at pre-compile  # Confirms transmission of an unsupported DMx message. Required if J1939DcmGenericDMxSupport is enabled.
        integer J1939DcmSPNsInDataStream [0..*]: 0..524287, multiplicity set at pre-compile, set at pre-compile  # Defines the SPNs available in data stream for use in DM24.
        reference J1939DcmDemClientRef: set at link in variant link-time+post-build / pre-compile in variant pre-compile, destination=DemClient  # Reference to the corresponding Dem Client.
        reference J1939DcmNmNodeRef: set at link in variant link-time+post-build / pre-compile in variant pre-compile, destination=J1939NmNode  # Reference to the corresponding J1939Nm node.
        reference J1939DcmNodeRmUserRef: post-build-variant-value=true, set at link in variant link-time / post-build in variant post-build / pre-compile in variant pre-compile, destination=J1939RmDcmUser  # Reference to the J1939RmUser used by J1939Dcm.
        reference J1939DcmServiceOnlyDTCsMemoryDestinationRef [0..0]: set at pre-compile, destination=DemUserDefinedMemory  # Reference to the user defined memory used for the Service Only DTCs handled by DM53, DM54, and DM55.
        container J1939DcmDiagnosticMessageSupport [1..*]  # Contains parameters to configure the diagnostic message support
          enumeration J1939DcmDmxSupport: {J1939DCM_DM01_SUPPORT, J1939DCM_DM02_SUPPORT, J1939DCM_DM03_SUPPORT, J1939DCM_DM04_SUPPORT, J1939DCM_DM05_SUPPORT, J1939DCM_DM06_SUPPORT, J1939DCM_DM07_SUPPORT, J1939DCM_DM08_SUPPORT, J1939DCM_DM09_SUPPORT, J1939DCM_DM10_SUPPORT, J1939DCM_DM11_SUPPORT, J1939DCM_DM12_SUPPORT, J1939DCM_DM13_SUPPORT, J1939DCM_DM14_SUPPORT, J1939DCM_DM15_SUPPORT, J1939DCM_DM16_SUPPORT, J1939DCM_DM17_SUPPORT, J1939DCM_DM18_SUPPORT, J1939DCM_DM19_SUPPORT, J1939DCM_DM20_SUPPORT, J1939DCM_DM21_SUPPORT, J1939DCM_DM22_SUPPORT, J1939DCM_DM23_SUPPORT, J1939DCM_DM24_SUPPORT, J1939DCM_DM25_SUPPORT, J1939DCM_DM26_SUPPORT, J1939DCM_DM27_SUPPORT, J1939DCM_DM28_SUPPORT, J1939DCM_DM29_SUPPORT, J1939DCM_DM30_SUPPORT, J1939DCM_DM31_SUPPORT, J1939DCM_DM32_SUPPORT, J1939DCM_DM33_SUPPORT, J1939DCM_DM34_SUPPORT, J1939DCM_DM35_SUPPORT, J1939DCM_DM36_SUPPORT, J1939DCM_DM37_SUPPORT, J1939DCM_DM38_SUPPORT, J1939DCM_DM39_SUPPORT, J1939DCM_DM40_SUPPORT, J1939DCM_DM41_SUPPORT, J1939DCM_DM42_SUPPORT, J1939DCM_DM43_SUPPORT, J1939DCM_DM44_SUPPORT, J1939DCM_DM45_SUPPORT, J1939DCM_DM46_SUPPORT, J1939DCM_DM47_SUPPORT, J1939DCM_DM48_SUPPORT, J1939DCM_DM49_SUPPORT, J1939DCM_DM50_SUPPORT, J1939DCM_DM51_SUPPORT, J1939DCM_DM52_SUPPORT, J1939DCM_DM53_SUPPORT, J1939DCM_DM54_SUPPORT, J1939DCM_DM55_SUPPORT, J1939DCM_DM56_SUPPORT, J1939DCM_DM57_SUPPORT}, set at pre-compile  # This parameter is used to identify the actual DMx message.
          reference J1939DcmDiagnosticMessageModeRuleRef [0..0]: scope=ECU, multiplicity set at link in variant link-time / pre-compile in variant post-build+pre-compile, set at link in variant link-time / pre-compile in variant post-build+pre-compile, destination=J1939DcmModeRule  # Reference to a J1939DcmModeRule which controls the execution of a DiagnosticMessage.
          reference J1939DcmDiagnosticMessageSupportChannelRef: set at link in variant link-time+post-build / pre-compile in variant pre-compile, destination=J1939DcmChannel  # Reference to J1939DcmChannel for which this diagnostic message is supported.
          container J1939DcmRxPdu [0..1]  # Contains parameters to configure the J1939DcmRxPdu. | This PDU consumes meta data items of type CAN_ID_32 for PDUs received from CanIf, and of type SOURCE_ADDRESS_16, TARGET_ADDRESS_16, and PRIORITY_8 for PDUs received from J1939Tp.
            integer J1939DcmRxPduId: 0..65535, scope=ECU, set at pre-compile, symbolic-name-value=true, with-auto=true  # The I-PDU identifier used for communication with PduR.
            reference J1939DcmRxPduRef: set at link in variant link-time / post-build in variant post-build / pre-compile in variant pre-compile, destination=Pdu  # Reference to the global Pdu element in the Ecuc module.
          container J1939DcmTxPdu [0..1]  # Contains parameters to configure the J1939DcmTxPdu. | This PDU produces meta data items of type CAN_ID_32 for PDUs transmitted via CanIf, and of type SOURCE_ADDRESS_16, TARGET_ADDRESS_16, and PRIORITY_8 for PDUs transmitted via J1939Tp.
            integer J1939DcmTxPduId: 0..65535, scope=ECU, set at pre-compile, symbolic-name-value=true, with-auto=true  # The I-PDU identifier used to identify the Tx message.
            reference J1939DcmTxPduRef: set at link in variant link-time / post-build in variant post-build / pre-compile in variant pre-compile, destination=Pdu  # Reference to the global Pdu element in the Ecuc module.
      container J1939DcmProcessingConditions [0..0]  # This container contains the configuration for mode arbitration functionality of the J1939Dcm
        container J1939DcmModeCondition [0..1]  # This container contains the configuration of a mode condition or an environmental conditions which can be used as argument in J1939DcmModeRules. | One J1939DcmModeCondition shall contain either one J1939DcmSwcModeRef or one J1939DcmBswModeRef or one J1939DcmSwcSRDataElementRef. Please note that the J1939Dcm acts as well as mode manager. Therefore the references J1939DcmSwcModeRef or one J1939DcmBswModeRef might point to provided ModeDeclarationGroupPrototypes of the J1939Dcm itself as well as to provided ModeDeclarationGroupPrototypes of other Bsw Modules or software components. In case of a configured J1939DcmSwcModeRef or J1939DcmBswModeRef only the J1939DcmConditionType J1939DCM_EQUALS or J1939DCM_EQUALS_NOT are applicable. In case of J1939DcmSwcSRDataElementRef all literals of J1939DcmConditionType are possible.
          enumeration J1939DcmConditionType: {J1939DCM_EQUALS, J1939DCM_EQUALS_NOT, J1939DCM_GREATER_OR_EQUAL, J1939DCM_GREATER_THAN, J1939DCM_LESS_OR_EQUAL, J1939DCM_LESS_THAN}, set at pre-compile  # This parameter specifies what kind of comparison that is made for the evaluation of the mode condition.
          instance reference J1939DcmBswModeRef [0..1]: multiplicity set at pre-compile, set at pre-compile, destination-context=MODE-DECLARATION-GROUP-PROTOTYPE, destination-type=MODE-DECLARATION  # This parameter references a mode of a ModeDeclarationGroupPrototype provided by a Basic Software Module used for the condition. | Please note that such ModeDeclarationGroupPrototype are owned by a Basic Software Module Description in the role providedModeGroup.
          instance reference J1939DcmSwcModeRef [0..1]: multiplicity set at pre-compile, set at pre-compile, destination-context=ROOT-SW-COMPOSITION-PROTOTYPE SW-COMPONENT-PROTOTYPE P-PORT-PROTOTYPE MODE-DECLARATION-GROUP-PROTOTYPE, destination-type=MODE-DECLARATION  # This parameter references a mode in a particular mode request port of a software component that is used for the condition.
          reference J1939DcmSwcSRDataElementRef [0..1]: multiplicity set at pre-compile, set at pre-compile, destination=J1939DcmDspExternalSRDataElementClass  # Reference to environmental conditions. | It is possible to reference a S/R Receiver-Port to read physical values and compare (equal, greater, less,...) them with a configured value that is defined by J1939DcmSwcSRDataElementValue.
          choice container J1939DcmSwcSRDataElementValue  # This container contains the configuration of a S/R compare value.
            container J1939DcmSwcSRDataElementArray [0..1]  # This container contains the configuration of a array SR data element compare value.
              container J1939DcmSwcSRDataElementArrayElement [0..*]  # This container contains the configuration of a array element SR data element compare value.
                integer J1939DcmSwcSRDataElementArrayElementIndex: 0..18446744073709551615, set at pre-compile  # Index to an array SR data element.
                integer J1939DcmSwcSRDataElementArrayElementValue: 0..18446744073709551615, set at pre-compile  # Value of an array SR data element compare value.
            container J1939DcmSwcSRDataElementPrimitive [0..1]  # This container contains the configuration of a primitive SR data element compare value.
              integer J1939DcmSwcSRDataElementPrimitiveValue: 0..18446744073709551615, set at pre-compile  # Reference to a primitive SR data element compare value.
        container J1939DcmModeRule [1..*]  # This container contains the configuration of a mode rule which represents a logical expression with J1939DcmModeConditions or other J1939DcmModeRules as arguments. | All arguments are processed with the operator defined by DcmLogicalOperator, for instance: Argument_A AND Argument_B AND Argument_C
          enumeration J1939DcmLogicalOperator [0..1]: {J1939DCM_AND, J1939DCM_OR}, multiplicity set at pre-compile, set at pre-compile  # This parameter specifies the logical operator to be used in the logical expression. If the expression only consists of a single condition this parameter shall not be used.
          integer J1939DcmModeRuleNrcValue [0..1]: 1..255, scope=ECU, multiplicity set at link in variant link-time / pre-compile in variant pre-compile, set at link in variant link-time / pre-compile in variant pre-compile  # Optional parameter which defines the NRC to be sent in case the mode rule condition is not valid.
          choice reference J1939DcmArgumentRef [1..*]: multiplicity set at pre-compile, requires-index=true, set at pre-compile, destination=[J1939DcmModeCondition, J1939DcmModeRule]  # This is a choice reference either to a mode condition or a an other mode rule serving as sub-expression.
    container J1939DcmGeneral  # Contains the general configuration parameters of the module.
      integer J1939DcmCommonBufferSize: 1..65535, set at pre-compile  # Size of common buffer (in Bytes). The buffer size should be as large as the longest command or response message.
      integer J1939DcmDM01BufferSize [0..1]: 1..65535, multiplicity set at pre-compile, set at pre-compile  # Size of DM01 buffer (in Bytes). The buffer size should be as large as the longest DM01 response message.
      integer J1939DcmDM01MaxDTCs [0..1]: 1..255, set at pre-compile, default-value=20  # Configuration value of limitation of maximum DTCs to be reported in the DM01 message.This parameter is applicable only for DEM triggered and Cyclically triggered DM01 message.For Tester triggered DM01 messages this limitation is not applicable.
      integer J1939DcmDM35BufferSize [0..0]: 1..65535, multiplicity set at pre-compile, set at pre-compile  # Size of DM35 buffer (in Bytes). The buffer size should be as large as the longest DM35 response message.
      boolean J1939DcmDevErrorDetect: set at pre-compile, default-value=false  # Switches the development error detection and notification on or off. | * true: detection and notification is enabled. * false: detection and notification is disabled.
      boolean J1939DcmGenericDMxSupport [0..0]: set at pre-compile, default-value=false  # Switches the support for all DMx messages that are not directly implemented in J1939Dcm. True: Unsupported DMx messages are handled by a CDD. False: Unsupported DMx messages are ignored/rejected.
      float J1939DcmMainFunctionPeriod: 0..INF, scope=ECU, set at link in variant link-time+post-build / pre-compile in variant pre-compile  # Call cycle in seconds of J1939Dcm_MainFunction.
      integer J1939DcmMaxDTCsPerMainFunction [0..1]: 1..255, multiplicity set at pre-compile, set at pre-compile  # Maximum threshold of DTCs filtered in a single MainFunction cycle.
      integer J1939DcmMaxFreezeFramesPerMainFunction [0..1]: 1..255, multiplicity set at pre-compile, set at pre-compile  # Maximum threshold of FreezeFrames filtered in a single MainFunction cycle.
      integer J1939DcmMaxRatiosPerMainFunction [0..1]: 1..255, multiplicity set at pre-compile, set at pre-compile  # Maximum threshold of Ratios filtered in a single MainFunction cycle.
      boolean J1939DcmRbAllowApplToStopDM1PeriodicMsg [0..1]: origin=RB:AR42.5.0.0:2019-01-25, set at pre-compile, default-value=false  # If enabled, this feature provides the Application an API to allow/stop DM01 Periodic messages for the current cycle. Application API 'J1939DcmAppl_AllowDM1PeriodicMsg' would be invoked from J1939Dcm_DM1Scheduler and J1939Dcm_DemTriggerOnDTCStatus. The Application can return E_OK to allow the transmission of DM01 Periodic messages, or return E_NOT_OK if DM01 periodic transmission is to be stopped for the current cycle. | * True : Enabled (ON); * False : Disabled (OFF)
      boolean J1939DcmRbGetPermToAcceptReq [0..1]: origin=RB:AR42.6.0.0:2019-07-26, set at pre-compile, default-value=false  # If enabled, this feature provides the Application an API to accept/reject DM Request messages received. Application API 'J1939DcmAppl_GetPermToAcceptReq' would be invoked from J1939Dcm_StartOfReception, J1939Dcm_RequestIndication and J1939Dcm_RxIndication APIs. The Application can return E_OK to accept the request message, or return E_NOT_OK if the request is to be rejected. If this feature is enabled, an Application callback 'J1939DcmAppl_RequestCompleted' will be given after the TxConfirmation to inform the Application that the request was serviced completely
      integer J1939DcmRbMemMaxNumberOfRetryForTransmit [0..1]: 0..255, multiplicity set at pre-compile, origin=RB:AR42.3.0.0:2018-01-25, set at pre-compile  # Maximum number of times the Device should retry to Transmit the Response for Memory Access Services when Status Request is being Transmitted and vice-versa.( configure this value as multiple of J1939Dcm Main Function Period)
      float J1939DcmRbMemTimeOutForData [0..1]: 0..1, origin=RB:AR42.3.0.0:2018-01-25, set at link in variant link-time+post-build / pre-compile in variant pre-compile  # Time-out period while waiting for data for requested operation(write).( configure this value as multiple of J1939Dcm Main Function Period)
      float J1939DcmRbMemTimeOutForOperationComplete [0..1]: 0..1, origin=RB:AR42.3.0.0:2018-01-25, set at link in variant link-time+post-build / pre-compile in variant pre-compile  # Time-out period while waiting to receive Operation Complete Message from Tool.( configure this value as multiple of J1939Dcm Main Function Period)
      float J1939DcmRbMemTimeOutForOperationExecution [0..1]: 0..1, origin=RB:AR42.3.0.0:2018-01-25, set at link in variant link-time+post-build / pre-compile in variant pre-compile  # Time-out period while waiting for requested operation(read, write, erase) to be completed from application side.( configure this value as multiple of J1939Dcm Main Function Period)
      float J1939DcmRbMemTimeOutForReceivingKey [0..1]: 0..1, origin=RB:AR42.3.0.0:2018-01-25, set at link in variant link-time+post-build / pre-compile in variant pre-compile  # Time-out period while waiting to receive Key from Tool.( configure this value as multiple of J1939Dcm Main Function Period)
      boolean J1939DcmVersionInfoApi: set at pre-compile, default-value=false  # Pre-processor switch for enabling version info API support.
