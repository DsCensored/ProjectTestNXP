AUTOSAR XML (schema 00050)
package /ETAS_Project/EcucModuleConfigurationValuess
  ecuc value collection EcucValueCollection_0: category=ECU_EXTACT, ecuc-values=[Rte, Os, rba_BswSrv, Com, ComM, EcuC, Dcm, CanIf, Can, CanTp, CanNm, PduR, CanSM, Mcu, Nm]
