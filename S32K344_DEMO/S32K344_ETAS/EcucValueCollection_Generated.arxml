AUTOSAR XML (schema 00050)
package /ETAS_Project/EcucModuleConfigurationValuess
  ecuc value collection EcucValueCollection_0: category=S32K344_ECUC_EXTRACT, ecuc-values=[Com, Rte, Os, rba_BswSrv, ComM, EcuC, Dcm, CanIf, Can, CanTp, CanNm, PduR, CanSM, Mcu, Nm, NvM_0, Fee_0, MemIf_0]
