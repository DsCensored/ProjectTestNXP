AUTOSAR XML (schema 00050)
package /ETAS_Project/EcucModuleConfigurationValuess
  module config Nm: implementation-config-variant=VARIANT-PRE-COMPILE
    NmGlobalConfig
      NmGlobalFeatures:
        NmCoordinatorSyncSupport = false
        NmUserDataEnabled = false
        NmCarWakeUpRxEnabled = false
        NmCoordinatorSupportEnabled = true
        NmRemoteSleepIndEnabled = false
        NmStateChangeIndEnabled = false
        NmBusSynchronizationEnabled = false
        NmComControlEnabled = false
        NmPduRxIndicationEnabled = false
      NmGlobalConstants: NmNumberOfChannels=1, NmRemoteSleepCancelCallback=TestNm_RemoteSleepCancellation, NmRemoteSleepIndCallback=TestNm_RemoteSleepIndication
      NmGlobalProperties: NmCycletimeMainFunction=0.01, NmVersionInfoApi=true
    NmChannelConfig_CanNmCluster_0_1 (NmChannelConfig):
      NmChannelSleepMaster = false
      NmComUserDataSupport = true
      NmStateReportEnabled = false
      NmShutdownDelayTimer = 0.0
      NmSynchronizingNetwork = false
      NmPassiveModeEnabled = false
      NmComMChannelRef = Can_Network_test0_Channel_Can_Network_test0
      NmBusType
        NmStandardBusNmConfig: NmStandardBusType=NM_BUSNM_CANNM
  module config ComM: implementation-config-variant=VARIANT-PRE-COMPILE
    ComMConfigSet
      Can_Network_test0_Channel_Can_Network_test0 (ComMChannel):
        ComMNoCom = true
        ComMFullCommRequestNotificationEnabled = false
        ComMMainFunctionPeriod = 0.01
        ComMBusType = COMM_BUS_TYPE_CAN
        ComMNoWakeUpInhibitionNvmStorage = false
        ComMNoWakeup = true
        ComMNetworkManagement: ComMNmVariant=NONE, ComMNmLightTimeout=10, ComMPncNmRequest=false
        ComMUserPerChannel_Can_Network_test0_Channel_Can_Network_test0 (ComMUserPerChannel): ComMUserChannel=ComMUser_Can_Network_test0_Channel_Can_Network_test0
      ComMUser_Can_Network_test0_Channel_Can_Network_test0 (ComMUser): ComMUserIdentifier=0
    ComMGeneral:
      ComMResetAfterForcingNoComm = false
      ComMModeLimitationEnabled = false
      ComMPncGatewayEnabled = false
      ComMEcuGroupClassification = 0
      ComMDevErrorDetect = false
      ComMWakeupInhibitionEnabled = false
      ComMPncSupport = false
      ComMTMinFullComModeDuration = 0.01
      ComMVersionInfoApi = false
      ComMRteEnabled = false
      ComMSynchronousWakeUp = false
  module config EcuC: implementation-config-variant=VARIANT-PRE-COMPILE
    EcucConfigSet
      EcucPduCollection: PduIdTypeEnum=uint16, PduLengthTypeEnum=uint16
        16 x Pdu, all with PduLength=8:
          Ctrl_Cmd_CanIf2PduR_Can_Network_test0_Channel_CAN: SysTPduToPduTriggeringRef=PduTrig_Ctrl_Cmd
          Ctrl_Cmd_PduR2Com_Can_Network_test0_Channel_CAN: SysTPduToPduTriggeringRef=PduTrig_Ctrl_Cmd
          Uds_Rx_Fun_CanIf2CanTp_Can_Network_test0_Channel_CAN: SysTPduToPduTriggeringRef=PduTrig_Uds_Rx_Fun
          Uds_Rx_Fun_CanTp2PduR_Can_Network_test0_Channel_CAN: SysTPduToPduTriggeringRef=PduTrig_Uds_Rx_Fun
          Uds_Rx_Fun_PduR2Dcm_Can_Network_test0_Channel_CAN: SysTPduToPduTriggeringRef=PduTrig_Uds_Rx_Fun
          Uds_Rx_Phy_CanIf2CanTp_Can_Network_test0_Channel_CAN: SysTPduToPduTriggeringRef=PduTrig_Uds_Rx_Phy
          Uds_Rx_Phy_CanTp2PduR_Can_Network_test0_Channel_CAN: SysTPduToPduTriggeringRef=PduTrig_Uds_Rx_Phy
          Uds_Rx_Phy_PduR2Dcm_Can_Network_test0_Channel_CAN: SysTPduToPduTriggeringRef=PduTrig_Uds_Rx_Phy
          Sts_Meg_Com2PduR_Can_Network_test0_Channel_CAN: SysTPduToPduTriggeringRef=PduTrig_Sts_Meg
          Sts_Meg_PduR2CanIf_Can_Network_test0_Channel_CAN: SysTPduToPduTriggeringRef=PduTrig_Sts_Meg
          Uds_Tx_Phys_Dcm2PduR_Can_Network_test0_Channel_CAN: SysTPduToPduTriggeringRef=PduTrig_Uds_Tx
          Uds_Tx_Phys_PduR2CanTp_Can_Network_test0_Channel_CAN: SysTPduToPduTriggeringRef=PduTrig_Uds_Tx
          Uds_Tx_Phys_CanTp2CanIf_Can_Network_test0_Channel_CAN: SysTPduToPduTriggeringRef=PduTrig_Uds_Tx
          Can_Nm_CanNm2CanIf_Can_Network_test0_Channel_CAN: DynamicLength=false, SysTPduToFrameTriggeringRef=Can_Nm_Trgr
          Can_Nm_Com2PduR_Can_Network_test0_Channel_CAN: DynamicLength=false, SysTPduToFrameTriggeringRef=Can_Nm_Trgr
          Can_Nm_PduR2CanNm_Can_Network_test0_Channel_CAN: DynamicLength=false, SysTPduToFrameTriggeringRef=Can_Nm_Trgr
    EcuCRbSettings: EcuCRbRteInUse=true, EcuCRbArRelease=AR45_Rev0
  module config PduR: implementation-config-variant=VARIANT-PRE-COMPILE
    PduRRoutingPaths: PduRConfigurationId=0
      Ctrl_Cmd_CanIf2Com_Can_Network_test0_Channel_CAN (PduRRoutingPath):
        PduRDestPduRRef = PduRRoutingPaths/Ctrl_Cmd_PduR2Com_Can_Network_test0_Channel_CAN
        PduRSrcPduRRef = PduRRoutingPaths/Ctrl_Cmd_CanIf2PduR_Can_Network_test0_Channel_CAN
      Ctrl_Cmd_PduR2Com_Can_Network_test0_Channel_CAN (PduRDestPdu): PduRDestPduRef=EcucPduCollection/Ctrl_Cmd_PduR2Com_Can_Network_test0_Channel_CAN
      Ctrl_Cmd_CanIf2PduR_Can_Network_test0_Channel_CAN (PduRSrcPdu): PduRSrcPduRef=EcucPduCollection/Ctrl_Cmd_CanIf2PduR_Can_Network_test0_Channel_CAN
      Uds_Rx_Fun_CanTp2Dcm_Can_Network_test0_Channel_CAN (PduRRoutingPath):
        PduRSrcPduRRef = PduRRoutingPaths/Uds_Rx_Fun_CanTp2PduR_Can_Network_test0_Channel_CAN
        PduRDestPduRRef = PduRRoutingPaths/Uds_Rx_Fun_PduR2Dcm_Can_Network_test0_Channel_CAN
      Uds_Rx_Fun_CanTp2PduR_Can_Network_test0_Channel_CAN (PduRSrcPdu): PduRSrcPduRef=EcucPduCollection/Uds_Rx_Fun_CanTp2PduR_Can_Network_test0_Channel_CAN
      Uds_Rx_Fun_PduR2Dcm_Can_Network_test0_Channel_CAN (PduRDestPdu): PduRDestPduRef=EcucPduCollection/Uds_Rx_Fun_PduR2Dcm_Can_Network_test0_Channel_CAN
      Uds_Rx_Phy_CanTp2Dcm_Can_Network_test0_Channel_CAN (PduRRoutingPath):
        PduRSrcPduRRef = PduRRoutingPaths/Uds_Rx_Phy_CanTp2PduR_Can_Network_test0_Channel_CAN
        PduRDestPduRRef = PduRRoutingPaths/Uds_Rx_Phy_PduR2Dcm_Can_Network_test0_Channel_CAN
      Uds_Rx_Phy_CanTp2PduR_Can_Network_test0_Channel_CAN (PduRSrcPdu): PduRSrcPduRef=EcucPduCollection/Uds_Rx_Phy_CanTp2PduR_Can_Network_test0_Channel_CAN
      Uds_Rx_Phy_PduR2Dcm_Can_Network_test0_Channel_CAN (PduRDestPdu): PduRDestPduRef=EcucPduCollection/Uds_Rx_Phy_PduR2Dcm_Can_Network_test0_Channel_CAN
      Sts_Meg_Com2CanIf_Can_Network_test0_Channel_CAN (PduRRoutingPath):
        PduRSrcPduRRef = PduRRoutingPaths/Sts_Meg_Com2PduR_Can_Network_test0_Channel_CAN
        PduRDestPduRRef = PduRRoutingPaths/Sts_Meg_PduR2CanIf_Can_Network_test0_Channel_CAN
      Sts_Meg_PduR2CanIf_Can_Network_test0_Channel_CAN (PduRDestPdu): PduRDestPduRef=EcucPduCollection/Sts_Meg_PduR2CanIf_Can_Network_test0_Channel_CAN
      Sts_Meg_Com2PduR_Can_Network_test0_Channel_CAN (PduRSrcPdu): PduRSrcPduRef=EcucPduCollection/Sts_Meg_Com2PduR_Can_Network_test0_Channel_CAN
      Uds_Tx_Dcm2CanTp_Can_Network_test0_Channel_CAN (PduRRoutingPath):
        PduRSrcPduRRef = PduRRoutingPaths/Uds_Tx_Phys_Dcm2PduR_Can_Network_test0_Channel_CAN
        PduRDestPduRRef = PduRRoutingPaths/Uds_Tx_Phys_PduR2CanTp_Can_Network_test0_Channel_CAN
      Uds_Tx_Phys_Dcm2PduR_Can_Network_test0_Channel_CAN (PduRSrcPdu): PduRSrcPduRef=EcucPduCollection/Uds_Tx_Phys_Dcm2PduR_Can_Network_test0_Channel_CAN
      Uds_Tx_Phys_PduR2CanTp_Can_Network_test0_Channel_CAN (PduRDestPdu): PduRDestPduRef=EcucPduCollection/Uds_Tx_Phys_PduR2CanTp_Can_Network_test0_Channel_CAN
      Can_Nm_Com2CanNm_Can_Network_test0_Channel_CAN (PduRRoutingPath):
        PduRSrcPduRRef = PduRRoutingPaths/Can_Nm_Com2PduR_Can_Network_test0_Channel_CAN
        PduRDestPduRRef = PduRRoutingPaths/Can_Nm_PduR2CanNm_Can_Network_test0_Channel_CAN
      Can_Nm_Com2PduR_Can_Network_test0_Channel_CAN (PduRSrcPdu): PduRSrcPduRef=EcucPduCollection/Can_Nm_Com2PduR_Can_Network_test0_Channel_CAN
      Can_Nm_PduR2CanNm_Can_Network_test0_Channel_CAN (PduRDestPdu): PduRDestPduRef=EcucPduCollection/Can_Nm_PduR2CanNm_Can_Network_test0_Channel_CAN
    5 x PduRBswModules, all with PduRCancelReceive=false:
      CanIf: PduRUpperModule=false, PduRTriggertransmit=false, PduRCommunicationInterface=true, PduRTransportProtocol=false, PduRCancelTransmit=false, PduRLowerModule=true, PduRTxConfirmation=true, PduRBswModuleRef=CanIf
      Com: PduRUpperModule=true, PduRTriggertransmit=true, PduRCommunicationInterface=true, PduRTransportProtocol=true, PduRCancelTransmit=false, PduRLowerModule=false, PduRTxConfirmation=false, PduRBswModuleRef=Com
      CanTp: PduRUpperModule=false, PduRTriggertransmit=false, PduRCommunicationInterface=false, PduRTransportProtocol=true, PduRCancelTransmit=true, PduRLowerModule=true, PduRTxConfirmation=true, PduRBswModuleRef=CanTp
        PduRRbInvalidHandlers: PduRRbIHCancelTransmit=false, PduRRbIHCancelReceive=false
      Dcm: PduRUpperModule=true, PduRTriggertransmit=false, PduRCommunicationInterface=false, PduRTransportProtocol=true, PduRCancelTransmit=true, PduRLowerModule=false, PduRTxConfirmation=true, PduRBswModuleRef=Dcm
      CanNm: PduRUpperModule=false, PduRTriggertransmit=true, PduRCommunicationInterface=true, PduRTransportProtocol=false, PduRCancelTransmit=false, PduRLowerModule=true, PduRTxConfirmation=true, PduRBswModuleRef=CanNm
    PduRGeneral:
      PduRRbTPGatewayOperation = false
      PduRRbMulticastFromTpSupport = false
      PduRVersionInfoApi = false
      PduRRbQueueingSupport = false
      PduRZeroCostOperation = false
      PduRDevErrorDetect = false
      PduRRbMulticastToTpSupport = false
      PduRRbIFGatewayOperation = false
      PduRRbMulticastToIfSupport = false
  module config Com: implementation-config-variant=VARIANT-PRE-COMPILE
    ComConfig
      IP_Ctrl_Cmd_Can_Network_test0_Channel_CAN_Rx (ComIPdu):
        ComIPduDirection = RECEIVE
        ComIPduSignalProcessing = IMMEDIATE
        ComIPduType = NORMAL
        ComIPduSignalRef = S_LED3_STS_Can_Network_test0_Channel_CAN_Rx
        ComIPduSignalRef = S_LED2_STS_Can_Network_test0_Channel_CAN_Rx
        ComIPduSignalRef = S_LED1_STS_Can_Network_test0_Channel_CAN_Rx
        ComIPduSignalRef = S_LED0_STS_Can_Network_test0_Channel_CAN_Rx
        ComIPduGroupRef = ComIPduGroup_Rx
        ComPduIdRef = EcucPduCollection/Ctrl_Cmd_PduR2Com_Can_Network_test0_Channel_CAN
      4 x ComSignal, all with ComSignalType=UINT8, ComSignalEndianness=BIG_ENDIAN, ComBitSize=1, ComTransferProperty=TRIGGERED:
        S_LED3_STS_Can_Network_test0_Channel_CAN_Rx: ComBitPosition=3, ComSystemTemplateSystemSignalRef=LED3_STS
        S_LED2_STS_Can_Network_test0_Channel_CAN_Rx: ComBitPosition=2, ComSystemTemplateSystemSignalRef=LED2_STS
        S_LED1_STS_Can_Network_test0_Channel_CAN_Rx: ComBitPosition=6, ComSystemTemplateSystemSignalRef=LED1_STS
        S_LED0_STS_Can_Network_test0_Channel_CAN_Rx: ComBitPosition=0, ComSystemTemplateSystemSignalRef=LED0_STS
      IP_Sts_Meg_Can_Network_test0_Channel_CAN_Tx (ComIPdu):
        ComIPduDirection = SEND
        ComTimeout = 0.1
        ComIPduSignalProcessing = IMMEDIATE
        ComIPduType = NORMAL
        ComFirstTimeout = 0.1
        ComIPduSignalRef = S_ADC1_S10_Vltg_Can_Network_test0_Channel_CAN_Tx
        ComIPduSignalRef = S_LED3_STS_Sts_Meg_Can_Network_test0_Channel_CAN_Tx
        ComIPduSignalRef = S_LED2_STS_Sts_Meg_Can_Network_test0_Channel_CAN_Tx
        ComIPduSignalRef = S_LED1_STS_Sts_Meg_Can_Network_test0_Channel_CAN_Tx
        ComIPduSignalRef = S_LED0_STS_Sts_Meg_Can_Network_test0_Channel_CAN_Tx
        ComIPduGroupRef = ComIPduGroup_Tx
        ComPduIdRef = EcucPduCollection/Sts_Meg_Com2PduR_Can_Network_test0_Channel_CAN
        ComTxIPdu: ComTxIPduUnusedAreasDefault=255
          ComTxModeTrue
            ComTxMode: ComTxModeNumberOfRepetitions=0, ComTxModeMode=PERIODIC, ComTxModeTimeOffset=0.0, ComTxModeTimePeriod=0.1, ComTxModeRepetitionPeriod=0
          ComTxModeFalse
            ComTxMode: ComTxModeNumberOfRepetitions=0, ComTxModeMode=PERIODIC, ComTxModeTimeOffset=0.0, ComTxModeTimePeriod=0.1, ComTxModeRepetitionPeriod=0
      5 x ComSignal, all with ComSignalEndianness=BIG_ENDIAN, ComTransferProperty=TRIGGERED:
        S_ADC1_S10_Vltg_Can_Network_test0_Channel_CAN_Tx: ComSignalType=UINT16, ComBitSize=16, ComBitPosition=15, ComSystemTemplateSystemSignalRef=ADC1_S10_Vltg
          ComFilter: ComFilterAlgorithm=NEW_IS_WITHIN, ComFilterMin=0, ComFilterMax=0, ComFilterOffset=0
        S_LED3_STS_Sts_Meg_Can_Network_test0_Channel_CAN_Tx: ComSignalType=UINT8, ComBitSize=1, ComBitPosition=2, ComSystemTemplateSystemSignalRef=LED3_STS_Sts_Meg
          ComFilter: ComFilterAlgorithm=ALWAYS, ComFilterMin=0, ComFilterMax=0, ComFilterOffset=0
        S_LED2_STS_Sts_Meg_Can_Network_test0_Channel_CAN_Tx: ComSignalType=UINT8, ComBitSize=1, ComBitPosition=1, ComSystemTemplateSystemSignalRef=LED2_STS_Sts_Meg
          ComFilter: ComFilterAlgorithm=ALWAYS, ComFilterMin=0, ComFilterMax=0, ComFilterOffset=0
        S_LED1_STS_Sts_Meg_Can_Network_test0_Channel_CAN_Tx: ComSignalType=UINT8, ComBitSize=1, ComBitPosition=3, ComSystemTemplateSystemSignalRef=LED1_STS_Sts_Meg
          ComFilter: ComFilterAlgorithm=ALWAYS, ComFilterMin=0, ComFilterMax=0, ComFilterOffset=0
        S_LED0_STS_Sts_Meg_Can_Network_test0_Channel_CAN_Tx: ComSignalType=UINT8, ComBitSize=1, ComBitPosition=0, ComSystemTemplateSystemSignalRef=LED0_STS_Sts_Meg
          ComFilter: ComFilterAlgorithm=ALWAYS, ComFilterMin=0, ComFilterMax=0, ComFilterOffset=0
      IP_Can_Nm_Can_Network_test0_Channel_CAN_Tx (ComIPdu):
        ComIPduDirection = SEND
        ComIPduSignalProcessing = IMMEDIATE
        ComIPduType = TP
        ComIPduGroupRef = ComIPduGroup_Tx
        ComPduIdRef = EcucPduCollection/Can_Nm_Com2PduR_Can_Network_test0_Channel_CAN
        ComTxIPdu: ComTxIPduUnusedAreasDefault=255
          ComTxModeTrue
            ComTxMode: ComTxModeNumberOfRepetitions=0, ComTxModeMode=NONE, ComTxModeTimeOffset=0.0, ComTxModeRepetitionPeriod=0, ComTxModeTimePeriod=0.1
      ComMainFunctionTx: ComMainTxTimeBase=0.01
      ComIPduGroup_Tx (ComIPduGroup)
      ComMainFunctionRx: ComMainRxTimeBase=0.01
      ComIPduGroup_Rx (ComIPduGroup)
    ComGeneral:
      ComCancellationSupport = false
      ComEnableJitterFilter = false
      ComCommonIPduTxPeriodFeature = false
      ComVersionInfoApi = false
      ComEnableSignalGroupArrayApi = false
      ComConfigurationUseDet = false
  module config Can: implementation-config-variant=VARIANT-PRE-COMPILE
    CanConfigSet
      Can_Network_CANNODE_0 (CanController):
        CanRxProcessing = POLLING
        CanControllerId = 0
        CanWakeupProcessing = POLLING
        CanControllerBaseAddress = 0
        CanTxProcessing = POLLING
        CanBusoffProcessing = POLLING
        CanControllerActivation = true
        CanWakeupSupport = false
        CanCpuClockRef = McuClockReferencePoint
        CanControllerDefaultBaudrate = Can_Network_CANNODE_0_BR_0
        Can_Network_CANNODE_0_BR_0 (CanControllerBaudrateConfig):
          CanControllerBaudRate = 500
          CanControllerBaudRateConfigID = 1
          CanControllerSeg1 = 10
          CanControllerSyncJumpWidth = 0
          CanControllerSeg2 = 0
          CanControllerPropSeg = 0
          CanControllerFdBaudrateConfig:
            CanControllerFdBaudRate = 800
            CanControllerSeg1 = 10
            CanControllerSyncJumpWidth = 0
            CanControllerSeg2 = 0
            CanControllerTxBitRateSwitch = true
            CanControllerPropSeg = 0
      6 x CanHardwareObject, all with CanHandleType=FULL, CanHwObjectCount=1, CanIdType=STANDARD, CanControllerRef=CanConfigSet/Can_Network_CANNODE_0:
        Can_Network_CANNODE_0_Rx_Std_MailBox_1: CanObjectId=0, CanObjectType=RECEIVE
          CanHwFilter: CanHwFilterMask=2047, CanHwFilterCode=257
        Can_Network_CANNODE_0_Rx_Std_MailBox_2: CanObjectId=1, CanObjectType=RECEIVE
          CanHwFilter: CanHwFilterMask=2047, CanHwFilterCode=2015
        Can_Network_CANNODE_0_Rx_Std_MailBox_3: CanObjectId=2, CanObjectType=RECEIVE
          CanHwFilter: CanHwFilterMask=2047, CanHwFilterCode=1893
        Can_Network_CANNODE_0_Tx_Std_MailBox_1: CanObjectId=3, CanObjectType=TRANSMIT
        Can_Network_CANNODE_0_Tx_Std_MailBox_2: CanObjectId=4, CanObjectType=TRANSMIT
        Can_Network_CANNODE_0_Tx_Std_MailBox_3: CanObjectId=5, CanObjectType=TRANSMIT
    CanGeneral:
      CanIndex = 0
      CanMultiplexedTransmission = false
      CanMainFunctionModePeriod = 0.001
      CanVersionInfoApi = false
      CanDevErrorDetect = false
      CanMainFunctionBusoffPeriod = 0.001
      CanEnableSecurityEventReporting = false
      CanGlobalTimeSupport = false
      CanTimeoutDuration = 1
  module config CanIf: implementation-config-variant=VARIANT-PRE-COMPILE
    CanIfCtrlDrvCfg:
      CanIfRbCtrlDrvPrefix = CanConf_CanHardwareObject
      CanIfRbForeignDrvSupport = true
      CanIfCtrlDrvNameRef = CanGeneral
      CanIfCtrlDrvInitHohConfigRef = CanIfInitHohCfg
      Can_Network_CANNODE_0 (CanIfCtrlCfg): CanIfCtrlWakeupSupport=false, CanIfCtrlId=0, CanIfCtrlCanCtrlRef=CanConfigSet/Can_Network_CANNODE_0
    CanIfInitCfg: CanIfInitCfgSet=0
      CanIfInitHohCfg
        3 x CanIfHrhCfg, all with CanIfHrhCanCtrlIdRef=CanIfCtrlDrvCfg/Can_Network_CANNODE_0:
          Can_Network_CANNODE_0_Rx_Std_MailBox_{1..3}: CanIfHrhIdSymRef=CanConfigSet/Can_Network_CANNODE_0_Rx_Std_MailBox_{1..3}
        3 x CanIfHthCfg, all with CanIfHthCanCtrlIdRef=CanIfCtrlDrvCfg/Can_Network_CANNODE_0:
          Can_Network_CANNODE_0_Tx_Std_MailBox_{1..3}: CanIfHthIdSymRef=CanConfigSet/Can_Network_CANNODE_0_Tx_Std_MailBox_{1..3}
      3 x CanIfRxPduCfg, all with CanIfRxPduCanIdType=STANDARD_FD_CAN, CanIfRxPduReadData=false, CanIfRxPduReadNotifyStatus=true:
        Ctrl_Cmd_Can_Network_CANNODE_0_IN: CanIfRxPduUserRxIndicationUL=PDUR, CanIfRxPduCanId=257, CanIfRxPduDataLength=8, CanIfRxPduUserRxIndicationName=PduR_CanIfRxIndication, CanIfRxPduRef=EcucPduCollection/Ctrl_Cmd_CanIf2PduR_Can_Network_test0_Channel_CAN, CanIfRxPduHrhIdRef=CanIfInitHohCfg/Can_Network_CANNODE_0_Rx_Std_MailBox_1
        Uds_Rx_Fun_Can_Network_CANNODE_0_IN: CanIfRxPduUserRxIndicationUL=CAN_TP, CanIfRxPduCanId=2015, CanIfRxPduDataLength=0, CanIfRxPduRef=Uds_Rx_Fun_CanIf2CanTp_Can_Network_test0_Channel_CAN, CanIfRxPduHrhIdRef=CanIfInitHohCfg/Can_Network_CANNODE_0_Rx_Std_MailBox_2
        Uds_Rx_Phy_Can_Network_CANNODE_0_IN: CanIfRxPduUserRxIndicationUL=CAN_TP, CanIfRxPduCanId=1893, CanIfRxPduDataLength=0, CanIfRxPduRef=Uds_Rx_Phy_CanIf2CanTp_Can_Network_test0_Channel_CAN, CanIfRxPduHrhIdRef=CanIfInitHohCfg/Can_Network_CANNODE_0_Rx_Std_MailBox_3
      Can_Nm_Can_Network_CANNODE_0_OUT (CanIfTxPduCfg):
        CanIfTxPduReadNotifyStatus = false
        CanIfTxPduCanIdType = STANDARD_FD_CAN
        CanIfTxPduCanId = 1536
        CanIfTxPduTruncation = false
        CanIfTxPduType = STATIC
        CanIfTxPduId = 0
        CanIfTxPduUserTxConfirmationUL = CAN_NM
        CanIfTxPduBufferRef = Bu_Can_Network_CANNODE_0_Tx_Std_MailBox_1
        CanIfTxPduRef = Can_Nm_CanNm2CanIf_Can_Network_test0_Channel_CAN
      Bu_Can_Network_CANNODE_0_Tx_Std_MailBox_1 (CanIfBufferCfg): CanIfBufferSize=0, CanIfBufferHthRef=CanIfInitHohCfg/Can_Network_CANNODE_0_Tx_Std_MailBox_1
      Sts_Meg_Can_Network_CANNODE_0_OUT (CanIfTxPduCfg):
        CanIfTxPduUserTxConfirmationName = PduR_CanIfTxConfirmation
        CanIfTxPduReadNotifyStatus = false
        CanIfTxPduUserTxConfirmationUL = PDUR
        CanIfTxPduCanIdType = STANDARD_FD_CAN
        CanIfTxPduCanId = 258
        CanIfTxPduTruncation = false
        CanIfTxPduType = STATIC
        CanIfTxPduId = 0
        CanIfTxPduRef = EcucPduCollection/Sts_Meg_PduR2CanIf_Can_Network_test0_Channel_CAN
        CanIfTxPduBufferRef = Bu_Can_Network_CANNODE_0_Tx_Std_MailBox_2
      Bu_Can_Network_CANNODE_0_Tx_Std_MailBox_2 (CanIfBufferCfg): CanIfBufferSize=0, CanIfBufferHthRef=CanIfInitHohCfg/Can_Network_CANNODE_0_Tx_Std_MailBox_2
      Uds_Tx_Can_Network_CANNODE_0_OUT (CanIfTxPduCfg):
        CanIfTxPduReadNotifyStatus = false
        CanIfTxPduUserTxConfirmationUL = CAN_TP
        CanIfTxPduCanIdType = STANDARD_FD_CAN
        CanIfTxPduCanId = 1901
        CanIfTxPduTruncation = false
        CanIfTxPduType = STATIC
        CanIfTxPduId = 0
        CanIfTxPduRef = Uds_Tx_Phys_CanTp2CanIf_Can_Network_test0_Channel_CAN
        CanIfTxPduBufferRef = Bu_Can_Network_CANNODE_0_Tx_Std_MailBox_3
      Bu_Can_Network_CANNODE_0_Tx_Std_MailBox_3 (CanIfBufferCfg): CanIfBufferSize=0, CanIfBufferHthRef=CanIfInitHohCfg/Can_Network_CANNODE_0_Tx_Std_MailBox_3
    CanIfPublicCfg:
      CanIfPublicWakeupCheckValidSupport = false
      CanIfPublicHandleTypeEnum = UINT8
      CanIfPublicErrorPassiveSupport = false
      CanIfPublicBusoffRecoveryfromRxIndication = false
      CanIfPublicTxBuffering = false
      CanIfPublicReadTxPduNotifyStatusApi = true
      CanIfPublicCanIfLiteConfiguration = false
      CanIfVersionInfoApi = false
      CanIfPublicTxConfirmPollingSupport = false
      CanIfTxOfflineActiveSupport = false
      CanIfPublicCancelTransmitSupport = false
      CanIfPublicReadRxPduNotifyStatusApi = true
      CanIfWakeupSupport = false
      CanIfTriggerTransmitSupport = false
      CanIfPublicSetDynamicTxIdApi = false
      CanIfPublicMultipleDrvSupport = false
      CanIfPublicPnSupport = false
      CanIfPublicReadRxPduDataApi = false
      CanIfDevErrorDetect = false
      CanIfPublicUserTpTxInOfflineMode = false
      CanIfGlobalTimeSupport = false
      CanIfRbCalibrationSupport: CanIfRbCalibration=false
    CanIfDispatchCfg: CanIfDispatchUserTrcvModeIndicationName=CAN_SM, CanIfDispatchUserCtrlBusOffUL=CAN_SM, CanIfDispatchUserCtrlModeIndicationUL=CAN_SM
    CanIfPrivateCfg: CanIfPrivateDataLengthCheck=false
  module config CanTp: implementation-config-variant=VARIANT-PRE-COMPILE
    CanTpConfig: CanTpMainFunctionPeriod=0.002
      CanTpChannel: CanTpRbHalfDuplexEnable=0
        CanTpRxNSdu:
          CanTpRbRxFcDisabled = 0
          CanTpRxAddressingFormat = CANTP_STANDARD
          CanTpRxNSduId = 0
          CanTpRxPaddingActivation = CANTP_ON
          CanTpRxTaType = CANTP_PHYSICAL
          CanTpRxNSduRef = Uds_Rx_Fun_CanIf2CanTp_Can_Network_test0_Channel_CAN
          CanTpRxNPdu_0 (CanTpRxNPdu): CanTpRxNPduId=0, CanTpRxNPduRef=EcucPduCollection/Uds_Rx_Fun_CanTp2PduR_Can_Network_test0_Channel_CAN
    CanTpGeneral:
      CanTpRbPageConfirmation = false
      CanTpDevErrorDetect = false
      CanTpChangeParameterApi = false
      CanTpReadParameterApi = false
      CanTpVersionInfoApi = true
      CanTpRbStrictDlcCheck = false
      CanTpPaddingByte = 0
  module config Dcm: implementation-config-variant=VARIANT-PRE-COMPILE
    DcmConfigSet
      DcmDsd_0 (DcmDsd): DcmRbDsdRequestManufacturerNotificationEnabled=false, DcmRbDsdRequestSupplierNotificationEnabled=false
        DcmDsdServiceTable_0 (DcmDsdServiceTable): DcmRbNRCForService=127
          DcmDsdService_0 (DcmDsdService)
      DcmDsl_0 (DcmDsl)
        DcmDslBuffer_0 (DcmDslBuffer)
        DcmDslDiagResp_0 (DcmDslDiagResp)
        DcmDslProtocol_0 (DcmDslProtocol)
          DcmDslProtocolRow_0 (DcmDslProtocolRow): DcmDslProtocolMaximumResponseSize=4095, DcmSendRespPendOnRestart=1
            DcmDslConnection_0 (DcmDslConnection)
      DcmPageBufferCfg_0 (DcmPageBufferCfg)
      DcmDsp:
        DcmDspEnableObdMirror = 0
        DcmRbDspAutoConfigureDEMOBDPIDs = 0
        DcmRbDspLimitRDBIRespToBufSize = 0
        DcmRbDspRdbiPagedBufferEnabled = 0
        DcmRbDspSequenceCheckRequestDownloadDisabled = 0
        DcmRbDspSequenceCheckRequestUploadDisabled = 0
        DcmRbDspSesSecUsedInProtocol = UDS
        DcmRbDspTransferDataMaxLenChkRequired = 1
        DcmDspDataDefaultEndianness = LITTLE_ENDIAN
        DcmDspSecurity_0 (DcmDspSecurity): DcmRbDspSecurityDelayTimerMonitor=REQUEST_SEED, DcmRbDspSecurityNRCExceedNoOfAttempt=NumAttDelayAndNumAttLock
        DcmDspSession_0 (DcmDspSession): DcmRbDspSessionParamRecordEnabled=1
  module config CanNm: implementation-config-variant=VARIANT-PRE-COMPILE
    CanNmGlobalConfig:
      CanNmGlobalPnSupport = false
      CanNmVersionInfoApi = false
      CanNmCoordinatorSyncSupport = false
      CanNmComControlEnabled = false
      CanNmStateChangeIndEnabled = false
      CanNmBusLoadReductionEnabled = false
      CanNmPnEiraCalcEnabled = false
      CanNmUserDataEnabled = false
      CanNmPnSyncShutdownErrorReactionEnabled = false
      CanNmMainFunctionPeriod = 0.01
      CanNmRemoteSleepIndEnabled = false
      CanNmComUserDataSupport = true
      CanNmDevErrorDetect = false
      CanNmPduRxIndicationEnabled = false
      CanNmImmediateTxconfEnabled = false
      CanNmBusSynchronizationEnabled = false
      CanNmPassiveModeEnabled = false
      CanNmImmediateRestartEnabled = false
      CanNmCC_CanNmCluster_0_1 (CanNmChannelConfig):
        CanNmBusLoadReductionActive = false
        CanNmWaitBusSleepTime = 0.01
        CanNmImmediateNmTransmissions = 0
        CanNmRepeatMessageTime = 0
        CanNmMsgCycleOffset = 0
        CanNmImmediateNmCycleTime = 0.01
        CanNmTimeoutTime = 0.02
        CanNmRepeatMsgIndEnabled = false
        CanNmMsgReducedTime = 0.01
        CanNmNodeDetectionEnabled = false
        CanNmMsgTimeoutTime = 0.01
        CanNmNodeIdEnabled = false
        CanNmCarWakeUpRxEnabled = false
        CanNmNodeId = 1
        CanNmPduNidPosition = CANNM_PDU_BYTE_0
        CanNmPnEnabled = false
        CanNmRemoteSleepIndTime = 0.01
        CanNmMsgCycleTime = 0.01
        CanNmPduCbvPosition = CANNM_PDU_BYTE_1
        CanNmComMNetworkHandleRef = Can_Network_test0_Channel_Can_Network_test0
        Can_Nm_Can_Network_test0_Channel (CanNmTxPdu): CanNmTxConfirmationPduId=0, CanNmTxPduRef=Can_Nm_CanNm2CanIf_Can_Network_test0_Channel_CAN
        Can_Nm_UserData_Can_Network_test0_Channel (CanNmUserDataTxPdu): CanNmTxUserDataPduId=0, CanNmTxUserDataPduRef=EcucPduCollection/Can_Nm_PduR2CanNm_Can_Network_test0_Channel_CAN
        CanNmRxPdu: CanNmRxPduId=0, CanNmRxPduRef=EcucPduCollection/Can_Nm_PduR2CanNm_Can_Network_test0_Channel_CAN
  module config CanSM: implementation-config-variant=VARIANT-PRE-COMPILE
    CanSMConfiguration: CanSMModeRequestRepetitionMax=5, CanSMModeRequestRepetitionTime=0.07
      Can_Network_CANNODE_0 (CanSMManagerNetwork):
        CanSMBorCounterL1ToL2 = 0
        CanSMBorTimeL1 = 0.04
        CanSMBorTimeL2 = 0.1
        CanSMBorTimeTxEnsured = 0.02
        CanSMBorTxConfirmationPolling = false
        CanSMComMNetworkHandleRef = Can_Network_test0_Channel_Can_Network_test0
        Can_Network_CANNODE_0 (CanSMController): CanSMControllerId=CanIfCtrlDrvCfg/Can_Network_CANNODE_0
        CanSMDemEventParameterRefs: CanSMRbDynCreate_CANSM_E_BUS_OFF=Standard
    CanSMGeneral: CanSMMainFunctionTimePeriod=0.01, CanSMDevErrorDetect=false, CanSMVersionInfoApi=false
  module config Mcu: implementation-config-variant=VARIANT-PRE-COMPILE
    McuGeneralConfiguration: McuDevErrorDetect=false, McuInitClock=true, McuGetRamStateApi=false, McuNoPll=true, McuPerformResetApi=true, McuVersionInfoApi=false
    McuPublishedInformation
      McuResetReasonConf: McuResetReason=0
    McuModuleConfiguration: McuNumberOfMcuModes=1, McuRamSectors=0, McuResetSetting=1, McuClockSrcFailureNotification=DISABLED
      McuClockSettingConfig: McuClockSettingId=1
        McuClockReferencePoint: McuClockReferencePointFrequency=0.0
      McuModeSettingConf: McuMode=1
