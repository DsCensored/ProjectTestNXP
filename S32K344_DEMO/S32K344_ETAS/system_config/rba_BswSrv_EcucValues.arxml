AUTOSAR XML (schema 00049)
package /ETAS_Project/EcucModuleConfigurationValuess
  module config rba_BswSrv
    rba_BswSrv_Config:
      rba_BswSrv_Config_Compiler_Lib_Support = 0
      rba_BswSrv_Config_Disable_Lock_support = 0
      rba_BswSrv_Config_Log_Level = 0
      rba_BswSrv_Config_Machine_Support_64bit = 0
      rba_BswSrv_Config_PrvWriteLock = ;
      rba_BswSrv_Config_GetReturnAddress = return 0x00000000;
      rba_BswSrv_Config_Get_Sys_Tick = 100
      rba_BswSrv_Config_PrvTryToGetLock = return E_NOT_OK;
      rba_BswSrv_Config_Get_Core_Id = 0
